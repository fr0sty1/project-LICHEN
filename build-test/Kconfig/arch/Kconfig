## firmware/bridge-zephyr/build/Kconfig/soc/Kconfig.defconfig
```kconfig
# Load Zephyr SoC Kconfig defconfig.
osource "/Volumes/Attic/Desktop/Projects/project-LICHEN/zephyr/soc/xlnx/zynqmp/Kconfig.defconfig"
osource "/Volumes/Attic/Desktop/Projects/project-LICHEN/zephyr/soc/xlnx/zynq7000/Kconfig.defconfig"
osource "/Volumes/Attic/Desktop/Projects/project-LICHEN/zephyr/soc/xen/Kconfig.defconfig"
osource "/Volumes/Attic/Desktop/Projects/project-LICHEN/zephyr/soc/ti/simplelink/Kconfig.defconfig"
osource "/Volumes/Attic/Desktop/Projects/project-LICHEN/zephyr/soc/ti/lm3s6965/Kconfig.defconfig"
osource "/Volumes/Attic/Desktop/Projects/project-LICHEN/zephyr/soc/ti/k3/Kconfig.defconfig"
osource "/Volumes/Attic/Desktop/Projects/project-LICHEN/zephyr/soc/telink/tlsr/Kconfig.defconfig"
osource "/Volumes/Attic/Desktop/Projects/project-LICHEN/zephyr/soc/starfive/jh71xx/Kconfig.defconfig"
osource "/Volumes/Attic/Desktop/Projects/project-LICHEN/zephyr/soc/st/stm32/Kconfig.defconfig"
osource "/Volumes/Attic/Desktop/Projects/project-LICHEN/zephyr/soc/snps/qemu_arc/Kconfig.defconfig"
osource "/Volumes/Attic/Desktop/Projects/project-LICHEN/zephyr/soc/snps/nsim/arc_v/Kconfig.defconfig"
osource "/Volumes/Attic/Desktop/Projects/project-LICHEN/zephyr/soc/snps/nsim/arc_classic/Kconfig.defconfig"
osource "/Volumes/Attic/Desktop/Projects/project-LICHEN/zephyr/soc/snps/hsdk4xd/Kconfig.defconfig"
osource "/Volumes/Attic/Desktop/Projects/project-LICHEN/zephyr/soc/snps/hsdk/Kconfig.defconfig"
osource "/Volumes/Attic/Desktop/Projects/project-LICHEN/zephyr/soc/snps/emsk/Kconfig.defconfig"
osource "/Volumes/Attic/Desktop/Projects/project-LICHEN/zephyr/soc/snps/emsdp/Kconfig.defconfig"
osource "/Volumes/Attic/Desktop/Projects/project-LICHEN/zephyr/soc/snps/arc_iot/Kconfig.defconfig"
osource "/Volumes/Attic/Desktop/Projects/project-LICHEN/zephyr/soc/silabs/Kconfig.defconfig"
osource "/Volumes/Attic/Desktop/Projects/project-LICHEN/zephyr/soc/sifive/sifive_freedom/Kconfig.defconfig"
osource "/Volumes/Attic/Desktop/Projects/project-LICHEN/zephyr/soc/rockchip/Kconfig.defconfig"
osource "/Volumes/Attic/Desktop/Projects/project-LICHEN/zephyr/soc/renode/riscv_virtual/Kconfig.defconfig"
osource "/Volumes/Attic/Desktop/Projects/project-LICHEN/zephyr/soc/renesas/smartbond/Kconfig.defconfig"
osource "/Volumes/Attic/Desktop/Projects/project-LICHEN/zephyr/soc/renesas/rzt2m/Kconfig.defconfig"
osource "/Volumes/Attic/Desktop/Projects/project-LICHEN/zephyr/soc/renesas/rcar/Kconfig.defconfig"
osource "/Volumes/Attic/Desktop/Projects/project-LICHEN/zephyr/soc/renesas/ra/Kconfig.defconfig"
osource "/Volumes/Attic/Desktop/Projects/project-LICHEN/zephyr/soc/raspberrypi/Kconfig.defconfig"
osource "/Volumes/Attic/Desktop/Projects/project-LICHEN/zephyr/soc/quicklogic/eos_s3/Kconfig.defconfig"
osource "/Volumes/Attic/Desktop/Projects/project-LICHEN/zephyr/soc/qemu/virt_riscv/Kconfig.defconfig"
osource "/Volumes/Attic/Desktop/Projects/project-LICHEN/zephyr/soc/qemu/malta/Kconfig.defconfig"
osource "/Volumes/Attic/Desktop/Projects/project-LICHEN/zephyr/soc/openisa/rv32m1/Kconfig.defconfig"
osource "/Volumes/Attic/Desktop/Projects/project-LICHEN/zephyr/soc/nxp/s32/Kconfig.defconfig"
osource "/Volumes/Attic/Desktop/Projects/project-LICHEN/zephyr/soc/nxp/rw/Kconfig.defconfig"
osource "/Volumes/Attic/Desktop/Projects/project-LICHEN/zephyr/soc/nxp/mcx/Kconfig.defconfig"
osource "/Volumes/Attic/Desktop/Projects/project-LICHEN/zephyr/soc/nxp/lpc/Kconfig.defconfig"
osource "/Volumes/Attic/Desktop/Projects/project-LICHEN/zephyr/soc/nxp/layerscape/Kconfig.defconfig"
osource "/Volumes/Attic/Desktop/Projects/project-LICHEN/zephyr/soc/nxp/kinetis/Kconfig.defconfig"
osource "/Volumes/Attic/Desktop/Projects/project-LICHEN/zephyr/soc/nxp/imxrt/Kconfig.defconfig"
osource "/Volumes/Attic/Desktop/Projects/project-LICHEN/zephyr/soc/nxp/imx/Kconfig.defconfig"
osource "/Volumes/Attic/Desktop/Projects/project-LICHEN/zephyr/soc/nuvoton/numicro/Kconfig.defconfig"
osource "/Volumes/Attic/Desktop/Projects/project-LICHEN/zephyr/soc/nuvoton/numaker/Kconfig.defconfig"
osource "/Volumes/Attic/Desktop/Projects/project-LICHEN/zephyr/soc/nuvoton/npcx/Kconfig.defconfig"
osource "/Volumes/Attic/Desktop/Projects/project-LICHEN/zephyr/soc/nordic/Kconfig.defconfig"
osource "/Volumes/Attic/Desktop/Projects/project-LICHEN/zephyr/soc/neorv32/Kconfig.defconfig"
osource "/Volumes/Attic/Desktop/Projects/project-LICHEN/zephyr/soc/native/inf_clock/Kconfig.defconfig"
osource "/Volumes/Attic/Desktop/Projects/project-LICHEN/zephyr/soc/microchip/miv/Kconfig.defconfig"
osource "/Volumes/Attic/Desktop/Projects/project-LICHEN/zephyr/soc/microchip/mec/Kconfig.defconfig"
osource "/Volumes/Attic/Desktop/Projects/project-LICHEN/zephyr/soc/mediatek/mtk_adsp/Kconfig.defconfig"
osource "/Volumes/Attic/Desktop/Projects/project-LICHEN/zephyr/soc/lowrisc/opentitan/Kconfig.defconfig"
osource "/Volumes/Attic/Desktop/Projects/project-LICHEN/zephyr/soc/litex/litex_vexriscv/Kconfig.defconfig"
osource "/Volumes/Attic/Desktop/Projects/project-LICHEN/zephyr/soc/ite/ec/Kconfig.defconfig"
osource "/Volumes/Attic/Desktop/Projects/project-LICHEN/zephyr/soc/intel/raptor_lake/Kconfig.defconfig"
osource "/Volumes/Attic/Desktop/Projects/project-LICHEN/zephyr/soc/intel/lakemont/Kconfig.defconfig"
osource "/Volumes/Attic/Desktop/Projects/project-LICHEN/zephyr/soc/intel/intel_socfpga_std/Kconfig.defconfig"
osource "/Volumes/Attic/Desktop/Projects/project-LICHEN/zephyr/soc/intel/intel_socfpga/Kconfig.defconfig"
osource "/Volumes/Attic/Desktop/Projects/project-LICHEN/zephyr/soc/intel/intel_niosv/Kconfig.defconfig"
osource "/Volumes/Attic/Desktop/Projects/project-LICHEN/zephyr/soc/intel/intel_ish/Kconfig.defconfig"
osource "/Volumes/Attic/Desktop/Projects/project-LICHEN/zephyr/soc/intel/intel_adsp/Kconfig.defconfig"
osource "/Volumes/Attic/Desktop/Projects/project-LICHEN/zephyr/soc/intel/elkhart_lake/Kconfig.defconfig"
osource "/Volumes/Attic/Desktop/Projects/project-LICHEN/zephyr/soc/intel/atom/Kconfig.defconfig"
osource "/Volumes/Attic/Desktop/Projects/project-LICHEN/zephyr/soc/intel/apollo_lake/Kconfig.defconfig"
osource "/Volumes/Attic/Desktop/Projects/project-LICHEN/zephyr/soc/intel/alder_lake/Kconfig.defconfig"
osource "/Volumes/Attic/Desktop/Projects/project-LICHEN/zephyr/soc/infineon/cat3/Kconfig.defconfig"
osource "/Volumes/Attic/Desktop/Projects/project-LICHEN/zephyr/soc/infineon/cat1b/Kconfig.defconfig"
osource "/Volumes/Attic/Desktop/Projects/project-LICHEN/zephyr/soc/infineon/cat1a/Kconfig.defconfig"
osource "/Volumes/Attic/Desktop/Projects/project-LICHEN/zephyr/soc/gd/gd32/Kconfig.defconfig"
osource "/Volumes/Attic/Desktop/Projects/project-LICHEN/zephyr/soc/gaisler/leon3/Kconfig.defconfig"
osource "/Volumes/Attic/Desktop/Projects/project-LICHEN/zephyr/soc/gaisler/gr716a/Kconfig.defconfig"
osource "/Volumes/Attic/Desktop/Projects/project-LICHEN/zephyr/soc/espressif/Kconfig.defconfig"
osource "/Volumes/Attic/Desktop/Projects/project-LICHEN/zephyr/soc/ene/kb1200/Kconfig.defconfig"
osource "/Volumes/Attic/Desktop/Projects/project-LICHEN/zephyr/soc/efinix/sapphire/Kconfig.defconfig"
osource "/Volumes/Attic/Desktop/Projects/project-LICHEN/zephyr/soc/cdns/xtensa_sample_controller/Kconfig.defconfig"
osource "/Volumes/Attic/Desktop/Projects/project-LICHEN/zephyr/soc/cdns/dc233c/Kconfig.defconfig"
osource "/Volumes/Attic/Desktop/Projects/project-LICHEN/zephyr/soc/brcm/bcmvk/Kconfig.defconfig"
osource "/Volumes/Attic/Desktop/Projects/project-LICHEN/zephyr/soc/brcm/bcm2712/Kconfig.defconfig"
osource "/Volumes/Attic/Desktop/Projects/project-LICHEN/zephyr/soc/brcm/bcm2711/Kconfig.defconfig"
osource "/Volumes/Attic/Desktop/Projects/project-LICHEN/zephyr/soc/atmel/sam0/Kconfig.defconfig"
osource "/Volumes/Attic/Desktop/Projects/project-LICHEN/zephyr/soc/atmel/sam/Kconfig.defconfig"
osource "/Volumes/Attic/Desktop/Projects/project-LICHEN/zephyr/soc/aspeed/Kconfig.defconfig"
osource "/Volumes/Attic/Desktop/Projects/project-LICHEN/zephyr/soc/arm/Kconfig.defconfig"
osource "/Volumes/Attic/Desktop/Projects/project-LICHEN/zephyr/soc/arm/beetle/Kconfig.defconfig"
osource "/Volumes/Attic/Desktop/Projects/project-LICHEN/zephyr/soc/andestech/Kconfig.defconfig"
osource "/Volumes/Attic/Desktop/Projects/project-LICHEN/zephyr/soc/ambiq/Kconfig.defconfig"
osource "/Volumes/Attic/Desktop/Projects/project-LICHEN/zephyr/soc/altr/zephyr_nios2f/Kconfig.defconfig"
osource "/Volumes/Attic/Desktop/Projects/project-LICHEN/zephyr/soc/altr/qemu_nios2/Kconfig.defconfig"
osource "/Volumes/Attic/Desktop/Projects/project-LICHEN/zephyr/soc/adi/max32/Kconfig.defconfig"
```
