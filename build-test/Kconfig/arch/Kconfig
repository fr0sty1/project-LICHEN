## firmware/bridge-zephyr/build/Kconfig/soc/Kconfig
```kconfig
# Load Zephyr SoC Kconfig descriptions.
osource "/Volumes/Attic/Desktop/Projects/project-LICHEN/zephyr/soc/xlnx/zynqmp/Kconfig"
osource "/Volumes/Attic/Desktop/Projects/project-LICHEN/zephyr/soc/xlnx/zynq7000/Kconfig"
osource "/Volumes/Attic/Desktop/Projects/project-LICHEN/zephyr/soc/xen/Kconfig"
osource "/Volumes/Attic/Desktop/Projects/project-LICHEN/zephyr/soc/ti/simplelink/Kconfig"
osource "/Volumes/Attic/Desktop/Projects/project-LICHEN/zephyr/soc/ti/lm3s6965/Kconfig"
osource "/Volumes/Attic/Desktop/Projects/project-LICHEN/zephyr/soc/ti/k3/Kconfig"
osource "/Volumes/Attic/Desktop/Projects/project-LICHEN/zephyr/soc/telink/tlsr/Kconfig"
osource "/Volumes/Attic/Desktop/Projects/project-LICHEN/zephyr/soc/starfive/jh71xx/Kconfig"
osource "/Volumes/Attic/Desktop/Projects/project-LICHEN/zephyr/soc/st/stm32/Kconfig"
osource "/Volumes/Attic/Desktop/Projects/project-LICHEN/zephyr/soc/snps/qemu_arc/Kconfig"
osource "/Volumes/Attic/Desktop/Projects/project-LICHEN/zephyr/soc/snps/nsim/arc_v/Kconfig"
osource "/Volumes/Attic/Desktop/Projects/project-LICHEN/zephyr/soc/snps/nsim/arc_classic/Kconfig"
osource "/Volumes/Attic/Desktop/Projects/project-LICHEN/zephyr/soc/snps/hsdk4xd/Kconfig"
osource "/Volumes/Attic/Desktop/Projects/project-LICHEN/zephyr/soc/snps/hsdk/Kconfig"
osource "/Volumes/Attic/Desktop/Projects/project-LICHEN/zephyr/soc/snps/emsk/Kconfig"
osource "/Volumes/Attic/Desktop/Projects/project-LICHEN/zephyr/soc/snps/emsdp/Kconfig"
osource "/Volumes/Attic/Desktop/Projects/project-LICHEN/zephyr/soc/snps/arc_iot/Kconfig"
osource "/Volumes/Attic/Desktop/Projects/project-LICHEN/zephyr/soc/silabs/Kconfig"
osource "/Volumes/Attic/Desktop/Projects/project-LICHEN/zephyr/soc/sifive/sifive_freedom/Kconfig"
osource "/Volumes/Attic/Desktop/Projects/project-LICHEN/zephyr/soc/rockchip/Kconfig"
osource "/Volumes/Attic/Desktop/Projects/project-LICHEN/zephyr/soc/renode/riscv_virtual/Kconfig"
osource "/Volumes/Attic/Desktop/Projects/project-LICHEN/zephyr/soc/renesas/smartbond/Kconfig"
osource "/Volumes/Attic/Desktop/Projects/project-LICHEN/zephyr/soc/renesas/rzt2m/Kconfig"
osource "/Volumes/Attic/Desktop/Projects/project-LICHEN/zephyr/soc/renesas/rcar/Kconfig"
osource "/Volumes/Attic/Desktop/Projects/project-LICHEN/zephyr/soc/renesas/ra/Kconfig"
osource "/Volumes/Attic/Desktop/Projects/project-LICHEN/zephyr/soc/raspberrypi/Kconfig"
osource "/Volumes/Attic/Desktop/Projects/project-LICHEN/zephyr/soc/quicklogic/eos_s3/Kconfig"
osource "/Volumes/Attic/Desktop/Projects/project-LICHEN/zephyr/soc/qemu/virt_riscv/Kconfig"
osource "/Volumes/Attic/Desktop/Projects/project-LICHEN/zephyr/soc/qemu/malta/Kconfig"
osource "/Volumes/Attic/Desktop/Projects/project-LICHEN/zephyr/soc/openisa/rv32m1/Kconfig"
osource "/Volumes/Attic/Desktop/Projects/project-LICHEN/zephyr/soc/nxp/s32/Kconfig"
osource "/Volumes/Attic/Desktop/Projects/project-LICHEN/zephyr/soc/nxp/rw/Kconfig"
osource "/Volumes/Attic/Desktop/Projects/project-LICHEN/zephyr/soc/nxp/mcx/Kconfig"
osource "/Volumes/Attic/Desktop/Projects/project-LICHEN/zephyr/soc/nxp/lpc/Kconfig"
osource "/Volumes/Attic/Desktop/Projects/project-LICHEN/zephyr/soc/nxp/layerscape/Kconfig"
osource "/Volumes/Attic/Desktop/Projects/project-LICHEN/zephyr/soc/nxp/kinetis/Kconfig"
osource "/Volumes/Attic/Desktop/Projects/project-LICHEN/zephyr/soc/nxp/imxrt/Kconfig"
osource "/Volumes/Attic/Desktop/Projects/project-LICHEN/zephyr/soc/nxp/imx/Kconfig"
osource "/Volumes/Attic/Desktop/Projects/project-LICHEN/zephyr/soc/nuvoton/numicro/Kconfig"
osource "/Volumes/Attic/Desktop/Projects/project-LICHEN/zephyr/soc/nuvoton/numaker/Kconfig"
osource "/Volumes/Attic/Desktop/Projects/project-LICHEN/zephyr/soc/nuvoton/npcx/Kconfig"
osource "/Volumes/Attic/Desktop/Projects/project-LICHEN/zephyr/soc/nordic/Kconfig"
osource "/Volumes/Attic/Desktop/Projects/project-LICHEN/zephyr/soc/neorv32/Kconfig"
osource "/Volumes/Attic/Desktop/Projects/project-LICHEN/zephyr/soc/native/inf_clock/Kconfig"
osource "/Volumes/Attic/Desktop/Projects/project-LICHEN/zephyr/soc/microchip/miv/Kconfig"
osource "/Volumes/Attic/Desktop/Projects/project-LICHEN/zephyr/soc/microchip/mec/Kconfig"
osource "/Volumes/Attic/Desktop/Projects/project-LICHEN/zephyr/soc/mediatek/mtk_adsp/Kconfig"
osource "/Volumes/Attic/Desktop/Projects/project-LICHEN/zephyr/soc/lowrisc/opentitan/Kconfig"
osource "/Volumes/Attic/Desktop/Projects/project-LICHEN/zephyr/soc/litex/litex_vexriscv/Kconfig"
osource "/Volumes/Attic/Desktop/Projects/project-LICHEN/zephyr/soc/ite/ec/Kconfig"
osource "/Volumes/Attic/Desktop/Projects/project-LICHEN/zephyr/soc/intel/raptor_lake/Kconfig"
osource "/Volumes/Attic/Desktop/Projects/project-LICHEN/zephyr/soc/intel/lakemont/Kconfig"
osource "/Volumes/Attic/Desktop/Projects/project-LICHEN/zephyr/soc/intel/intel_socfpga_std/Kconfig"
osource "/Volumes/Attic/Desktop/Projects/project-LICHEN/zephyr/soc/intel/intel_socfpga/Kconfig"
osource "/Volumes/Attic/Desktop/Projects/project-LICHEN/zephyr/soc/intel/intel_niosv/Kconfig"
osource "/Volumes/Attic/Desktop/Projects/project-LICHEN/zephyr/soc/intel/intel_ish/Kconfig"
osource "/Volumes/Attic/Desktop/Projects/project-LICHEN/zephyr/soc/intel/intel_adsp/Kconfig"
osource "/Volumes/Attic/Desktop/Projects/project-LICHEN/zephyr/soc/intel/elkhart_lake/Kconfig"
osource "/Volumes/Attic/Desktop/Projects/project-LICHEN/zephyr/soc/intel/atom/Kconfig"
osource "/Volumes/Attic/Desktop/Projects/project-LICHEN/zephyr/soc/intel/apollo_lake/Kconfig"
osource "/Volumes/Attic/Desktop/Projects/project-LICHEN/zephyr/soc/intel/alder_lake/Kconfig"
osource "/Volumes/Attic/Desktop/Projects/project-LICHEN/zephyr/soc/infineon/cat3/Kconfig"
osource "/Volumes/Attic/Desktop/Projects/project-LICHEN/zephyr/soc/infineon/cat1b/Kconfig"
osource "/Volumes/Attic/Desktop/Projects/project-LICHEN/zephyr/soc/infineon/cat1a/Kconfig"
osource "/Volumes/Attic/Desktop/Projects/project-LICHEN/zephyr/soc/gd/gd32/Kconfig"
osource "/Volumes/Attic/Desktop/Projects/project-LICHEN/zephyr/soc/gaisler/leon3/Kconfig"
osource "/Volumes/Attic/Desktop/Projects/project-LICHEN/zephyr/soc/gaisler/gr716a/Kconfig"
osource "/Volumes/Attic/Desktop/Projects/project-LICHEN/zephyr/soc/espressif/Kconfig"
osource "/Volumes/Attic/Desktop/Projects/project-LICHEN/zephyr/soc/ene/kb1200/Kconfig"
osource "/Volumes/Attic/Desktop/Projects/project-LICHEN/zephyr/soc/efinix/sapphire/Kconfig"
osource "/Volumes/Attic/Desktop/Projects/project-LICHEN/zephyr/soc/cdns/xtensa_sample_controller/Kconfig"
osource "/Volumes/Attic/Desktop/Projects/project-LICHEN/zephyr/soc/cdns/dc233c/Kconfig"
osource "/Volumes/Attic/Desktop/Projects/project-LICHEN/zephyr/soc/brcm/bcmvk/Kconfig"
osource "/Volumes/Attic/Desktop/Projects/project-LICHEN/zephyr/soc/brcm/bcm2712/Kconfig"
osource "/Volumes/Attic/Desktop/Projects/project-LICHEN/zephyr/soc/brcm/bcm2711/Kconfig"
osource "/Volumes/Attic/Desktop/Projects/project-LICHEN/zephyr/soc/atmel/sam0/Kconfig"
osource "/Volumes/Attic/Desktop/Projects/project-LICHEN/zephyr/soc/atmel/sam/Kconfig"
osource "/Volumes/Attic/Desktop/Projects/project-LICHEN/zephyr/soc/aspeed/Kconfig"
osource "/Volumes/Attic/Desktop/Projects/project-LICHEN/zephyr/soc/arm/Kconfig"
osource "/Volumes/Attic/Desktop/Projects/project-LICHEN/zephyr/soc/arm/beetle/Kconfig"
osource "/Volumes/Attic/Desktop/Projects/project-LICHEN/zephyr/soc/andestech/Kconfig"
osource "/Volumes/Attic/Desktop/Projects/project-LICHEN/zephyr/soc/ambiq/Kconfig"
osource "/Volumes/Attic/Desktop/Projects/project-LICHEN/zephyr/soc/altr/zephyr_nios2f/Kconfig"
osource "/Volumes/Attic/Desktop/Projects/project-LICHEN/zephyr/soc/altr/qemu_nios2/Kconfig"
osource "/Volumes/Attic/Desktop/Projects/project-LICHEN/zephyr/soc/adi/max32/Kconfig"
```
