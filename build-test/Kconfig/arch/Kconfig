## lichen/apps/gateway/boards/qemu_x86.conf
```kconfig
# qemu_x86 gateway config - CoAP/local-client build without LoRa hardware.

# qemu_x86 has no LoRa devicetree node or lora0 alias. Keep this board in
# CoAP/local-client mode; hardware gateway boards provide real radio overlays.
CONFIG_LORA=n
CONFIG_LICHEN_LORA_L2=n
CONFIG_LICHEN_L2=n
```

## lichen/apps/gateway/boards/r1_neo_nrf52840.conf
```kconfig
# Muzi Works R1 Neo gateway config — nRF52840 + SX1262 + BLE

# The R1 Neo gateway exposes the local client interface over BLE NUS, not
# Zephyr's wired SLIP driver.
CONFIG_SLIP=n

CONFIG_LORA_SX126X=y

# BLE UART bridge (LICHEN gateway feature)
CONFIG_BT=y
CONFIG_BT_PERIPHERAL=y
CONFIG_BT_DEVICE_NAME="LICHEN"
CONFIG_BT_MAX_CONN=1
CONFIG_BT_L2CAP_TX_MTU=247
CONFIG_BT_BUF_ACL_TX_SIZE=251
CONFIG_BT_BUF_ACL_RX_SIZE=251
CONFIG_LORA_LICHEN_BLE=y
CONFIG_LORA_LICHEN_BLE_LEGACY_NUS=y

# Native USB is available for console and future wired local-client bring-up.
CONFIG_USB_DEVICE_VID=0x239A
CONFIG_USB_DEVICE_PID=0x0102
CONFIG_USB_DEVICE_PRODUCT="LICHEN R1 Neo Gateway"
CONFIG_USB_DEVICE_MANUFACTURER="LICHEN"

# Board capability boundary for app-facing hardware decisions.
CONFIG_LICHEN_HAL=y
CONFIG_LICHEN_BOARD_NAME="Muzi Works R1 Neo"
CONFIG_LICHEN_HAS_LORA=y
CONFIG_LICHEN_RADIO_MODEL_SX126X=y
CONFIG_LICHEN_HAS_BLE_LOCAL=y
CONFIG_LICHEN_HAS_SERIAL_LOCAL=n
CONFIG_LICHEN_HAS_BUTTONS=y
CONFIG_LICHEN_HAS_LEDS=y
CONFIG_LICHEN_UI_PROFILE_TRACKER=y

# Hardware present but intentionally disabled until validated or modeled.
CONFIG_LICHEN_HAS_DISPLAY=n
CONFIG_LICHEN_HAS_GNSS=n
CONFIG_SENSOR=y
CONFIG_LICHEN_HAS_BATTERY=y
CONFIG_LICHEN_HAS_PMIC=n
CONFIG_LICHEN_HAS_EXTERNAL_FLASH=n
```

## lichen/apps/gateway/boards/t1000_e_nrf52840.conf
```kconfig
# Seeed T1000-E gateway config — nRF52840 + LR1110

CONFIG_LORA_LR1110=y

CONFIG_SERIAL=y
CONFIG_UART_INTERRUPT_DRIVEN=y
CONFIG_GNSS=y
CONFIG_GNSS_AG3335=y
```

## lichen/apps/gateway/boards/t_deck_esp32s3_procpu.conf
```kconfig
# SPDX-License-Identifier: GPL-3.0-or-later
# SPDX-FileCopyrightText: The contributors to the LICHEN project
#
# LilyGO T-Deck gateway config — ESP32-S3 + SX1262 + WiFi backhaul (border router mode)
# Consolidated merge resolution from workers 17/19/20/21/23/24 (project-LICHEN-verh, project-LICHEN-ewpt, project-LICHEN-pv6m), worktree-worker18 (project-LICHEN-g7g6), Heltec V3 (project-LICHEN-9ppq/idjc/m48r/jne8/spkj/rh9u/wkov/3hib).
# Includes LICHEN HAL, hardware disabled pending validation (BLE/serial/display/GNSS/battery/PMIC/flash=n per worker23 beads), no-SLIP USB CDC for LCI,
# bench CRC32 MIC + dev provisioning for T-Echo/T1000-E interop, TC_TX thread to prevent deadlock, tuned stacks (12288/8192/8192),
# bench RX1=100ms/TX=2dBm/timeout=1000ms, NVS epoch persist, WiFi 6LBR+RPL root+prefix+buffer/heap tuning.
# SSID/PSK/insecure-MIC bench-only. Update for production. Matches test/vectors/ and puck apps.
CONFIG_LORA_SX126X=y
CONFIG_LICHEN_HAL=y
CONFIG_LICHEN_BOARD_NAME="LilyGO T-Deck"
CONFIG_LICHEN_HAS_LORA=y
CONFIG_LICHEN_RADIO_MODEL_SX126X=y
CONFIG_WIFI_NM=y
CONFIG_ESP_WIFI_ENABLED=y

# Hardware intentionally disabled pending validation (per worker23 beads).
CONFIG_LICHEN_HAS_BLE_LOCAL=n
CONFIG_LICHEN_HAS_SERIAL_LOCAL=n
CONFIG_LICHEN_HAS_DISPLAY=n
CONFIG_LICHEN_HAS_GNSS=n
CONFIG_LICHEN_HAS_BATTERY=n
CONFIG_LICHEN_HAS_PMIC=n
CONFIG_LICHEN_HAS_EXTERNAL_FLASH=n

# No SLIP (uses USB CDC for LCI/console; avoids UART_PIPE chosen-node dependency).
CONFIG_SLIP=n

# Bench-only insecure link (CRC32 MIC fallback). Enables TX without full key exchange.
# Peers: bench pucks (T-Echo, T1000-E). Replace with proper keys for production.
CONFIG_LICHEN_LINK_INSECURE_CRC32_MIC=y
CONFIG_LICHEN_L2_DEV_PROVISIONING=y
CONFIG_LICHEN_L2_DEV_PEER_EUI64="7a7ff09dc86c2c10,8a1a2c4b93812cab"

# Dedicated TC thread prevents workqueue deadlock on TX (lora_send + SX126x TX-done).
CONFIG_NET_TC_TX_COUNT=1

# Stack sizes prevent overflows on Xtensa (Ed25519/SCHC in L2 RX, net paths).
# Per heltec-9ppq + t-deck fixes from multiple workers.
CONFIG_LICHEN_LORA_L2_RX_STACK_SIZE=12288
CONFIG_NET_RX_STACK_SIZE=8192
CONFIG_NET_TX_STACK_SIZE=12288
CONFIG_MAIN_STACK_SIZE=8192
CONFIG_LICHEN_LORA_L2_RX_TIMEOUT_MS=1000
CONFIG_LICHEN_LORA_TX_POWER=2
CONFIG_LICHEN_GATEWAY_RX1_DELAY_MS=100
CONFIG_FLASH=y
CONFIG_FLASH_MAP=y
CONFIG_NVS=y
CONFIG_SETTINGS=y
CONFIG_SETTINGS_NVS=y
CONFIG_LICHEN_LINK_EPOCH_PERSIST=y
CONFIG_LORA_LICHEN_GATEWAY_RPL_ROOT=y
CONFIG_LICHEN_GATEWAY_PREFIX_DELEGATION=y
CONFIG_LICHEN_GATEWAY_WIFI_SSID="lichen-test"
CONFIG_LICHEN_GATEWAY_WIFI_PSK="lichen123"
CONFIG_WIFI=y
CONFIG_NET_L2_ETHERNET=y
CONFIG_NET_L2_WIFI_MGMT=y
CONFIG_NET_IF_MAX_IPV6_COUNT=3
CONFIG_NET_IPV6_ND=y
CONFIG_NET_CONFIG_NEED_IPV6_ROUTER=y
CONFIG_NET_MAX_ROUTERS=4
CONFIG_NET_IPV6_NBR_CACHE=16
CONFIG_NET_BUF_RX_COUNT=20
CONFIG_ESP_WIFI_STATIC_RX_BUFFER_NUM=8
CONFIG_ESP_WIFI_DYNAMIC_RX_BUFFER_NUM=32
CONFIG_ESP_WIFI_STATIC_TX_BUFFER_NUM=8
CONFIG_HEAP_MEM_POOL_SIZE=131072
```
