## firmware/bridge-zephyr/build/Kconfig/soc/Kconfig.sysbuild
```kconfig
# Load SoC sysbuild Kconfig descriptions.
osource "/Volumes/Attic/Desktop/Projects/project-LICHEN/zephyr/soc/xlnx/zynqmp/Kconfig.sysbuild"
osource "/Volumes/Attic/Desktop/Projects/project-LICHEN/zephyr/soc/xlnx/zynq7000/Kconfig.sysbuild"
osource "/Volumes/Attic/Desktop/Projects/project-LICHEN/zephyr/soc/xen/Kconfig.sysbuild"
osource "/Volumes/Attic/Desktop/Projects/project-LICHEN/zephyr/soc/ti/simplelink/Kconfig.sysbuild"
osource "/Volumes/Attic/Desktop/Projects/project-LICHEN/zephyr/soc/ti/lm3s6965/Kconfig.sysbuild"
osource "/Volumes/Attic/Desktop/Projects/project-LICHEN/zephyr/soc/ti/k3/Kconfig.sysbuild"
osource "/Volumes/Attic/Desktop/Projects/project-LICHEN/zephyr/soc/telink/tlsr/Kconfig.sysbuild"
osource "/Volumes/Attic/Desktop/Projects/project-LICHEN/zephyr/soc/starfive/jh71xx/Kconfig.sysbuild"
osource "/Volumes/Attic/Desktop/Projects/project-LICHEN/zephyr/soc/st/stm32/Kconfig.sysbuild"
osource "/Volumes/Attic/Desktop/Projects/project-LICHEN/zephyr/soc/snps/qemu_arc/Kconfig.sysbuild"
osource "/Volumes/Attic/Desktop/Projects/project-LICHEN/zephyr/soc/snps/nsim/arc_v/Kconfig.sysbuild"
osource "/Volumes/Attic/Desktop/Projects/project-LICHEN/zephyr/soc/snps/nsim/arc_classic/Kconfig.sysbuild"
osource "/Volumes/Attic/Desktop/Projects/project-LICHEN/zephyr/soc/snps/hsdk4xd/Kconfig.sysbuild"
osource "/Volumes/Attic/Desktop/Projects/project-LICHEN/zephyr/soc/snps/hsdk/Kconfig.sysbuild"
osource "/Volumes/Attic/Desktop/Projects/project-LICHEN/zephyr/soc/snps/emsk/Kconfig.sysbuild"
osource "/Volumes/Attic/Desktop/Projects/project-LICHEN/zephyr/soc/snps/emsdp/Kconfig.sysbuild"
osource "/Volumes/Attic/Desktop/Projects/project-LICHEN/zephyr/soc/snps/arc_iot/Kconfig.sysbuild"
osource "/Volumes/Attic/Desktop/Projects/project-LICHEN/zephyr/soc/silabs/Kconfig.sysbuild"
osource "/Volumes/Attic/Desktop/Projects/project-LICHEN/zephyr/soc/sifive/sifive_freedom/Kconfig.sysbuild"
osource "/Volumes/Attic/Desktop/Projects/project-LICHEN/zephyr/soc/rockchip/Kconfig.sysbuild"
osource "/Volumes/Attic/Desktop/Projects/project-LICHEN/zephyr/soc/renode/riscv_virtual/Kconfig.sysbuild"
osource "/Volumes/Attic/Desktop/Projects/project-LICHEN/zephyr/soc/renesas/smartbond/Kconfig.sysbuild"
osource "/Volumes/Attic/Desktop/Projects/project-LICHEN/zephyr/soc/renesas/rzt2m/Kconfig.sysbuild"
osource "/Volumes/Attic/Desktop/Projects/project-LICHEN/zephyr/soc/renesas/rcar/Kconfig.sysbuild"
osource "/Volumes/Attic/Desktop/Projects/project-LICHEN/zephyr/soc/renesas/ra/Kconfig.sysbuild"
osource "/Volumes/Attic/Desktop/Projects/project-LICHEN/zephyr/soc/raspberrypi/Kconfig.sysbuild"
osource "/Volumes/Attic/Desktop/Projects/project-LICHEN/zephyr/soc/quicklogic/eos_s3/Kconfig.sysbuild"
osource "/Volumes/Attic/Desktop/Projects/project-LICHEN/zephyr/soc/qemu/virt_riscv/Kconfig.sysbuild"
osource "/Volumes/Attic/Desktop/Projects/project-LICHEN/zephyr/soc/qemu/malta/Kconfig.sysbuild"
osource "/Volumes/Attic/Desktop/Projects/project-LICHEN/zephyr/soc/openisa/rv32m1/Kconfig.sysbuild"
osource "/Volumes/Attic/Desktop/Projects/project-LICHEN/zephyr/soc/nxp/s32/Kconfig.sysbuild"
osource "/Volumes/Attic/Desktop/Projects/project-LICHEN/zephyr/soc/nxp/rw/Kconfig.sysbuild"
osource "/Volumes/Attic/Desktop/Projects/project-LICHEN/zephyr/soc/nxp/mcx/Kconfig.sysbuild"
osource "/Volumes/Attic/Desktop/Projects/project-LICHEN/zephyr/soc/nxp/lpc/Kconfig.sysbuild"
osource "/Volumes/Attic/Desktop/Projects/project-LICHEN/zephyr/soc/nxp/layerscape/Kconfig.sysbuild"
osource "/Volumes/Attic/Desktop/Projects/project-LICHEN/zephyr/soc/nxp/kinetis/Kconfig.sysbuild"
osource "/Volumes/Attic/Desktop/Projects/project-LICHEN/zephyr/soc/nxp/imxrt/Kconfig.sysbuild"
osource "/Volumes/Attic/Desktop/Projects/project-LICHEN/zephyr/soc/nxp/imx/Kconfig.sysbuild"
osource "/Volumes/Attic/Desktop/Projects/project-LICHEN/zephyr/soc/nuvoton/numicro/Kconfig.sysbuild"
osource "/Volumes/Attic/Desktop/Projects/project-LICHEN/zephyr/soc/nuvoton/numaker/Kconfig.sysbuild"
osource "/Volumes/Attic/Desktop/Projects/project-LICHEN/zephyr/soc/nuvoton/npcx/Kconfig.sysbuild"
osource "/Volumes/Attic/Desktop/Projects/project-LICHEN/zephyr/soc/nordic/Kconfig.sysbuild"
osource "/Volumes/Attic/Desktop/Projects/project-LICHEN/zephyr/soc/neorv32/Kconfig.sysbuild"
osource "/Volumes/Attic/Desktop/Projects/project-LICHEN/zephyr/soc/native/inf_clock/Kconfig.sysbuild"
osource "/Volumes/Attic/Desktop/Projects/project-LICHEN/zephyr/soc/microchip/miv/Kconfig.sysbuild"
osource "/Volumes/Attic/Desktop/Projects/project-LICHEN/zephyr/soc/microchip/mec/Kconfig.sysbuild"
osource "/Volumes/Attic/Desktop/Projects/project-LICHEN/zephyr/soc/mediatek/mtk_adsp/Kconfig.sysbuild"
osource "/Volumes/Attic/Desktop/Projects/project-LICHEN/zephyr/soc/lowrisc/opentitan/Kconfig.sysbuild"
osource "/Volumes/Attic/Desktop/Projects/project-LICHEN/zephyr/soc/litex/litex_vexriscv/Kconfig.sysbuild"
osource "/Volumes/Attic/Desktop/Projects/project-LICHEN/zephyr/soc/ite/ec/Kconfig.sysbuild"
osource "/Volumes/Attic/Desktop/Projects/project-LICHEN/zephyr/soc/intel/raptor_lake/Kconfig.sysbuild"
osource "/Volumes/Attic/Desktop/Projects/project-LICHEN/zephyr/soc/intel/lakemont/Kconfig.sysbuild"
osource "/Volumes/Attic/Desktop/Projects/project-LICHEN/zephyr/soc/intel/intel_socfpga_std/Kconfig.sysbuild"
osource "/Volumes/Attic/Desktop/Projects/project-LICHEN/zephyr/soc/intel/intel_socfpga/Kconfig.sysbuild"
osource "/Volumes/Attic/Desktop/Projects/project-LICHEN/zephyr/soc/intel/intel_niosv/Kconfig.sysbuild"
osource "/Volumes/Attic/Desktop/Projects/project-LICHEN/zephyr/soc/intel/intel_ish/Kconfig.sysbuild"
osource "/Volumes/Attic/Desktop/Projects/project-LICHEN/zephyr/soc/intel/intel_adsp/Kconfig.sysbuild"
osource "/Volumes/Attic/Desktop/Projects/project-LICHEN/zephyr/soc/intel/elkhart_lake/Kconfig.sysbuild"
osource "/Volumes/Attic/Desktop/Projects/project-LICHEN/zephyr/soc/intel/atom/Kconfig.sysbuild"
osource "/Volumes/Attic/Desktop/Projects/project-LICHEN/zephyr/soc/intel/apollo_lake/Kconfig.sysbuild"
osource "/Volumes/Attic/Desktop/Projects/project-LICHEN/zephyr/soc/intel/alder_lake/Kconfig.sysbuild"
osource "/Volumes/Attic/Desktop/Projects/project-LICHEN/zephyr/soc/infineon/cat3/Kconfig.sysbuild"
osource "/Volumes/Attic/Desktop/Projects/project-LICHEN/zephyr/soc/infineon/cat1b/Kconfig.sysbuild"
osource "/Volumes/Attic/Desktop/Projects/project-LICHEN/zephyr/soc/infineon/cat1a/Kconfig.sysbuild"
osource "/Volumes/Attic/Desktop/Projects/project-LICHEN/zephyr/soc/gd/gd32/Kconfig.sysbuild"
osource "/Volumes/Attic/Desktop/Projects/project-LICHEN/zephyr/soc/gaisler/leon3/Kconfig.sysbuild"
osource "/Volumes/Attic/Desktop/Projects/project-LICHEN/zephyr/soc/gaisler/gr716a/Kconfig.sysbuild"
osource "/Volumes/Attic/Desktop/Projects/project-LICHEN/zephyr/soc/espressif/Kconfig.sysbuild"
osource "/Volumes/Attic/Desktop/Projects/project-LICHEN/zephyr/soc/ene/kb1200/Kconfig.sysbuild"
osource "/Volumes/Attic/Desktop/Projects/project-LICHEN/zephyr/soc/efinix/sapphire/Kconfig.sysbuild"
osource "/Volumes/Attic/Desktop/Projects/project-LICHEN/zephyr/soc/cdns/xtensa_sample_controller/Kconfig.sysbuild"
osource "/Volumes/Attic/Desktop/Projects/project-LICHEN/zephyr/soc/cdns/dc233c/Kconfig.sysbuild"
osource "/Volumes/Attic/Desktop/Projects/project-LICHEN/zephyr/soc/brcm/bcmvk/Kconfig.sysbuild"
osource "/Volumes/Attic/Desktop/Projects/project-LICHEN/zephyr/soc/brcm/bcm2712/Kconfig.sysbuild"
osource "/Volumes/Attic/Desktop/Projects/project-LICHEN/zephyr/soc/brcm/bcm2711/Kconfig.sysbuild"
osource "/Volumes/Attic/Desktop/Projects/project-LICHEN/zephyr/soc/atmel/sam0/Kconfig.sysbuild"
osource "/Volumes/Attic/Desktop/Projects/project-LICHEN/zephyr/soc/atmel/sam/Kconfig.sysbuild"
osource "/Volumes/Attic/Desktop/Projects/project-LICHEN/zephyr/soc/aspeed/Kconfig.sysbuild"
osource "/Volumes/Attic/Desktop/Projects/project-LICHEN/zephyr/soc/arm/Kconfig.sysbuild"
osource "/Volumes/Attic/Desktop/Projects/project-LICHEN/zephyr/soc/arm/beetle/Kconfig.sysbuild"
osource "/Volumes/Attic/Desktop/Projects/project-LICHEN/zephyr/soc/andestech/Kconfig.sysbuild"
osource "/Volumes/Attic/Desktop/Projects/project-LICHEN/zephyr/soc/ambiq/Kconfig.sysbuild"
osource "/Volumes/Attic/Desktop/Projects/project-LICHEN/zephyr/soc/altr/zephyr_nios2f/Kconfig.sysbuild"
osource "/Volumes/Attic/Desktop/Projects/project-LICHEN/zephyr/soc/altr/qemu_nios2/Kconfig.sysbuild"
osource "/Volumes/Attic/Desktop/Projects/project-LICHEN/zephyr/soc/adi/max32/Kconfig.sysbuild"
```

## firmware/bridge-zephyr/subsys/lichen/Kconfig
```kconfig
# SPDX-License-Identifier: GPL-3.0-or-later
# SPDX-FileCopyrightText: The contributors to the LICHEN project

# LICHEN L2 network integration options
# These extend the base LICHEN Kconfig from lichen/subsys/lichen/Kconfig
# with Zephyr network stack integration.

menuconfig LICHEN
	bool "LICHEN mesh networking stack"
	help
	  Enable the LICHEN IPv6 mesh networking stack over LoRa.

if LICHEN

config LICHEN_TIME_BUILD_EPOCH_UNIX
	int "Deterministic firmware build epoch floor"
	default 1700000000
	range 1 2147483647
	help
	  Deterministic Unix timestamp used as the minimum plausible wall-clock
	  value. Production builds must set this from reproducible build
	  metadata, preferably SOURCE_DATE_EPOCH, or an explicit release epoch.

choice LICHEN_TIME_BUILD_EPOCH_SOURCE
	prompt "Firmware build epoch metadata source"
	default LICHEN_TIME_BUILD_EPOCH_SOURCE_FIXED
	help
	  Records where CONFIG_LICHEN_TIME_BUILD_EPOCH_UNIX came from.

config LICHEN_TIME_BUILD_EPOCH_SOURCE_FIXED
	bool "Fixed Kconfig default or test override"

config LICHEN_TIME_BUILD_EPOCH_SOURCE_DATE_EPOCH
	bool "SOURCE_DATE_EPOCH"

config LICHEN_TIME_BUILD_EPOCH_SOURCE_RELEASE
	bool "Explicit release epoch"

config LICHEN_TIME_BUILD_EPOCH_SOURCE_DEVELOPER_GENERATED
	bool "Explicit developer generated timestamp"

config LICHEN_TIME_BUILD_EPOCH_SOURCE_DEVELOPER_FIXED
	bool "Explicit developer fixed timestamp"

endchoice

config LICHEN_LORA_L2
	bool "LICHEN LoRa L2 driver"
	depends on LORA
	depends on NETWORKING
	depends on NET_IPV6
	depends on LICHEN_IPV6
	select LICHEN_LINK
	select HWINFO
	select TINYCRYPT
	select TINYCRYPT_AES
	select TINYCRYPT_AES_CCM
	default y
	help
	  Enable the LICHEN LoRa L2 driver. This provides low-level LoRa
	  radio access including TX/RX threads and EUI-64 generation.
	  It is only supported through the full LICHEN_L2 Zephyr network
	  interface path; standalone LoRa mode is disabled because it could
	  receive frames without parsing, SCHC decompression, or IPv6 ingress.

config LICHEN_LORA_L2_LOG_LEVEL
	int "LICHEN LoRa L2 log level"
	depends on LICHEN_LORA_L2
	default 3
	range 0 4
	help
	  Log level for LICHEN LoRa L2 driver.
	  0 = Off, 1 = Error, 2 = Warning, 3 = Info, 4 = Debug

config LICHEN_LORA_L2_RX_STACK_SIZE
	int "LICHEN LoRa L2 RX thread stack size"
	depends on LICHEN_LORA_L2
	default 2048
	help
	  Stack size for the LoRa L2 RX thread.

config LICHEN_LORA_L2_RX_PRIORITY
	int "LICHEN LoRa L2 RX thread priority"
	depends on LICHEN_LORA_L2
	default 7
	help
	  Priority for the LoRa L2 RX thread. Lower numbers = higher priority.

config LICHEN_LORA_L2_RX_TIMEOUT_MS
	int "LoRa RX timeout in milliseconds"
	depends on LICHEN_LORA_L2
	default 1000
	range 100 10000
	help
	  Timeout for lora_recv() calls in the RX thread. This affects:
	  - How often the thread checks the running flag (lower = more responsive stop)
	  - Stop latency (worst case: 100ms + this timeout before thread joins)
	  - CPU overhead (lower = more loop iterations, but overhead is minimal)

	  Lower values (500-1000ms) provide faster stop() responsiveness.
	  Higher values (3000-5000ms) may save power on some platforms by
	  reducing wakeup frequency, but slow down disable/enable cycles.

	  Default 1000ms balances responsiveness with low overhead.

config LICHEN_LORA_FREQUENCY
	int "LoRa frequency in Hz"
	depends on LICHEN_LORA_L2
	default 915000000
	range 150000000 960000000
	help
	  LoRa carrier frequency in Hz. Must comply with regional regulations.
	  Common ISM bands: 915000000 (US), 868000000 (EU), 433000000 (Asia).
	  Range: 150-960 MHz covers all LoRa-capable frequency bands.

config LICHEN_LORA_TX_POWER
	int "LoRa TX power in dBm"
	depends on LICHEN_LORA_L2
	default 14
	range 0 22
	help
	  LoRa transmit power in dBm. Default 14 dBm is safe worldwide.
	  Higher values may violate regional regulations. Maximum 22 dBm.

config LICHEN_L2
	bool "LICHEN Zephyr L2 network interface"
	depends on LICHEN_LORA_L2
	depends on LICHEN_LINK
	depends on NETWORKING
	depends on NET_IPV6
	depends on LICHEN_IPV6
	default y if NET_IPV6
	help
	  Register LICHEN as a Zephyr L2 network interface so the IPv6
	  stack routes packets through it. This implements the net_l2
	  callbacks (recv, send, enable, flags) and bridges IPv6 packets
	  to the LoRa radio via SCHC compression and LICHEN framing.

	  When enabled, this creates a network device called "LICHEN" that
	  appears as a standard Zephyr network interface, allowing IPv6
	  applications to send/receive packets over LoRa transparently.

config LICHEN_L2_LOG_LEVEL
	int "LICHEN L2 log level"
	depends on LICHEN_L2
	default 3
	range 0 4
	help
	  Log level for LICHEN Zephyr L2 interface.
	  0 = Off, 1 = Error, 2 = Warning, 3 = Info, 4 = Debug

config LICHEN_UTIL_LOG_LEVEL
	int "LICHEN util log level"
	depends on LICHEN
	default 1
	range 0 4
	help
	  Log level for LICHEN utility functions (SHA-256, etc.).
	  0 = Off, 1 = Error, 2 = Warning, 3 = Info, 4 = Debug

config LICHEN_L2_RX_ALLOC_TIMEOUT_MS
	int "RX packet allocation timeout (ms)"
	depends on LICHEN_L2
	default 50
	range 0 1000
	help
	  Timeout in milliseconds for net_pkt_rx_alloc_with_buffer().
	  Controls how long the RX path waits for a network buffer.

	  Tradeoffs:
	  - Lower values (0-10ms): Faster failure under memory pressure,
	    but may drop packets that could have succeeded with a brief wait.
	  - Higher values (50-100ms): Better allocation success rate,
	    but may stall RX processing and cause radio buffer overruns.

	  For LoRa's low data rate (~300 bps at SF10), 50ms is reasonable:
	  a full 255-byte frame takes ~6.8 seconds to transmit, so brief
	  allocation delays don't cause radio-level issues. However, if your
	  application has tighter real-time constraints, reduce this value.

	  If you see "Failed to allocate RX packet" log messages, consider
	  increasing this value or adding more NET_BUF_RX buffers.

	  Set to 0 for immediate failure (K_NO_WAIT).

config LICHEN_IPV6
	bool "LICHEN IPv6 address utilities"
	default y
	help
	  Enable LICHEN IPv6 address utilities. This handles:
	  - Link-local address derivation from EUI-64
	  - ULA address construction
	  - GUA address construction
	  These are standalone utilities that work with or without
	  Zephyr's full networking stack.

config LICHEN_IPV6_ULA_PREFIX
	string "Default ULA prefix"
	depends on LICHEN_IPV6
	default "fd00:lich:en00::"
	help
	  Default ULA prefix used when no DODAG root provides one.
	  Format: fd00:xxxx:xxxx:: (must be in fd00::/8)

	  Note: Kconfig cannot validate string format at compile time.
	  Runtime validation in lichen_make_ula() enforces the fd00::/8
	  requirement and returns -EINVAL for invalid prefixes.

endif # LICHEN
```

## lichen/apps/gateway/boards/nucleo_wl55jc.conf
```kconfig
# nucleo_wl55jc board config — hardware-specific overrides

# STM32WL55 integrated SubGHz radio (not external SX12XX)
# ponytail: LORA_SX12XX is for external SPI chips like RAK4631
# The STM32WL uses LORA_STM32WL_SUBGHZ_RADIO via devicetree
CONFIG_LORA_STM32WL_SUBGHZ_RADIO=y
CONFIG_LICHEN_HAS_LORA=y

# SLIP bridge over UART to upstream host
CONFIG_SLIP=y
CONFIG_SLIP_TAP=y
CONFIG_NET_SLIP_TAP=y
CONFIG_LICHEN_HAS_SERIAL_LOCAL=y
```
