## build-test/Kconfig/arch/Kconfig
```kconfig
# Load arch Kconfig descriptions.
osource "/mnt/lichen-zephyr/work/zephyr/arch/x86/Kconfig"
osource "/mnt/lichen-zephyr/work/zephyr/arch/xtensa/Kconfig"
osource "/mnt/lichen-zephyr/work/zephyr/arch/sparc/Kconfig"
osource "/mnt/lichen-zephyr/work/zephyr/arch/riscv/Kconfig"
osource "/mnt/lichen-zephyr/work/zephyr/arch/posix/Kconfig"
osource "/mnt/lichen-zephyr/work/zephyr/arch/nios2/Kconfig"
osource "/mnt/lichen-zephyr/work/zephyr/arch/mips/Kconfig"
osource "/mnt/lichen-zephyr/work/zephyr/arch/arm64/Kconfig"
osource "/mnt/lichen-zephyr/work/zephyr/arch/arm/Kconfig"
osource "/mnt/lichen-zephyr/work/zephyr/arch/arc/Kconfig"
```

## build-test/Kconfig/soc/Kconfig.soc
```kconfig
# Load SoC Kconfig descriptions.
osource "/mnt/lichen-zephyr/work/zephyr/soc/xlnx/zynqmp/Kconfig.soc"
osource "/mnt/lichen-zephyr/work/zephyr/soc/xlnx/zynq7000/Kconfig.soc"
osource "/mnt/lichen-zephyr/work/zephyr/soc/xen/Kconfig.soc"
osource "/mnt/lichen-zephyr/work/zephyr/soc/ti/simplelink/Kconfig.soc"
osource "/mnt/lichen-zephyr/work/zephyr/soc/ti/lm3s6965/Kconfig.soc"
osource "/mnt/lichen-zephyr/work/zephyr/soc/ti/k3/Kconfig.soc"
osource "/mnt/lichen-zephyr/work/zephyr/soc/telink/tlsr/Kconfig.soc"
osource "/mnt/lichen-zephyr/work/zephyr/soc/starfive/jh71xx/Kconfig.soc"
osource "/mnt/lichen-zephyr/work/zephyr/soc/st/stm32/Kconfig.soc"
osource "/mnt/lichen-zephyr/work/zephyr/soc/snps/qemu_arc/Kconfig.soc"
osource "/mnt/lichen-zephyr/work/zephyr/soc/snps/nsim/arc_v/Kconfig.soc"
osource "/mnt/lichen-zephyr/work/zephyr/soc/snps/nsim/arc_classic/Kconfig.soc"
osource "/mnt/lichen-zephyr/work/zephyr/soc/snps/hsdk4xd/Kconfig.soc"
osource "/mnt/lichen-zephyr/work/zephyr/soc/snps/hsdk/Kconfig.soc"
osource "/mnt/lichen-zephyr/work/zephyr/soc/snps/emsk/Kconfig.soc"
osource "/mnt/lichen-zephyr/work/zephyr/soc/snps/emsdp/Kconfig.soc"
osource "/mnt/lichen-zephyr/work/zephyr/soc/snps/arc_iot/Kconfig.soc"
osource "/mnt/lichen-zephyr/work/zephyr/soc/silabs/Kconfig.soc"
osource "/mnt/lichen-zephyr/work/zephyr/soc/sifive/sifive_freedom/Kconfig.soc"
osource "/mnt/lichen-zephyr/work/zephyr/soc/rockchip/Kconfig.soc"
osource "/mnt/lichen-zephyr/work/zephyr/soc/renode/riscv_virtual/Kconfig.soc"
osource "/mnt/lichen-zephyr/work/zephyr/soc/renesas/smartbond/Kconfig.soc"
osource "/mnt/lichen-zephyr/work/zephyr/soc/renesas/rzt2m/Kconfig.soc"
osource "/mnt/lichen-zephyr/work/zephyr/soc/renesas/rcar/Kconfig.soc"
osource "/mnt/lichen-zephyr/work/zephyr/soc/renesas/ra/Kconfig.soc"
osource "/mnt/lichen-zephyr/work/zephyr/soc/raspberrypi/Kconfig.soc"
osource "/mnt/lichen-zephyr/work/zephyr/soc/quicklogic/eos_s3/Kconfig.soc"
osource "/mnt/lichen-zephyr/work/zephyr/soc/qemu/virt_riscv/Kconfig.soc"
osource "/mnt/lichen-zephyr/work/zephyr/soc/qemu/malta/Kconfig.soc"
osource "/mnt/lichen-zephyr/work/zephyr/soc/openisa/rv32m1/Kconfig.soc"
osource "/mnt/lichen-zephyr/work/zephyr/soc/nxp/s32/Kconfig.soc"
osource "/mnt/lichen-zephyr/work/zephyr/soc/nxp/rw/Kconfig.soc"
osource "/mnt/lichen-zephyr/work/zephyr/soc/nxp/mcx/Kconfig.soc"
osource "/mnt/lichen-zephyr/work/zephyr/soc/nxp/lpc/Kconfig.soc"
osource "/mnt/lichen-zephyr/work/zephyr/soc/nxp/layerscape/Kconfig.soc"
osource "/mnt/lichen-zephyr/work/zephyr/soc/nxp/kinetis/Kconfig.soc"
osource "/mnt/lichen-zephyr/work/zephyr/soc/nxp/imxrt/Kconfig.soc"
osource "/mnt/lichen-zephyr/work/zephyr/soc/nxp/imx/Kconfig.soc"
osource "/mnt/lichen-zephyr/work/zephyr/soc/nuvoton/numicro/Kconfig.soc"
osource "/mnt/lichen-zephyr/work/zephyr/soc/nuvoton/numaker/Kconfig.soc"
osource "/mnt/lichen-zephyr/work/zephyr/soc/nuvoton/npcx/Kconfig.soc"
osource "/mnt/lichen-zephyr/work/zephyr/soc/nordic/Kconfig.soc"
osource "/mnt/lichen-zephyr/work/zephyr/soc/neorv32/Kconfig.soc"
osource "/mnt/lichen-zephyr/work/zephyr/soc/native/inf_clock/Kconfig.soc"
osource "/mnt/lichen-zephyr/work/zephyr/soc/microchip/miv/Kconfig.soc"
osource "/mnt/lichen-zephyr/work/zephyr/soc/microchip/mec/Kconfig.soc"
osource "/mnt/lichen-zephyr/work/zephyr/soc/mediatek/mtk_adsp/Kconfig.soc"
osource "/mnt/lichen-zephyr/work/zephyr/soc/lowrisc/opentitan/Kconfig.soc"
osource "/mnt/lichen-zephyr/work/zephyr/soc/litex/litex_vexriscv/Kconfig.soc"
osource "/mnt/lichen-zephyr/work/zephyr/soc/ite/ec/Kconfig.soc"
osource "/mnt/lichen-zephyr/work/zephyr/soc/intel/raptor_lake/Kconfig.soc"
osource "/mnt/lichen-zephyr/work/zephyr/soc/intel/lakemont/Kconfig.soc"
osource "/mnt/lichen-zephyr/work/zephyr/soc/intel/intel_socfpga_std/Kconfig.soc"
osource "/mnt/lichen-zephyr/work/zephyr/soc/intel/intel_socfpga/Kconfig.soc"
osource "/mnt/lichen-zephyr/work/zephyr/soc/intel/intel_niosv/Kconfig.soc"
osource "/mnt/lichen-zephyr/work/zephyr/soc/intel/intel_ish/Kconfig.soc"
osource "/mnt/lichen-zephyr/work/zephyr/soc/intel/intel_adsp/Kconfig.soc"
osource "/mnt/lichen-zephyr/work/zephyr/soc/intel/elkhart_lake/Kconfig.soc"
osource "/mnt/lichen-zephyr/work/zephyr/soc/intel/atom/Kconfig.soc"
osource "/mnt/lichen-zephyr/work/zephyr/soc/intel/apollo_lake/Kconfig.soc"
osource "/mnt/lichen-zephyr/work/zephyr/soc/intel/alder_lake/Kconfig.soc"
osource "/mnt/lichen-zephyr/work/zephyr/soc/infineon/cat3/Kconfig.soc"
osource "/mnt/lichen-zephyr/work/zephyr/soc/infineon/cat1b/Kconfig.soc"
osource "/mnt/lichen-zephyr/work/zephyr/soc/infineon/cat1a/Kconfig.soc"
osource "/mnt/lichen-zephyr/work/zephyr/soc/gd/gd32/Kconfig.soc"
osource "/mnt/lichen-zephyr/work/zephyr/soc/gaisler/leon3/Kconfig.soc"
osource "/mnt/lichen-zephyr/work/zephyr/soc/gaisler/gr716a/Kconfig.soc"
osource "/mnt/lichen-zephyr/work/zephyr/soc/espressif/Kconfig.soc"
osource "/mnt/lichen-zephyr/work/zephyr/soc/ene/kb1200/Kconfig.soc"
osource "/mnt/lichen-zephyr/work/zephyr/soc/efinix/sapphire/Kconfig.soc"
osource "/mnt/lichen-zephyr/work/zephyr/soc/cdns/xtensa_sample_controller/Kconfig.soc"
osource "/mnt/lichen-zephyr/work/zephyr/soc/cdns/dc233c/Kconfig.soc"
osource "/mnt/lichen-zephyr/work/zephyr/soc/brcm/bcmvk/Kconfig.soc"
osource "/mnt/lichen-zephyr/work/zephyr/soc/brcm/bcm2712/Kconfig.soc"
osource "/mnt/lichen-zephyr/work/zephyr/soc/brcm/bcm2711/Kconfig.soc"
osource "/mnt/lichen-zephyr/work/zephyr/soc/atmel/sam0/Kconfig.soc"
osource "/mnt/lichen-zephyr/work/zephyr/soc/atmel/sam/Kconfig.soc"
osource "/mnt/lichen-zephyr/work/zephyr/soc/aspeed/Kconfig.soc"
osource "/mnt/lichen-zephyr/work/zephyr/soc/arm/Kconfig.soc"
osource "/mnt/lichen-zephyr/work/zephyr/soc/arm/beetle/Kconfig.soc"
osource "/mnt/lichen-zephyr/work/zephyr/soc/andestech/Kconfig.soc"
osource "/mnt/lichen-zephyr/work/zephyr/soc/ambiq/Kconfig.soc"
osource "/mnt/lichen-zephyr/work/zephyr/soc/altr/zephyr_nios2f/Kconfig.soc"
osource "/mnt/lichen-zephyr/work/zephyr/soc/altr/qemu_nios2/Kconfig.soc"
osource "/mnt/lichen-zephyr/work/zephyr/soc/adi/max32/Kconfig.soc"
```

## build_heltec_gw/Kconfig/Kconfig.shield
```kconfig
osource "/mnt/lichen-zephyr/work/project-LICHEN-worker2/lichen/boards/shields/*/Kconfig.shield"
```

## firmware/bridge-zephyr/boards/lilygo_tbeam.conf
```kconfig
# LilyGo T-Beam v1.2 bridge fragment — RETIRED/FAIL (project-LICHEN-2u26.5)
#
# No canonical Zephyr board target exists for `lilygo_tbeam`. The name is not
# a valid west -b selector in Zephyr 3.7 or lichen/boards/. Pin mapping and
# wiring notes are retained for reference only.
#
# Classified FAIL (no canonical board) per project-LICHEN-2u26 and io1k
# audit. Removed from active support claims. T-Beam v1 class is partner-owned
# long tail (see firmware-board-capability-matrix.md).
#
# ESP32 uses UART0 for console (via CP2102/CH340 USB-serial chip)
# rather than native USB CDC like nRF52.

# Disable USB CDC (not applicable to ESP32)
CONFIG_USB_DEVICE_STACK=n
CONFIG_USB_CDC_ACM=n

# UART console
CONFIG_SERIAL=y
CONFIG_CONSOLE=y
CONFIG_UART_CONSOLE=y

# SPI for SX1262
CONFIG_LORA=y
CONFIG_SPI=y
```

## firmware/bridge-zephyr/boards/lilygo_tdeck.conf
```kconfig
# LilyGo T-Deck board-specific config
#
# ESP32-S3 uses UART0 for console.

# Disable USB CDC (use UART)
CONFIG_USB_DEVICE_STACK=n
CONFIG_USB_CDC_ACM=n

# UART console
CONFIG_SERIAL=y
CONFIG_CONSOLE=y
CONFIG_UART_CONSOLE=y

# SPI for SX1262
CONFIG_LORA=y
CONFIG_SPI=y
```

## firmware/bridge-zephyr/boards/rak19007_wisblock.conf
```kconfig
# STALE/RETIRED per project-LICHEN-2u26.6: duplicates RAK4631 core identity without distinct canonical carrier target. Fragment retired per 2u26.
# RAK19007 WisBlock Base Board (2nd Gen) + RAK4631 Core
#
# nRF52840 with native USB CDC-ACM

# USB CDC-ACM serial console
CONFIG_USB_DEVICE_STACK=y
CONFIG_USB_CDC_ACM=y
CONFIG_USB_DEVICE_INITIALIZE_AT_BOOT=y
CONFIG_UART_INTERRUPT_DRIVEN=y
CONFIG_USB_DEVICE_VID=0x239A
CONFIG_USB_DEVICE_PID=0x0029
CONFIG_USB_DEVICE_PRODUCT="LICHEN LoRa Bridge"
CONFIG_USB_DEVICE_MANUFACTURER="LICHEN"

# I2C for WisBlock sensor slots
CONFIG_I2C=y

# GPIO for slot IO pins and power control
CONFIG_GPIO=y

# Regulator for 3V3_S switchable power
CONFIG_REGULATOR=y

# LoRa radio on RAK4631 core
CONFIG_LORA=y
```

## firmware/bridge-zephyr/boards/rak4631_nrf52840.conf
```kconfig
# RAK4631 nRF52840 board-specific config
#
# nRF52840 supports native USB CDC-ACM.

# USB CDC-ACM serial
CONFIG_USB_DEVICE_STACK=y
CONFIG_USB_CDC_ACM=y
CONFIG_USB_DEVICE_INITIALIZE_AT_BOOT=y
CONFIG_UART_INTERRUPT_DRIVEN=y
# Zephyr forces this to LOG_LEVEL_NONE when CDC ACM is the console and UART
# logging is enabled; set it explicitly to avoid a compile-time warning.
CONFIG_USB_CDC_ACM_LOG_LEVEL_OFF=y
CONFIG_USB_DEVICE_VID=0x239A
CONFIG_USB_DEVICE_PID=0x0029
CONFIG_USB_DEVICE_PRODUCT="LICHEN LoRa Bridge"
CONFIG_USB_DEVICE_MANUFACTURER="LICHEN"

# LoRa radio on RAK4631 core
CONFIG_LORA=y
```

## firmware/bridge-zephyr/boards/seeed_wio_tracker_1110.conf
```kconfig
# Seeed Wio Tracker 1110 board-specific config
#
# nRF52840 with LR1110 (GNSS/WiFi + LoRa).
# Uses native USB CDC-ACM for console (via pogo pins).

# USB CDC-ACM serial
CONFIG_USB_DEVICE_STACK=y
CONFIG_USB_CDC_ACM=y
CONFIG_USB_DEVICE_INITIALIZE_AT_BOOT=y
CONFIG_UART_INTERRUPT_DRIVEN=y
CONFIG_USB_DEVICE_VID=0x239A
CONFIG_USB_DEVICE_PID=0x0029
CONFIG_USB_DEVICE_PRODUCT="LICHEN LoRa Bridge"
CONFIG_USB_DEVICE_MANUFACTURER="LICHEN"

# SPI for LR1110
CONFIG_LORA=y
CONFIG_SPI=y

# GPIO for LR1110 control pins and peripherals
CONFIG_GPIO=y
```

## firmware/bridge-zephyr/boards/station_g2.conf
```kconfig
# B&Q Consulting Station G2 board-specific config
#
# ESP32-S3 with SX1262 + PA/LNA for high-power LoRa

# USB CDC serial console
CONFIG_USB_DEVICE_STACK=y
CONFIG_SERIAL=y
CONFIG_CONSOLE=y
CONFIG_UART_CONSOLE=y

# SPI for SX1262
CONFIG_LORA=y
CONFIG_SPI=y

# GPIO for SX1262 control pins and button
CONFIG_GPIO=y
```

## firmware/bridge-zephyr/boards/t1000_e_nrf52840.conf
```kconfig
# Seeed T1000-E (t1000_e/nrf52840) bridge board fragment
#
# nRF52840 with LR1110. Matches canonical HWMv2 stem.
# USB CDC-ACM console + LR1110 on SPI2.

# USB CDC-ACM serial
CONFIG_USB_DEVICE_STACK=y
CONFIG_USB_CDC_ACM=y
CONFIG_USB_DEVICE_INITIALIZE_AT_BOOT=y
CONFIG_UART_INTERRUPT_DRIVEN=y
CONFIG_USB_DEVICE_VID=0x239A
CONFIG_USB_DEVICE_PID=0x0029
CONFIG_USB_DEVICE_PRODUCT="LICHEN LoRa Bridge"
CONFIG_USB_DEVICE_MANUFACTURER="LICHEN"

# SPI for LR1110 (board DTS provides SPI2 + lr1110 node)
CONFIG_LORA=y
CONFIG_LORA_LR1110=y
CONFIG_LICHEN_HAS_LORA=y
CONFIG_LICHEN_RADIO_MODEL_LR1110=y
CONFIG_SPI=y

# GPIO (provided by board)
CONFIG_GPIO=y
```

## firmware/bridge-zephyr/boards/t_deck_esp32s3_procpu.conf
```kconfig
# SPDX-License-Identifier: GPL-3.0-or-later
# SPDX-FileCopyrightText: The contributors to the LICHEN project
#
# LilyGO T-Deck bridge config — ESP32-S3 + SX1262 (minimal for firmware/bridge-zephyr target).
# Matches puck/gateway radio settings; extend with app-specific fragments as needed.
CONFIG_LORA=y
CONFIG_LORA_SX126X=y
CONFIG_LICHEN_HAS_LORA=y
CONFIG_LICHEN_RADIO_MODEL_SX126X=y
```

## firmware/bridge-zephyr/boards/t_echo_nrf52840.conf
```kconfig
# LilyGo T-Echo bridge config - nRF52840 + SX1262

CONFIG_LORA=y
CONFIG_LORA_SX126X=y
CONFIG_LICHEN_HAS_LORA=y
CONFIG_LICHEN_RADIO_MODEL_SX126X=y
```

## firmware/bridge-zephyr/boards/xiao_s3_wio_sx1262.conf
```kconfig
# SPDX-License-Identifier: GPL-3.0-or-later
# SPDX-FileCopyrightText: The contributors to the LICHEN project
#
# BLOCKED/RETIRED: Seeed XIAO ESP32-S3 + Wio-SX1262 (project-LICHEN-2u26.10)
# No canonical Zephyr board or composite shield mapping (seeed_xiao_esp32s3
# + custom Wio-SX1262 shield not defined). Classified FAIL in m5m1.8 bridge
# audit. Use heltec_wifi_lora32_v3/esp32s3/procpu proxy. Do not present
# as supported target. See firmware-board-capability-matrix.md.
#
# ESP32-S3 with native USB CDC for console (retained for reference).
#
# USB CDC serial console
CONFIG_USB_DEVICE_STACK=y
CONFIG_SERIAL=y
CONFIG_CONSOLE=y
CONFIG_UART_CONSOLE=y

# SPI for SX1262
CONFIG_LORA=y
CONFIG_SPI=y

# GPIO for SX1262 control pins and LED
CONFIG_GPIO=y
```
