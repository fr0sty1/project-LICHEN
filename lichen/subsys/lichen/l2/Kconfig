## lichen/tests/build_epoch/testcase.yaml
```yaml
# SPDX-License-Identifier: GPL-3.0-or-later
# SPDX-FileCopyrightText: The contributors to the LICHEN project

tests:
  lichen.build_epoch.source_date_epoch:
    tags:
      - lichen
      - hal
      - time
    platform_allow:
      - native_sim
      - native_sim/native/64
      - qemu_x86
    integration_platforms:
      - native_sim
      - native_sim/native/64
      - qemu_x86
    extra_args:
      - LICHEN_BUILD_EPOCH_TEST_CASE=source_date_epoch
  lichen.build_epoch.release:
    tags:
      - lichen
      - hal
      - time
    platform_allow:
      - native_sim
      - native_sim/native/64
      - qemu_x86
    integration_platforms:
      - native_sim
      - native_sim/native/64
      - qemu_x86
    extra_args:
      - LICHEN_BUILD_EPOCH_TEST_CASE=release
  lichen.build_epoch.developer_generated:
    tags:
      - lichen
      - hal
      - time
    platform_allow:
      - native_sim
      - native_sim/native/64
      - qemu_x86
    integration_platforms:
      - native_sim
      - native_sim/native/64
      - qemu_x86
    extra_args:
      - LICHEN_BUILD_EPOCH_TEST_CASE=developer_generated
  lichen.build_epoch.developer_fixed:
    tags:
      - lichen
      - hal
      - time
    platform_allow:
      - native_sim
      - native_sim/native/64
      - qemu_x86
    integration_platforms:
      - native_sim
      - native_sim/native/64
      - qemu_x86
    extra_args:
      - LICHEN_BUILD_EPOCH_TEST_CASE=developer_fixed
```

## lichen/tests/gateway_config/testcase.yaml
```yaml
# SPDX-License-Identifier: GPL-3.0-or-later
# SPDX-FileCopyrightText: The contributors to the LICHEN project

tests:
  net.lichen.gateway_config:
    tags:
      - net
      - lichen
      - gateway
      - cbor
    platform_allow:
      - native_sim
      - native_sim/native/64
      - qemu_x86
    integration_platforms:
      - native_sim
      - native_sim/native/64
      - qemu_x86
```

## lichen/tests/gateway_status/testcase.yaml
```yaml
# SPDX-License-Identifier: GPL-3.0-or-later
# SPDX-FileCopyrightText: The contributors to the LICHEN project

tests:
  net.lichen.gateway_status:
    tags:
      - net
      - lichen
      - gateway
      - status
      - cbor
    platform_allow:
      - qemu_x86
      - native_sim
      - native_sim/native/64
    integration_platforms:
      - qemu_x86
      - native_sim
      - native_sim/native/64
```

## lichen/tests/gnss_emul/testcase.yaml
```yaml
# SPDX-License-Identifier: GPL-3.0-or-later
# SPDX-FileCopyrightText: The contributors to the LICHEN project

tests:
  net.lichen.gnss_emul:
    tags:
      - net
      - lichen
      - gnss
      - simulation
    platform_allow:
      - native_sim
      - native_sim/native/64
      - qemu_x86
      - qemu_x86_64
    integration_platforms:
      - qemu_x86
    timeout: 30
```

## lichen/tests/hal/testcase.yaml
```yaml
# SPDX-License-Identifier: GPL-3.0-or-later
# SPDX-FileCopyrightText: The contributors to the LICHEN project

tests:
  lichen.hal.native_defaults:
    tags:
      - lichen
      - hal
    platform_allow:
      - native_sim
      - qemu_x86
    integration_platforms:
      - native_sim
      - qemu_x86
  lichen.hal.loopback_lora:
    tags:
      - lichen
      - hal
    platform_allow:
      - native_sim
    integration_platforms:
      - native_sim
    extra_args:
      - CONF_FILE=prj.conf;prj_lora_loopback.conf
      - DTC_OVERLAY_FILE=boards/native_sim_lora_loopback.overlay
  lichen.hal.absent_power_qemu:
    tags:
      - lichen
      - hal
      - power
    platform_allow:
      - qemu_x86
    integration_platforms:
      - qemu_x86
    extra_configs:
      - CONFIG_LICHEN_HAS_BATTERY=n
      - CONFIG_LICHEN_HAS_PMIC=n
  lichen.hal.battery_adc:
    tags:
      - lichen
      - hal
      - power
      - battery
    platform_allow:
      - native_sim
      - qemu_x86
    integration_platforms:
      - native_sim
      - qemu_x86
    extra_args:
      - DTC_OVERLAY_FILE=boards/native_sim_battery_adc.overlay
    extra_configs:
      - CONFIG_ADC=y
      - CONFIG_ADC_EMUL=y
      - CONFIG_SENSOR=y
      - CONFIG_LICHEN_HAS_BATTERY=y
      - CONFIG_LICHEN_HAS_PMIC=n
  lichen.hal.power_providers:
    tags:
      - lichen
      - hal
      - power
      - battery
      - pmic
    platform_allow:
      - native_sim
      - qemu_x86
    integration_platforms:
      - native_sim
      - qemu_x86
    extra_args:
      - DTC_OVERLAY_FILE=boards/native_sim_power_providers.overlay
    extra_configs:
      - CONFIG_EMUL=y
      - CONFIG_I2C=y
      - CONFIG_FUEL_GAUGE=y
      - CONFIG_SBS_GAUGE_NEW_API=y
      - CONFIG_EMUL_SBS_GAUGE=y
      - CONFIG_CHARGER=y
      - CONFIG_SBS_CHARGER=y
      - CONFIG_EMUL_SBS_CHARGER=y
      - CONFIG_LICHEN_HAS_BATTERY=y
      - CONFIG_LICHEN_HAS_PMIC=y
```

## lichen/tests/hal_reset_unavailable/testcase.yaml
```yaml
# SPDX-License-Identifier: GPL-3.0-or-later
# SPDX-FileCopyrightText: The contributors to the LICHEN project

tests:
  lichen.hal_reset_unavailable.reboot_disabled:
    tags:
      - lichen
      - hal
      - reset
    harness: console
    harness_config:
      type: one_line
      regex:
        - "HAL reset unavailable PASS"
    platform_allow:
      - native_sim
      - native_sim/native/64
      - qemu_x86
    integration_platforms:
      - native_sim
      - native_sim/native/64
      - qemu_x86
```

## lichen/tests/hal_serial_precedence/testcase.yaml
```yaml
# SPDX-License-Identifier: GPL-3.0-or-later
# SPDX-FileCopyrightText: The contributors to the LICHEN project

tests:
  lichen.hal.serial_precedence.native_uart:
    tags:
      - lichen
      - hal
      - serial
    platform_allow:
      - qemu_x86
    integration_platforms:
      - qemu_x86
    extra_args:
      - DTC_OVERLAY_FILE=boards/qemu_x86_native_uart.overlay
  lichen.hal.serial_precedence.uart_pipe:
    tags:
      - lichen
      - hal
      - serial
    platform_allow:
      - qemu_x86
    integration_platforms:
      - qemu_x86
    extra_args:
      - DTC_OVERLAY_FILE=boards/qemu_x86_uart_pipe.overlay
  lichen.hal.serial_precedence.slip_uart:
    tags:
      - lichen
      - hal
      - serial
    platform_allow:
      - qemu_x86
    integration_platforms:
      - qemu_x86
    extra_args:
      - DTC_OVERLAY_FILE=boards/qemu_x86_slip_uart.overlay
  lichen.hal.serial_precedence.shell_uart:
    tags:
      - lichen
      - hal
      - serial
    platform_allow:
      - qemu_x86
    integration_platforms:
      - qemu_x86
    extra_args:
      - DTC_OVERLAY_FILE=boards/qemu_x86_shell_uart.overlay
  lichen.hal.serial_precedence.console:
    tags:
      - lichen
      - hal
      - serial
    platform_allow:
      - qemu_x86
    integration_platforms:
      - qemu_x86
    extra_args:
      - DTC_OVERLAY_FILE=boards/qemu_x86_console.overlay
```

## lichen/tests/icmpv6/testcase.yaml
```yaml
# SPDX-License-Identifier: GPL-3.0-or-later
# SPDX-FileCopyrightText: The contributors to the LICHEN project

tests:
  lichen.icmpv6:
    tags:
      - lichen
      - ipv6
      - icmpv6
    platform_allow:
      - native_sim
      - native_sim/native/64
    integration_platforms:
      - native_sim
      - native_sim/native/64
```

## lichen/tests/inbound_lci_location/testcase.yaml
```yaml
common:
  tags:
    - lichen
    - gateway
    - lci
    - location
tests:
  net.lichen.inbound_lci_location.native:
    platform_allow:
      - native_sim
      - native_sim/native/64
    integration_platforms:
      - native_sim
      - native_sim/native/64
  net.lichen.inbound_lci_location.qemu:
    platform_allow:
      - qemu_x86
    integration_platforms:
      - qemu_x86
    extra_configs:
      - CONFIG_NET_TEST=y
```

## lichen/tests/kiss_transport/testcase.yaml
```yaml
# SPDX-License-Identifier: GPL-3.0-or-later
# SPDX-FileCopyrightText: The contributors to the LICHEN project

tests:
  lichen.transport.kiss:
    tags: kiss transport tnc serial aprs ax25
    platform_allow:
      - native_sim
      - native_sim/native/64
```
