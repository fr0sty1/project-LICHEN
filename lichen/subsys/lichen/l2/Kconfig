## lichen/subsys/lichen/rpl/Kconfig
```kconfig
# SPDX-License-Identifier: GPL-3.0-or-later
# SPDX-FileCopyrightText: The contributors to the LICHEN project

# LICHEN RPL routing Kconfig

menuconfig LICHEN_RPL
	bool "LICHEN RPL routing"
	depends on LICHEN
	select NET_IPV6_NBR_CACHE
	select NET_ROUTE
	help
	  Enable RPL (RFC 6550) routing for DODAG mesh formation.
	  Provides upward routing via preferred parents and downward
	  routing via source routes (non-storing mode).

if LICHEN_RPL

config LICHEN_RPL_MRHOF
	bool "MRHOF objective function"
	default y
	help
	  Use Minimum Rank with Hysteresis Objective Function (MRHOF)
	  for parent selection (RFC 6719). MRHOF selects parents based
	  on ETX link quality with hysteresis to prevent flapping.

config LICHEN_RPL_MAX_PARENTS
	int "Maximum parent candidates"
	default 4
	range 2 8
	help
	  Maximum number of parent candidates tracked per DODAG and retained
	  per DAO target. More parents improves resilience but multiplies the
	  root-state memory used by every configured route.

config LICHEN_RPL_MAX_ROUTES
	int "Maximum routing table entries"
	default 32
	range 1 64
	help
	  Maximum number of target routes in the routing table.
	  Only relevant for root nodes in non-storing mode. The default root
	  state uses approximately 15 KiB before thread stacks and packet buffers.

config LICHEN_RPL_MAX_ACTIVE_DAO_CANDIDATES
	int "Maximum active DAO candidates"
	default 32
	range 1 64
	help
	  Maximum aggregate number of active target-to-parent candidates retained
	  by a root. A grouped DAO that would exceed this limit is rejected atomically.

config LICHEN_RPL_TRICKLE_IMIN_MS
	int "Trickle Imin (ms)"
	default 4000
	range 100 60000
	help
	  Minimum Trickle interval in milliseconds. Matches spec Imin=4s=4000 ms
	  (draft-lichen-rpl-lora-00.md:235, RFC 6206). Smaller values speed up
	  convergence but increase traffic.

config LICHEN_RPL_TRICKLE_IMAX_DOUBLINGS
	int "Trickle Imax doublings"
	default 8
	range 1 16
	help
	  Number of times Imin is doubled to reach Imax (RFC 6206).
	  Imax = Imin * 2^doublings.

config LICHEN_RPL_TRICKLE_K
	int "Trickle redundancy constant"
	default 10
	range 1 255
	help
	  Redundancy constant k for Trickle (RFC 6206).
	  Suppress transmission if k or more consistent messages heard.

config LICHEN_RPL_MIN_HOP_RANK_INCREASE
	int "MinHopRankIncrease"
	default 256
	range 1 65535
	help
	  Minimum increase in rank between a node and its parent.
	  Standard value is 256 (RFC 6550).

config LICHEN_RPL_MAX_RANK_INCREASE
	int "MaxRankIncrease"
	default 2048
	range 256 65535
	help
	  Maximum allowed increase from the lowest rank ever held.
	  Prevents routing loops during topology changes.

config LICHEN_RPL_PARENT_SWITCH_THRESHOLD
	int "Parent switch threshold"
	default 192
	range 0 65535
	depends on LICHEN_RPL_MRHOF
	help
	  Minimum cost improvement required to switch parents.
	  Provides hysteresis to prevent flapping.

config LICHEN_RPL_LOG_LEVEL
	int "RPL log level"
	default 3
	range 0 4
	help
	  Log level for LICHEN RPL:
	  0=off, 1=error, 2=warning, 3=info, 4=debug

config LICHEN_CCP_TDMA
	bool "CCP-1 TDMA time slots with RPL"
	default y
	depends on LICHEN_RPL
	select LICHEN_TDMA
	select LICHEN_CCP_TIME_SYNC
	help
	  Enable TDMA integration for CCP-1 (coordinated capacity planning).
	  Adds support for slot assignment, beacon sync, and tdma_tx_allowed()
	  checks coordinated with RPL DODAG and DIO options per
	  spec/02a-coordinated-capacity.md §2a.2, §2a.5 (FSM, desync recovery)
	  and ccp16.json, ccp_tdma.json. See AGENTS.md init graph.
	  Must follow lichen_link_init() before tdma_init().

config LICHEN_CHANNEL_AGILITY
	bool "Channel agility / rendezvous (CCP-1/12)"
	default y
	depends on LICHEN_RPL
	select LICHEN_MULTI_CHANNEL_ENABLED
	help
	  Enable frequency/channel agility and rendezvous per CCP-1. Uses
	  control channel CH0 for RPL traffic, hash-based selection for data
	  channels, synchronized via SFN from RPL beacons/DIOs.

config LICHEN_ADAPTIVE_SF
	bool "Adaptive spreading factor (CCP-16)"
	default y
	depends on LICHEN_RPL
	select LICHEN_ADAPTIVE_SF_ENABLED
	help
	  Enable adaptive SF selection using per-neighbor SNR EMA and density
	  from RPL metrics (CCP-16). Integrates with LICHEN_LINK_CCP16_LOAD_BALANCING.

endif # LICHEN_RPL
```

## lichen/subsys/lichen/schc/Kconfig
```kconfig
# SPDX-License-Identifier: GPL-3.0-or-later
# SPDX-FileCopyrightText: The contributors to the LICHEN project

# LICHEN SCHC header compression Kconfig

menuconfig LICHEN_SCHC
	bool "SCHC header compression (RFC 8724)"
	depends on LICHEN
	select SCHC
	help
	  Enable Static Context Header Compression for IPv6/UDP/CoAP
	  and ICMPv6 packets. Compresses 48+ byte headers to 3-6 bytes.

	  Rules implemented:
	  - Rule 0: link-local IPv6 + UDP + CoAP
	  - Rule 1: global IPv6 + UDP + CoAP
	  - Rule 2: ICMPv6 Echo (link-local)
	  - Rule 3: RPL DIO (link-local ICMPv6)
	  - Rule 4: RPL DAO (routable Yggdrasil 02xx source for multi-hop)
	  - Rule 255: uncompressed passthrough

if LICHEN_SCHC

config LICHEN_SCHC_LOG_LEVEL
	int "SCHC log level"
	default 3
	range 0 4
	help
	  Log level for LICHEN SCHC subsystem:
	  0=off, 1=error, 2=warning, 3=info, 4=debug

endif # LICHEN_SCHC
```

## lichen/subsys/lichen/senml/Kconfig
```kconfig
# SPDX-License-Identifier: GPL-3.0-or-later
# SPDX-FileCopyrightText: The contributors to the LICHEN project

# LICHEN SenML subsystem Kconfig

menuconfig LICHEN_SENML
	bool "SenML CBOR encoder"
	depends on LICHEN
	imply ZCBOR
	help
	  Enable SenML (RFC 8428) CBOR encoding for sensor data.
	  Content-Format: application/senml+cbor (112)

if LICHEN_SENML

config LICHEN_SENML_LOG_LEVEL
	int "SenML log level"
	default 3
	range 0 4
	help
	  Log level for LICHEN SenML encoder:
	  0=off, 1=error, 2=warning, 3=info, 4=debug

endif # LICHEN_SENML
```

## lichen/subsys/lichen/transport/Kconfig
```kconfig
# SPDX-License-Identifier: GPL-3.0-or-later
# SPDX-FileCopyrightText: The contributors to the LICHEN project

# LCI Transport bindings (spec/11-lci.md section 17.3)
#   - 17.3.1: SLIP over Serial/USB
#   - 17.3.2: BLE (SLIP over NUS / RFC 7668 IPSP)

# ─── SLIP Serial Transport (17.3.1) ─────────────────────────────────────────

menuconfig LICHEN_SLIP_TRANSPORT
	bool "SLIP transport for LCI (Serial/USB)"
	depends on LICHEN
	depends on SERIAL
	depends on RING_BUFFER
	depends on NET_L2_DUMMY
	depends on NET_IPV6
	help
	  Enable SLIP transport binding for the Local Client Interface (LCI).
	  Provides IPv6/CoAP connectivity over UART or USB-CDC using RFC 1055
	  SLIP framing.

	  This allows standard SLIP tools (slattach, tunslip6) to communicate
	  with the mesh node using any CoAP client.

	  Per LCI spec 17.3.1:
	  - Framing: END=0xC0, ESC=0xDB, ESC_END=0xDC, ESC_ESC=0xDD
	  - Node address: fe80::1
	  - Client address: fe80::2
	  - Recommended baud: 115200 or higher

if LICHEN_SLIP_TRANSPORT

config SLIP_TRANSPORT_LOG_LEVEL
	int "SLIP transport log level"
	default 3
	range 0 4
	help
	  Log level for SLIP transport module:
	    0 = Off
	    1 = Error
	    2 = Warning
	    3 = Info
	    4 = Debug

config SLIP_TRANSPORT_RX_RING_SIZE
	int "RX ring buffer size"
	default 256
	range 64 4096
	help
	  Size of the ring buffer used to transfer received bytes from
	  the UART ISR to the RX processing thread. Should be large enough
	  to hold multiple packets worth of SLIP-encoded data.

config SLIP_TRANSPORT_RX_THREAD_STACK_SIZE
	int "RX thread stack size"
	default 1024
	range 512 4096
	help
	  Stack size for the SLIP RX processing thread.

config SLIP_TRANSPORT_RX_THREAD_PRIORITY
	int "RX thread priority"
	default 7
	range 0 15
	help
	  Priority of the SLIP RX processing thread.
	  Lower numbers are higher priority.

config SLIP_TRANSPORT_AUTO_INIT
	bool "Automatically initialize SLIP transport"
	default y
	help
	  Automatically initialize the SLIP transport at boot.
	  If disabled, call slip_transport_init() explicitly.

endif # LICHEN_SLIP_TRANSPORT

# ─── BLE Transport (17.3.2) ─────────────────────────────────────────────────

menuconfig LICHEN_BLE_TRANSPORT
	bool "BLE IPSP transport for LCI"
	depends on LICHEN
	depends on BT
	depends on BT_PERIPHERAL
	help
	  Enable BLE transport bindings for the Local Client Interface (LCI).
	  This allows phones and laptops to communicate with the mesh node
	  over Bluetooth Low Energy using standard IPv6/CoAP.

	  Implements LCI spec 17.3.2:
	  - Option A (always built): SLIP over Nordic UART Service (NUS)
	  - Option B (optional): RFC 7668 6LoWPAN over BLE IPSP

if LICHEN_BLE_TRANSPORT

config LICHEN_BLE_SLIP
	bool "SLIP over BLE UART (Option A)"
	default y
	help
	  Enable SLIP-framed IPv6 over Nordic UART Service (NUS).
	  This is the REQUIRED transport option per LCI spec.

	  NUS UUID: 6E400001-B5A3-F393-E0A9-E50E24DCCA9E
	  Works with standard BLE serial libraries on all platforms.

config LICHEN_BLE_IPSP
	bool "6LoWPAN over BLE IPSP (Option B)"
	depends on NET_L2_BT
	help
	  Enable RFC 7668 6LoWPAN over BLE with Internet Protocol Support
	  Profile (IPSP). This is the OPTIONAL standard-compliant transport.

	  Requires Zephyr's BT L2 networking stack and provides:
	  - Standard IPSP profile
	  - L2CAP connection-oriented channels
	  - 6LoWPAN IPHC header compression

	  More protocol overhead but fully standards-compliant.

config LICHEN_BLE_TRANSPORT_REQUIRE_SECURE
	bool "Require LE Secure Connections"
	default y
	help
	  Require LE Secure Connections (security level 4) for all
	  BLE transport operations except read-only access.

	  SECURITY: Should be enabled for production. Disabling allows
	  unauthenticated access over BLE which is suitable only for
	  development and debugging.

config LICHEN_BLE_TRANSPORT_DIAG_REQUIRE_SECURE
	bool "Require LE Secure Connections for diagnostics"
	default y
	help
	  Require LE Secure Connections for diagnostic resources
	  (/diag/raw/*) regardless of the general security setting.

	  SECURITY: This MUST be enabled per LCI spec 17.6.1 table which
	  requires BLE pairing for raw diagnostic access.

config LICHEN_BLE_TRANSPORT_AUTO_START
	bool "Automatically start BLE advertising"
	default y
	help
	  Automatically start BLE advertising when the transport is
	  initialized. If disabled, call lichen_ble_transport_start()
	  explicitly.

config LICHEN_BLE_TRANSPORT_LOG_LEVEL
	int "BLE transport log level"
	default 3
	range 0 4
	help
	  Log level for BLE transport module:
	    0 = Off
	    1 = Error
	    2 = Warning
	    3 = Info
	    4 = Debug

config LICHEN_BLE_TRANSPORT_RX_TIMEOUT_MS
	int "SLIP frame receive timeout (ms)"
	default 5000
	range 1000 30000
	help
	  Timeout for receiving a complete SLIP frame. If a frame is not
	  completed within this time, the partial frame is discarded.

config LICHEN_BLE_TRANSPORT_MAX_CONNECTIONS
	int "Maximum concurrent BLE connections"
	default 1
	range 1 4
	help
	  Maximum number of concurrent BLE connections. For LCI, a single
	  connection is typically sufficient. Multiple connections increase
	  RAM usage.

endif # LICHEN_BLE_TRANSPORT

# ─── KISS TNC Transport (spec/kiss-framing.md) ──────────────────────────────

menuconfig LICHEN_KISS_TRANSPORT
	bool "KISS TNC transport"
	depends on LICHEN
	depends on SERIAL
	depends on RING_BUFFER
	help
	  Enable KISS TNC protocol transport for host interface connectivity.
	  Provides byte-stuffed framing over serial links, compatible with
	  legacy amateur radio applications (APRSDroid, Direwolf, Xastir,
	  Linux AX.25 stack).

	  Per spec/kiss-framing.md:
	  - Port 0: AX.25/APRS frames (legacy TNC app compatibility)
	  - Port 1: Raw LICHEN link frames (debugging, native apps)
	  - Commands: TxDelay, Persistence, SlotTime, SetHardware supported

	  Reference: http://www.ka9q.net/papers/kiss.html

if LICHEN_KISS_TRANSPORT

config KISS_TRANSPORT_LOG_LEVEL
	int "KISS transport log level"
	default 3
	range 0 4
	help
	  Log level for KISS transport module:
	    0 = Off
	    1 = Error
	    2 = Warning
	    3 = Info
	    4 = Debug

config KISS_TRANSPORT_RX_RING_SIZE
	int "RX ring buffer size"
	default 512
	range 128 4096
	help
	  Size of the ring buffer used to transfer received bytes from
	  the UART ISR to the RX processing thread. Should be large enough
	  to hold at least one full KISS frame (up to ~2KB escaped).

config KISS_TRANSPORT_RX_THREAD_STACK_SIZE
	int "RX thread stack size"
	default 1536
	range 1024 4096
	help
	  Stack size for the KISS RX processing thread. Needs to be larger
	  than SLIP due to frame dispatch callback overhead.

config KISS_TRANSPORT_RX_THREAD_PRIORITY
	int "RX thread priority"
	default 7
	range 0 15
	help
	  Priority of the KISS RX processing thread.
	  Lower numbers are higher priority.

config KISS_TRANSPORT_AUTO_INIT
	bool "Automatically initialize KISS transport"
	default n
	help
	  Automatically initialize the KISS transport at boot.
	  If disabled (default), call kiss_transport_init() explicitly
	  with the desired callbacks.

endif # LICHEN_KISS_TRANSPORT
```

## lichen/subsys/schc/Kconfig
```kconfig
# SPDX-License-Identifier: GPL-3.0-or-later
# SPDX-FileCopyrightText: The contributors to the LICHEN project

menuconfig SCHC
	bool "Static Context Header Compression"
	help
	  Enable the generic RFC 8724 SCHC profile dispatch module.

if SCHC

config SCHC_LOG_LEVEL
	int "SCHC log level"
	default 3
	range 0 4
	help
	  Log level for the generic SCHC subsystem:
	  0=off, 1=error, 2=warning, 3=info, 4=debug

endif # SCHC
```

## lichen/tests/app_interface/testcase.yaml
```yaml
# SPDX-License-Identifier: GPL-3.0-or-later
# SPDX-FileCopyrightText: The contributors to the LICHEN project

tests:
  net.lichen.app_interface:
    platform_allow:
      - native_sim
      - native_sim/native/64
    tags: lichen app-interface
```

## lichen/tests/ble_app_owner/testcase.yaml
```yaml
# SPDX-License-Identifier: GPL-3.0-or-later
# SPDX-FileCopyrightText: The contributors to the LICHEN project

# 64-bit native_sim only: CONFIG_BT_PERIPHERAL pulls in the Zephyr BLE HCI
# controller device, which is not instantiated on the 32-bit native_sim build
# (link fails with "undefined reference to __device_dts_ord_*"). The 64-bit
# target links and runs it; that coverage runs in the EC2 ARM64 CI job.
tests:
  net.lichen.ble_app_owner:
    platform_allow:
      - native_sim/native/64
    tags: bluetooth app-interface
  net.lichen.ble_app_owner.native:
    platform_allow:
      - native_sim/native/64
    extra_args:
      - BLE_APP_OWNER_TEST_MODE=native
    tags: bluetooth app-interface
  net.lichen.ble_app_owner.native_legacy:
    platform_allow:
      - native_sim/native/64
    extra_args:
      - BLE_APP_OWNER_TEST_MODE=native_legacy
    tags: bluetooth app-interface
  net.lichen.ble_app_owner.meshtastic:
    platform_allow:
      - native_sim/native/64
    extra_args:
      - BLE_APP_OWNER_TEST_MODE=meshtastic
    tags: bluetooth app-interface meshtastic
  net.lichen.ble_app_owner.meshcore:
    platform_allow:
      - native_sim/native/64
    extra_args:
      - BLE_APP_OWNER_TEST_MODE=meshcore
    tags: bluetooth app-interface meshcore
```

## lichen/tests/ble_ingress/testcase.yaml
```yaml
# SPDX-License-Identifier: GPL-3.0-or-later
# SPDX-FileCopyrightText: The contributors to the LICHEN project

tests:
  net.lichen.ble_ingress:
    tags:
      - net
      - lichen
      - gateway
      - ble
    platform_allow:
      - native_sim
      - native_sim/native/64
      - qemu_x86
    integration_platforms:
      - native_sim
      - native_sim/native/64
      - qemu_x86
    extra_args:
      - CONFIG_LOG_DEFAULT_LEVEL=4
```

## lichen/tests/ble_ipsp_transport/testcase.yaml
```yaml
# SPDX-License-Identifier: GPL-3.0-or-later
# SPDX-FileCopyrightText: The contributors to the LICHEN project

tests:
  lichen.transport.ble_ipsp:
    tags: ble transport lci
    platform_allow:
      - native_sim/native/64
```
