## lichen/subsys/lichen/l2/Kconfig
```kconfig
# SPDX-License-Identifier: GPL-3.0-or-later
# SPDX-FileCopyrightText: The contributors to the LICHEN project

# LICHEN Zephyr L2 network integration options

config LICHEN_IPV6
	bool "LICHEN IPv6 address utilities"
	depends on LICHEN
	# The l2 library always compiles lichen_util.c (EUI-64 derivation),
	# which needs TinyCrypt SHA-256 — select it here, not only from
	# LICHEN_LORA_L2, so radio-less builds (native_sim) link too.
	select TINYCRYPT
	select TINYCRYPT_SHA256
	default y
	help
	  Enable LICHEN IPv6 address utilities:
	  - Link-local fe80::/10 (control plane)
	  - Yggdrasil-derived 02xx::/64 primary mesh address from Ed25519 pubkey
	  - GUA optional (from DIO)

	  See lichen_yggdrasil_addr and spec/04-network.md for primary
	  address derivation. Utilities are standalone and can be used with or
	  without Zephyr's full networking stack.

config LICHEN_ICMPV6
	bool "LICHEN ICMPv6 implementation"
	depends on LICHEN_IPV6
	default y
	help
	  Enable LICHEN ICMPv6 implementation (RFC 4443):
	  - Echo Request/Reply (ping)
	  - Destination Unreachable
	  - Packet Too Big
	  - Time Exceeded
	  - Parameter Problem

	  The checksum covers the IPv6 pseudo-header (source, destination,
	  upper-layer length, Next Header = 58) followed by the ICMPv6 message.

	  These utilities are standalone and can be used with or without
	  Zephyr's full networking stack.

config LICHEN_LORA_L2
	bool "LICHEN LoRa L2 driver"
	depends on LICHEN
	depends on LICHEN_HAL
	depends on LICHEN_HAS_LORA
	depends on LORA
	depends on NETWORKING
	depends on NET_IPV6
	depends on LICHEN_IPV6
	select LICHEN_LINK
	select HWINFO
	select TINYCRYPT
	select TINYCRYPT_SHA256
	default y
	help
	  Enable the LICHEN LoRa L2 driver. This provides low-level LoRa
	  radio access including TX/RX threads and EUI-64 generation.

	  It is intended to be used through the full LICHEN_L2 Zephyr network
	  interface path so received frames are parsed, decompressed, verified,
	  and injected into IPv6.

config LICHEN_LORA_L2_LOG_LEVEL
	int "LICHEN LoRa L2 log level"
	depends on LICHEN_LORA_L2
	default 3
	range 0 4
	help
	  Log level for LICHEN LoRa L2 driver.
	  0 = Off, 1 = Error, 2 = Warning, 3 = Info, 4 = Debug.

config LICHEN_LORA_L2_RX_STACK_SIZE
	int "LICHEN LoRa L2 RX thread stack size"
	depends on LICHEN_LORA_L2
	default 2048
	help
	  Stack size for the LoRa L2 RX thread.

config LICHEN_LORA_L2_RX_PRIORITY
	int "LICHEN LoRa L2 RX thread priority"
	depends on LICHEN_LORA_L2
	default 7
	range 0 NUM_PREEMPT_PRIORITIES
	help
	  Priority for the LoRa L2 RX thread. Lower numbers have higher
	  priority in Zephyr. Validated against NUM_PREEMPT_PRIORITIES
	  at build time. (project-LICHEN-dq6n.26)

config LICHEN_LORA_L2_RX_TIMEOUT_MS
	int "LoRa RX timeout in milliseconds"
	depends on LICHEN_LORA_L2
	default 1000
	range 100 10000
	help
	  Timeout for lora_recv() calls in the RX thread.

	  Lower values provide faster stop() responsiveness. Higher values may
	  reduce wakeups on some platforms, but slow disable/enable cycles.

config LICHEN_LORA_FREQUENCY
	int "LoRa frequency in Hz"
	depends on LICHEN_LORA_L2
	default 915000000
	range 150000000 960000000
	help
	  LoRa carrier frequency in Hz. Must comply with regional regulations.
	  Common ISM bands: 915000000 (US), 868000000 (EU), 433000000 (Asia).

config LICHEN_LORA_TX_POWER
	int "LoRa TX power in dBm"
	depends on LICHEN_LORA_L2
	default 14
	range 0 22
	help
	  LoRa transmit power in dBm. Default 14 dBm is safe worldwide.
	  Higher values may violate regional regulations.

config LICHEN_L2
	bool "LICHEN Zephyr L2 network interface"
	depends on LICHEN_LORA_L2
	depends on LICHEN_LINK
	depends on NETWORKING
	depends on NET_IPV6
	depends on LICHEN_IPV6
	select LICHEN_COAP
	default y if NET_IPV6
	help
	  Register LICHEN as a Zephyr L2 network interface so the IPv6 stack
	  routes packets through LoRa. This implements the net_l2 callbacks
	  and bridges IPv6 packets to the LoRa radio via SCHC compression and
	  LICHEN framing.

config LICHEN_L2_LOG_LEVEL
	int "LICHEN L2 log level"
	depends on LICHEN_L2
	default 3
	range 0 4
	help
	  Log level for LICHEN Zephyr L2 interface.
	  0 = Off, 1 = Error, 2 = Warning, 3 = Info, 4 = Debug.

config LICHEN_L2_RX_ALLOC_TIMEOUT_MS
	int "RX packet allocation timeout (ms)"
	depends on LICHEN_L2
	default 50
	range 0 1000
	help
	  Timeout in milliseconds for net_pkt_rx_alloc_with_buffer().

	  For LoRa's low data rate, 50 ms is reasonable. If RX packet
	  allocation fails under memory pressure, increase this value or add
	  more NET_BUF_RX buffers.

config LICHEN_L2_DEV_PROVISIONING
	bool "INSECURE: fixed development link key and static peer"
	depends on LICHEN_L2
	default n
	help
	  Provision the link layer at boot with a fixed, publicly-known
	  Ed25519 seed (shared by every node built with this option) and
	  register the single peer named by LICHEN_L2_DEV_PEER_EUI64.

	  SECURITY: This provides NO authentication — the seed is in the
	  source tree, so anyone can forge frames. It exists only so the
	  CoAP/IPv6-over-LoRa path can run on the bench before the real
	  announce/EDHOC peer provisioning lands. Never enable in
	  production builds.

config LICHEN_L2_DEV_PEER_EUI64
	string "Dev peer EUI-64 list (comma-separated, ':' separators allowed)"
	depends on LICHEN_L2_DEV_PROVISIONING
	default ""
	help
	  Comma-separated EUI-64s of the peers to accept signed frames
	  from, e.g. "f4ce36001234abcd" or
	  "f4:ce:36:00:12:34:ab:cd,8a1a2c4b93812cab". Each node logs its
	  own EUI-64 / link-local address at boot. Each peer's dev pubkey
	  is derived from its EUI-64 (see lichen_link_derive_seed).

config LICHEN_SF_ASSIGNMENT_ENABLED
	bool "Enable per-peer SF assignment (DIO or hash(IID))"
	depends on LICHEN_LORA_L2
	default n
	help
	  Parse ASSIGNED_SF from DIO. Fall back to
	  hash(IID) or fixed SF10. Required for multi-SF gateway support.

config LICHEN_GATEWAY_MULTI_SF
	bool "Enable multi-SF CAD scan on gateway (SF7-SF12)"
	depends on LICHEN_LORA_L2
	depends on LORA_LICHEN_GATEWAY_RPL_ROOT
	default n
	help
	  Gateway performs CAD across SFs before RX (lr1110/lora_l2 updates).
	  Complements SF assignment. Increases power but supports dense mesh.

config LICHEN_L2_TEST_HOOKS
	bool "LICHEN L2 ztest-only test hooks"
	depends on LICHEN_L2
	depends on ZTEST
	default n
	help
	  Expose deterministic key loading and packet counters for automated
	  L2 path tests. This must stay disabled in production builds.

config LICHEN_LORA_CCA
	bool "Enable Clear Channel Assessment before every TX"
	default y
	depends on LICHEN_LORA_L2
	help
	  Perform CAD (LoRa CCA) before lora_send() per CCP-15.
	  Reduces collisions in dense meshes. Requires radio driver CAD support.
	  Default y but gated by driver capabilities (sim/renode may stub to always-clear).

config LICHEN_LORA_CCA_THRESHOLD_DBM
	int "CCA RSSI threshold (dBm)"
	default -85
	range -120 -40
	depends on LICHEN_LORA_CCA
	help
	  If measured RSSI < threshold, channel is clear. Typical LoRa value -85 dBm.
	  Too low = excessive backoff; too high = collisions.

config LICHEN_LORA_CCA_TIMEOUT_MS
	int "Max CCA wait time (ms)"
	default 50
	range 5 200
	depends on LICHEN_LORA_CCA
	help
	  Timeout for CAD operation. Must be long enough for radio to sample but short
	  enough for low latency. Matches typical CAD duration ~ few symbol times.

config LICHEN_DUTY_CYCLE
	bool "LICHEN duty cycle enforcement"
	depends on LICHEN_LORA_L2
	default y
	help
	  Enable CCP-13 DutyCycleTracker in lichen_lora_l2_tx. Checks before send,
	  records airtime after successful TX. Returns -EBUSY if cannot transmit.

config LICHEN_LR_FHSS_ENABLED
	bool "LR-FHSS mode for SX1262 (zd2d.2)"
	default n
	depends on LORA_SX126X
	select LICHEN_LORA_L2
	help
	  Enables LR-FHSS PHY on SX1262 (not SX127x). Requires driver support.

config LICHEN_LR_FHSS_OCW
	int "LR-FHSS operating channel width (kHz)"
	default 137
	range 137 336
	depends on LICHEN_LR_FHSS_ENABLED

config LICHEN_LR_FHSS_CR
	int "LR-FHSS coding rate"
	default 1
	range 1 2
	depends on LICHEN_LR_FHSS_ENABLED
```

## lichen/subsys/lichen/link/Kconfig
```kconfig
# SPDX-License-Identifier: GPL-3.0-or-later
# SPDX-FileCopyrightText: The contributors to the LICHEN project

# LICHEN link layer Kconfig

menuconfig LICHEN_LINK
	bool "LICHEN link layer"
	depends on LICHEN
	select CRC
	select LICHEN_CRYPTO_AES_CCM
	select LICHEN_SCHC
	select TINYCRYPT
	select TINYCRYPT_SHA256
	help
	  Enable the LICHEN link layer with Schnorr-48 signatures
	  and replay protection. Automatically enables SCHC header
	  compression for IPv6 packet handling.

if LICHEN_LINK

config LICHEN_LINK_SCHNORR
	bool "Schnorr-48 link signatures"
	default y
	select LICHEN_CRYPTO_MONOCYPHER
	help
	  Enable 48-byte Schnorr signatures per draft-lichen-schnorr-00.
	  This provides sender authentication for every link-layer frame.

config LICHEN_LINK_MAX_NEIGHBORS
	int "Maximum tracked neighbors"
	default 16
	range 4 64
	help
	  Maximum number of neighbors to track replay state for.
	  Each neighbor uses approximately 20 bytes of RAM (EUI-64 +
	  64-bit replay window + metadata).

config LICHEN_LINK_LOG_LEVEL
	int "Link layer log level"
	default 3
	range 0 4
	help
	  Log level for LICHEN link layer:
	  0=off, 1=error, 2=warning, 3=info, 4=debug

config LICHEN_LINK_MIC_SKIP_VERIFY
	bool "Skip MIC verification (DANGEROUS)"
	default n
	help
	  DANGER: Disables MIC verification, allowing forged frames to be
	  accepted. This option exists ONLY for testing environments where
	  link-layer keys are not yet provisioned.

	  NEVER enable this in production — it completely disables frame
	  authentication and allows any attacker to inject packets.

	  When enabled, a warning is logged for every received frame to
	  make the insecure state obvious.

config LICHEN_LINK_INSECURE_CRC32_MIC
	bool "Allow CRC32 MIC fallback (INSECURE)"
	default n
	help
	  DANGER: Allows CRC32 to be used as the MIC when no link key is
	  configured. CRC32 provides error detection ONLY — it provides NO
	  cryptographic authentication. Any attacker can compute valid CRC32
	  values and forge frames.

	  This option exists ONLY for:
	  - Development and testing
	  - Networks with higher-layer authentication (e.g., OSCORE)

	  For production deployments requiring link-layer security, configure
	  a link key to enable AES-CCM-64 MIC instead of enabling this option.

	  When enabled, a compile-time warning is emitted to ensure the
	  insecure configuration is visible in build logs.

config LICHEN_LINK_EPOCH_PERSIST
	bool "Persist the link TX epoch across reboots"
	depends on SETTINGS
	help
	  Persist the link-layer TX epoch to the settings subsystem and
	  advance it by one on every boot. This keeps a rebooted node's
	  (epoch, seqnum) counter monotonically ahead of what its peers
	  remember in their replay windows, so frames sent after a reboot
	  are not rejected as replays.

	  Without this, link_ctx picks a random epoch in [128,255] at boot,
	  which is lower than the peer's remembered epoch ~50% of the time
	  and causes one-way replay deafness until both nodes reset together
	  (lora_ipv6_mesh-3uhb). Costs one small settings write per boot.

config LICHEN_LINK_EPOCH_TEST_HOOKS
	bool "Test hooks for epoch persistence"
	depends on LICHEN_LINK_EPOCH_PERSIST
	depends on ZTEST
	help
	  Expose lichen_link_epoch_test_reset() to clear the in-RAM
	  boot-epoch cache so tests can simulate a reboot and exercise the
	  persist-and-advance behavior. Testing only.

config LICHEN_LINK_CCP16_LOAD_BALANCING
	bool "CCP16 density-aware load balancing"
	depends on LICHEN_RPL
	depends on LICHEN_LINK_EPOCH_PERSIST
	select LICHEN_SCHC
	help
	  Enable CCP-16 coordinated load balancing for high-density
	  (DEFCON-scale) deployments. References density tracking, adaptive
	  SF thresholds, and channel utilization from
	  spec/appendix-design-rationale.md. Explicitly selects SCHC and
	  link epoch features required for TDMA/multi-channel operation.

config LICHEN_TDMA
	bool "TDMA slot scheduling / gateway-centric mode (beacon-sync, slot assign, spatial reuse)"
	depends on LICHEN_LINK_CCP16_LOAD_BALANCING
	depends on LICHEN_RPL
	select LICHEN_SCHC
	help
	  Enable TDMA struct and lichen_tdma_init() after lichen_link_load_key() per
	  AGENTS.md init graph and spec/02a-coordinated-capacity.md §2a.2 (guard=100ms,
	  slot=hash(EUI64^epoch)%num_slots via lichen_hash_32; validated by ccp16.json
	  + ccp_tdma.json). Supports beacon sync, GPS sync, dynamic slot assignment
	  from root, spatial reuse, desync FSM per §2a.5. Must not call before key
	  loaded. Mimics lichen_link_ctx pattern exactly.

config LICHEN_CCP_TIME_SYNC
	bool "CCP time synchronization (SFN, beacons, GPS stratum)"
	default y
	depends on LICHEN_LINK_CCP16_LOAD_BALANCING
	help
	  Enable time sync for CCP-16 desync recovery, TDMA slots, and RPL
	  version interactions per spec/02a-coordinated-capacity.md §2a.4, §2a.5.
	  Uses beacon SFN with GPS stratum-0 priority, local RTC fallback. Matches
	  ccp16.json, ccp16-desync.json vectors exactly. SECURITY: signed beacons only.

config LICHEN_TDMA_BEACON_SYNC
	bool "Beacon-based TDMA synchronization"
	depends on LICHEN_TDMA
	default y
	help
	  Nodes sync time and slots from gateway periodic beacons.

config LICHEN_MULTI_CHANNEL_ENABLED
	bool "Multi-channel TX/RX coordination (CCP-9/12)"
	depends on LICHEN_LINK
	default y
	help
	  Enable multi-channel operation. Control on CH0,
	  data channels 1-N with hash/rendezvous selection, idle listen on control,
	  dynamic hop for RX. Requires updated radio API and link scheduler.

config LICHEN_N_CHANNELS
	int "Number of LoRa channels (incl. control)"
	depends on LICHEN_MULTI_CHANNEL_ENABLED
	default 8
	range 1 16
	help
	  Matches regional plan (e.g. 8 for EU868). Used for mod N in
	  select_channel/hash_32 and synchronized_hop_channel(CCP-12).

endif # LICHEN_LINK
```

## lichen/subsys/lichen/meshcore/Kconfig
```kconfig
# SPDX-License-Identifier: GPL-3.0-or-later
# SPDX-FileCopyrightText: The contributors to the LICHEN project

menuconfig LICHEN_MESHCORE_CODEC
	bool "MeshCore app-compat bounded command codec"
	depends on LICHEN
	help
	  Enable the bounded no-allocation MeshCore app compatibility codec
	  surface. BLE transports pass one complete raw MeshCore inner command
	  frame per GATT value; serial/TCP framing is handled separately.

if LICHEN_MESHCORE_CODEC

config LICHEN_MESHCORE_ADAPTER
	bool "MeshCore app-compat dispatcher"
	help
	  Enable the board-agnostic MeshCore app adapter dispatcher. It consumes
	  raw inner command frames from local transports and emits bounded
	  response or push frames through caller-provided transport callbacks.

config LICHEN_MESHCORE_MAX_FRAME
	int "Maximum MeshCore BLE inner frame size"
	default 176
	range 1 176
	help
	  Maximum raw MeshCore inner frame size accepted or emitted by BLE. This
	  follows the firmware-side MeshCore frame budget; serial/TCP transports
	  may use a smaller outer-framing budget.

config LICHEN_MESHCORE_MAX_SERIAL_PAYLOAD
	int "Maximum MeshCore serial payload size"
	default 172
	range 1 65535
	help
	  Maximum MeshCore inner payload size accepted inside the serial/TCP
	  0x3c/0x3e + uint16_le length wrapper. Must fit in uint16_t per codec assert.

config LICHEN_MESHCORE_PENDING_EVENTS
	int "Maximum pending MeshCore app events"
	default 4
	range 1 16
	help
	  Maximum incoming LICHEN app-interface events retained for a connected
	  MeshCore client to drain with CMD_SYNC_NEXT_MESSAGE.

endif # LICHEN_MESHCORE_CODEC
```
