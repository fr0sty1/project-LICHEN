## CMakeLists.txt
```
# SPDX-License-Identifier: GPL-3.0-or-later
# SPDX-FileCopyrightText: The contributors to the LICHEN project

cmake_minimum_required(VERSION 3.20.0)
find_package(Zephyr REQUIRED HINTS $ENV{ZEPHYR_BASE})
project(app_identity_rollback)

zephyr_compile_options(-Wno-error=duplicated-branches)

set(LICHEN_ROOT ${CMAKE_CURRENT_SOURCE_DIR}/../..)
target_sources(app PRIVATE
  ../app_identity/src/identity_store.c
  src/link_stubs.c
  ${LICHEN_ROOT}/subsys/lichen/app_identity/identity_store.c
  ${LICHEN_ROOT}/subsys/lichen/app_identity/identity_settings.c
  ${LICHEN_ROOT}/subsys/lichen/crypto/monocypher.c
)
target_include_directories(app PRIVATE
  ${LICHEN_ROOT}/subsys/lichen/app_identity/include
  ${LICHEN_ROOT}/subsys/lichen/link/include
  ${LICHEN_ROOT}/subsys/lichen/crypto
)
```

## prj.conf
```kconfig
# SPDX-License-Identifier: GPL-3.0-or-later
# SPDX-FileCopyrightText: The contributors to the LICHEN project

CONFIG_ZTEST=y
CONFIG_ZTEST_STACK_SIZE=2048
CONFIG_MAIN_STACK_SIZE=2048
CONFIG_IDLE_STACK_SIZE=2048
CONFIG_SETTINGS=y
CONFIG_CRC=y
CONFIG_ENTROPY_GENERATOR=y
CONFIG_TEST_RANDOM_GENERATOR=y
CONFIG_STACK_CANARIES=y
CONFIG_STACK_SENTINEL=y
CONFIG_ASSERT=y
CONFIG_ASSERT_VERBOSE=y
```

## src/link_stubs.c
```c
/* SPDX-License-Identifier: GPL-3.0-or-later */
/* SPDX-FileCopyrightText: The contributors to the LICHEN project */

#include <errno.h>
#include <string.h>

#include <lichen/link_ctx.h>
#include <monocypher.h>

int lichen_link_init(struct lichen_link_ctx *ctx, const uint8_t *eui64) {
  if (ctx == NULL || eui64 == NULL) {
    return -EINVAL;
  }
  memset(ctx, 0, sizeof(*ctx));
  memcpy(ctx->eui64, eui64, LICHEN_EUI64_LEN);
  k_mutex_init(&ctx->seq_lock);
  return 0;
}

int lichen_link_derive_pubkey(const uint8_t seed[LICHEN_SEED_LEN],
                              uint8_t out_pk[LICHEN_PK_LEN]) {
  if (seed == NULL || out_pk == NULL) {
    return -EINVAL;
  }
  crypto_blake2b(out_pk, LICHEN_PK_LEN, seed, LICHEN_SEED_LEN);
  return 0;
}

int lichen_link_load_key(struct lichen_link_ctx *ctx,
                         const uint8_t seed[LICHEN_SEED_LEN]) {
  uint8_t public_key[LICHEN_PK_LEN];
  int ret;

  if (ctx == NULL || seed == NULL) {
    return -EINVAL;
  }
  ret = lichen_link_derive_pubkey(seed, public_key);
  if (ret == 0) {
    memcpy(ctx->ed25519_sk, seed, LICHEN_SK_LEN);
    memcpy(ctx->ed25519_pk, public_key, LICHEN_PK_LEN);
    ctx->has_key = true;
  }
  crypto_wipe(public_key, sizeof(public_key));
  return ret;
}
```
