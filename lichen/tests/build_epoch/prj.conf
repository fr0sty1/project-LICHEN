## CMakeLists.txt
```
# SPDX-License-Identifier: GPL-3.0-or-later
# SPDX-FileCopyrightText: The contributors to the LICHEN project

cmake_minimum_required(VERSION 3.20.0)

include(${CMAKE_CURRENT_LIST_DIR}/../../cmake/lichen_build_epoch.cmake)

set(LICHEN_BUILD_EPOCH_TEST_CASE "source_date_epoch" CACHE STRING
  "Build epoch test case")
set(_developer_generated_checked 0)

if(LICHEN_BUILD_EPOCH_TEST_CASE STREQUAL "source_date_epoch")
  set(ENV{SOURCE_DATE_EPOCH} "1711111111")
  set(LICHEN_TIME_BUILD_EPOCH_MODE "production" CACHE STRING "" FORCE)
  set(_expected_epoch 1711111111)
  set(_expected_source SOURCE_DATE_EPOCH)
  lichen_configure_time_build_epoch()
elseif(LICHEN_BUILD_EPOCH_TEST_CASE STREQUAL "release")
  unset(ENV{SOURCE_DATE_EPOCH})
  set(LICHEN_TIME_BUILD_EPOCH_MODE "production" CACHE STRING "" FORCE)
  set(LICHEN_RELEASE_EPOCH_UNIX "1712222222" CACHE STRING "" FORCE)
  set(_expected_epoch 1712222222)
  set(_expected_source RELEASE)
  lichen_configure_time_build_epoch()
elseif(LICHEN_BUILD_EPOCH_TEST_CASE STREQUAL "developer_generated")
  unset(ENV{SOURCE_DATE_EPOCH})
  set(LICHEN_TIME_BUILD_EPOCH_MODE "developer-generated" CACHE STRING "" FORCE)
  set(_expected_source DEVELOPER_GENERATED)
  lichen_configure_time_build_epoch()
  set(_expected_epoch ${LICHEN_TIME_BUILD_EPOCH_RESOLVED})
  set(_developer_generated_checked ${LICHEN_TIME_BUILD_EPOCH_GENERATED})
elseif(LICHEN_BUILD_EPOCH_TEST_CASE STREQUAL "developer_fixed")
  unset(ENV{SOURCE_DATE_EPOCH})
  set(LICHEN_TIME_BUILD_EPOCH_MODE "developer-generated" CACHE STRING "" FORCE)
  set(LICHEN_DEVELOPER_BUILD_EPOCH_UNIX "1713333333" CACHE STRING "" FORCE)
  set(_expected_epoch 1713333333)
  set(_expected_source DEVELOPER_FIXED)
  lichen_configure_time_build_epoch()
else()
  message(FATAL_ERROR "Unsupported LICHEN_BUILD_EPOCH_TEST_CASE=${LICHEN_BUILD_EPOCH_TEST_CASE}")
endif()

find_package(Zephyr REQUIRED HINTS $ENV{ZEPHYR_BASE})
project(build_epoch)

target_compile_definitions(app PRIVATE
  LICHEN_BUILD_EPOCH_EXPECTED_EPOCH=${_expected_epoch}
  LICHEN_BUILD_EPOCH_DEVELOPER_GENERATED_CHECKED=$<BOOL:${_developer_generated_checked}>
  LICHEN_BUILD_EPOCH_EXPECT_SOURCE_${_expected_source}=1)
target_sources(app PRIVATE src/main.c)
```

## prj.conf
```kconfig
# SPDX-License-Identifier: GPL-3.0-or-later
# SPDX-FileCopyrightText: The contributors to the LICHEN project

CONFIG_ZTEST=y
CONFIG_LICHEN=y
CONFIG_LICHEN_HAL=y
CONFIG_LICHEN_IPV6=n
CONFIG_MAIN_STACK_SIZE=2048

# C Safety Policy - spec/appendix-c-safety.md
CONFIG_STACK_CANARIES=y
CONFIG_STACK_SENTINEL=y
CONFIG_ASSERT=y
CONFIG_ASSERT_VERBOSE=y
```

## boards/native_sim.conf
```kconfig
../../sanitizers.conf
```

## src/main.c
```c
/*
 * SPDX-License-Identifier: GPL-3.0-or-later
 * SPDX-FileCopyrightText: The contributors to the LICHEN project
 */

#include <zephyr/ztest.h>

#include <lichen/hal.h>

ZTEST(build_epoch, test_build_epoch_metadata)
{
	struct lichen_hal_time_snapshot snapshot;

	zassert_equal((uint32_t)CONFIG_LICHEN_TIME_BUILD_EPOCH_UNIX,
		      (uint32_t)LICHEN_BUILD_EPOCH_EXPECTED_EPOCH);

#if defined(LICHEN_BUILD_EPOCH_EXPECT_SOURCE_SOURCE_DATE_EPOCH)
	zassert_true(IS_ENABLED(CONFIG_LICHEN_TIME_BUILD_EPOCH_SOURCE_DATE_EPOCH));
	zassert_false(IS_ENABLED(CONFIG_LICHEN_TIME_BUILD_EPOCH_SOURCE_RELEASE));
	zassert_false(IS_ENABLED(CONFIG_LICHEN_TIME_BUILD_EPOCH_SOURCE_DEVELOPER_GENERATED));
	zassert_false(IS_ENABLED(CONFIG_LICHEN_TIME_BUILD_EPOCH_SOURCE_DEVELOPER_FIXED));
#elif defined(LICHEN_BUILD_EPOCH_EXPECT_SOURCE_RELEASE)
	zassert_true(IS_ENABLED(CONFIG_LICHEN_TIME_BUILD_EPOCH_SOURCE_RELEASE));
	zassert_false(IS_ENABLED(CONFIG_LICHEN_TIME_BUILD_EPOCH_SOURCE_DATE_EPOCH));
	zassert_false(IS_ENABLED(CONFIG_LICHEN_TIME_BUILD_EPOCH_SOURCE_DEVELOPER_GENERATED));
	zassert_false(IS_ENABLED(CONFIG_LICHEN_TIME_BUILD_EPOCH_SOURCE_DEVELOPER_FIXED));
#elif defined(LICHEN_BUILD_EPOCH_EXPECT_SOURCE_DEVELOPER_GENERATED)
	zassert_true(IS_ENABLED(CONFIG_LICHEN_TIME_BUILD_EPOCH_SOURCE_DEVELOPER_GENERATED));
	zassert_false(IS_ENABLED(CONFIG_LICHEN_TIME_BUILD_EPOCH_SOURCE_DATE_EPOCH));
	zassert_false(IS_ENABLED(CONFIG_LICHEN_TIME_BUILD_EPOCH_SOURCE_RELEASE));
	zassert_false(IS_ENABLED(CONFIG_LICHEN_TIME_BUILD_EPOCH_SOURCE_DEVELOPER_FIXED));
	zassert_true(LICHEN_BUILD_EPOCH_DEVELOPER_GENERATED_CHECKED);
#elif defined(LICHEN_BUILD_EPOCH_EXPECT_SOURCE_DEVELOPER_FIXED)
	zassert_true(IS_ENABLED(CONFIG_LICHEN_TIME_BUILD_EPOCH_SOURCE_DEVELOPER_FIXED));
	zassert_false(IS_ENABLED(CONFIG_LICHEN_TIME_BUILD_EPOCH_SOURCE_DATE_EPOCH));
	zassert_false(IS_ENABLED(CONFIG_LICHEN_TIME_BUILD_EPOCH_SOURCE_RELEASE));
	zassert_false(IS_ENABLED(CONFIG_LICHEN_TIME_BUILD_EPOCH_SOURCE_DEVELOPER_GENERATED));
	zassert_false(LICHEN_BUILD_EPOCH_DEVELOPER_GENERATED_CHECKED);
#else
#error "Missing build epoch source expectation"
#endif

	zassert_ok(lichen_hal_time_snapshot_get(&snapshot));
	zassert_equal(snapshot.build_epoch,
		      (uint32_t)LICHEN_BUILD_EPOCH_EXPECTED_EPOCH);
	zassert_equal(snapshot.effective_epoch_floor,
		      (uint32_t)LICHEN_BUILD_EPOCH_EXPECTED_EPOCH);
}

ZTEST_SUITE(build_epoch, NULL, NULL, NULL, NULL, NULL);
```
