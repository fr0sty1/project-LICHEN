## lichen/tests/edhoc_handshake/testcase.yaml
```yaml
tests:
  lichen.edhoc.handshake:
    tags: edhoc crypto security
    platform_allow: qemu_x86 native_sim
    integration_platforms:
      - qemu_x86
```

## lichen/tests/meshtastic_adapter_layout/testcase.yaml
```yaml
# SPDX-License-Identifier: GPL-3.0-or-later
# SPDX-FileCopyrightText: The contributors to the LICHEN project

tests:
  lichen.meshtastic_adapter_layout:
    tags:
      - lichen
      - meshtastic
      - abi
    platform_allow:
      - native_sim
      - native_sim/native/64
      - qemu_x86
    integration_platforms:
      - native_sim
      - qemu_x86
```

## lichen/tests/oscore_persist/testcase.yaml
```yaml
tests:
  lichen.oscore.persist:
    platform_allow:
      - qemu_x86
    tags:
      - lichen
      - oscore
      - settings
      - security
```

## lichen/tests/regional_duty_cycle/testcase.yaml
```yaml
# SPDX-License-Identifier: GPL-3.0-or-later
# SPDX-FileCopyrightText: The contributors to the LICHEN project

tests:
  lichen.regional_duty_cycle:
    tags:
      - lichen
      - hal
      - duty-cycle
    platform_allow:
      - native_sim
      - native_sim/native/64
      - qemu_x86
    integration_platforms:
      - native_sim
      - qemu_x86
```

## lichen/tests/replay_persist/testcase.yaml
```yaml
tests:
  lichen.link.replay_persist:
    platform_allow:
      - qemu_x86
    tags:
      - lichen
      - link
      - replay
      - security
```

## lichen/tests/routing_dispatch/testcase.yaml
```yaml
common:
  tags:
    - lichen
    - routing
tests:
  net.lichen.routing_dispatch:
    platform_allow:
      - qemu_x86
      - native_sim
      - native_sim/native/64
    integration_platforms:
      - qemu_x86
```

## lichen/tests/time_source_class/testcase.yaml
```yaml
# SPDX-License-Identifier: GPL-3.0-or-later
# SPDX-FileCopyrightText: The contributors to the LICHEN project

tests:
  lichen.time_source_class:
    tags:
      - lichen
      - timing
    platform_allow:
      - qemu_cortex_m3
    integration_platforms:
      - qemu_cortex_m3
```

## lichen/tests/tunnel_auth_zephyr/testcase.yaml
```yaml
# SPDX-License-Identifier: GPL-3.0-or-later
# SPDX-FileCopyrightText: The contributors to the LICHEN project

tests:
  net.lichen.tunnel_auth:
    tags: [net, lichen, gateway, security]
    platform_allow: [qemu_x86, native_sim, native_sim/native/64]
    integration_platforms: [qemu_x86]
```
