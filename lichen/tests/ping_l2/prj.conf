## CMakeLists.txt
```
# SPDX-License-Identifier: GPL-3.0-or-later
# SPDX-FileCopyrightText: The contributors to the LICHEN project

cmake_minimum_required(VERSION 3.20.0)
find_package(Zephyr REQUIRED HINTS $ENV{ZEPHYR_BASE})
project(ping_l2)

include_directories(${CMAKE_CURRENT_SOURCE_DIR}/../../drivers/lora_loopback)

FILE(GLOB app_sources src/*.c)
target_sources(app PRIVATE ${app_sources})
```

## prj.conf
```kconfig
# SPDX-License-Identifier: GPL-3.0-or-later
# SPDX-FileCopyrightText: The contributors to the LICHEN project

# ICMPv6 packet-path test over the real LICHEN L2 and LoRa loopback path

# Logging
CONFIG_LOG=y
CONFIG_PRINTK=y

# Zephyr test framework
CONFIG_ZTEST=y
CONFIG_ZTEST_STACK_SIZE=4096

# Networking core
CONFIG_NETWORKING=y
CONFIG_NET_BUF=y
CONFIG_NET_LOG=y

# IPv6
CONFIG_NET_IPV6=y
CONFIG_NET_IPV4=n
CONFIG_NET_UDP=y
CONFIG_NET_SOCKETS=y
CONFIG_NET_CONTEXT_RCVTIMEO=y
CONFIG_POSIX_API=y

# Keep IPv6 minimal for the native loopback test
CONFIG_NET_IPV6_DAD=n

# Network buffers
CONFIG_NET_PKT_RX_COUNT=8
CONFIG_NET_PKT_TX_COUNT=8
CONFIG_NET_BUF_RX_COUNT=16
CONFIG_NET_BUF_TX_COUNT=16
CONFIG_NET_IF_MAX_IPV6_COUNT=4

# Real LICHEN L2 path and native LoRa loopback radio
CONFIG_LICHEN=y
CONFIG_LICHEN_HAS_LORA=y
CONFIG_LICHEN_CRYPTO_MONOCYPHER=y
CONFIG_LICHEN_LINK=y
CONFIG_LICHEN_APP_IDENTITY=y
CONFIG_LICHEN_APP_IDENTITY_TEST_HOOKS=y
CONFIG_LICHEN_L2=y
CONFIG_LICHEN_L2_TEST_HOOKS=y
CONFIG_LORA=y
CONFIG_LORA_LOOPBACK=y
CONFIG_LORA_LOOPBACK_MTU=255
CONFIG_LORA_LOOPBACK_TEST_HOOKS=y
CONFIG_LICHEN_LORA_L2_RX_TIMEOUT_MS=100

# Random generator for test
CONFIG_ENTROPY_GENERATOR=y
CONFIG_TEST_RANDOM_GENERATOR=y

# Stack sizes
CONFIG_IDLE_STACK_SIZE=2048
CONFIG_MAIN_STACK_SIZE=4096
CONFIG_SYSTEM_WORKQUEUE_STACK_SIZE=4096

# C Safety Policy - spec/appendix-c-safety.md
CONFIG_STACK_CANARIES=y
CONFIG_STACK_SENTINEL=y
CONFIG_ASSERT=y
CONFIG_ASSERT_VERBOSE=y
```

## boards/native_sim_native_64.overlay
```dts
/*
 * SPDX-License-Identifier: GPL-3.0-or-later
 * SPDX-FileCopyrightText: The contributors to the LICHEN project
 */

/ {
	aliases {
		lora0 = &lora_loopback0;
	};

	chosen {
		zephyr,lora = &lora_loopback0;
	};

	lora_loopback0: lora {
		compatible = "lichen,lora-loopback";
		status = "okay";
	};
};
```

## src/main.c
```c
/* SPDX-License-Identifier: GPL-3.0-or-later */
/* SPDX-FileCopyrightText: The contributors to the LICHEN project */

/**
 * @file main.c
 * @brief ICMPv6 packet-path proof over real LICHEN_L2 and LoRa loopback.
 */

#include <zephyr/device.h>
#include <zephyr/kernel.h>
#include <zephyr/logging/log.h>
#include <zephyr/net/icmp.h>
#include <zephyr/net/net_if.h>
#include <zephyr/net/net_ip.h>
#include <zephyr/net/net_pkt.h>
#include <zephyr/net/socket.h>
#include <zephyr/sys/byteorder.h>
#include <zephyr/ztest.h>

#include "ipv6_addr.h"

#include <lichen/app_identity/app_identity.h>
#include <lichen/hal.h>

#include <string.h>

#include "lichen_l2.h"
#include "lora_l2.h"
#include "lora_loopback_test.h"
#include <lichen/tx_queue.h>

/* White-box fault injection target: the module-static TX queue in lora_l2.c. */
extern struct tx_queue tx_queue;

LOG_MODULE_REGISTER(ping_l2_test, LOG_LEVEL_INF);

#define PING_DATA      "LICHEN"
#define PING_DATA_SIZE (sizeof(PING_DATA) - 1)
#define UDP_TEST_PORT  56830

static const uint8_t coap_test_payload[] = {
	0x50, 0x02, 0x4c, 0x32, 0xff, 'o', 'k'
};

static const uint8_t test_seed[32] = {
	0x4c, 0x49, 0x43, 0x48, 0x45, 0x4e, 0x2d, 0x4c,
	0x32, 0x2d, 0x6c, 0x6f, 0x6f, 0x70, 0x62, 0x61,
	0x63, 0x6b, 0x2d, 0x70, 0x61, 0x74, 0x68, 0x2d,
	0x74, 0x65, 0x73, 0x74, 0x2d, 0x30, 0x30, 0x31,
};
static const uint8_t test_link_key[16] = {
	0x4c, 0x32, 0x2d, 0x6c, 0x69, 0x6e, 0x6b, 0x2d,
	0x6c, 0x6f, 0x6f, 0x70, 0x62, 0x61, 0x63, 0x6b,
};

static const struct device *lora_dev;
static struct net_if *test_iface;
static struct in6_addr test_ll_addr;
static struct in6_addr peer_ll_addr;
static uint8_t expected_packet[sizeof(struct net_ipv6_hdr) + 8 + PING_DATA_SIZE];
static size_t expected_packet_len;
static uint8_t expected_udp_packet[sizeof(struct net_ipv6_hdr) + 8 + sizeof(coap_test_payload)];
static size_t expected_udp_packet_len;
static uint8_t test_pubkey[32];

static void build_ping_packet(uint8_t *packet, size_t *packet_len);
static void build_udp_packet(uint8_t *packet, size_t *packet_len);

static void make_link_local_from_eui64(const uint8_t eui64[8],
				       struct in6_addr *addr)
{
	memset(addr, 0, sizeof(*addr));
	addr->s6_addr[0] = 0xfe;
	addr->s6_addr[1] = 0x80;
	memcpy(&addr->s6_addr[8], eui64, 8);
	addr->s6_addr[8] ^= 0x02;
}

static uint32_t checksum_add(const uint8_t *data, size_t len)
{
	uint32_t sum = 0;

	while (len > 1) {
		sum += ((uint16_t)data[0] << 8) | data[1];
		data += 2;
		len -= 2;
	}

	if (len > 0) {
		sum += (uint16_t)data[0] << 8;
	}

	return sum;
}

static uint16_t checksum_finish(uint32_t sum)
{
	while ((sum >> 16) != 0) {
		sum = (sum & 0xffff) + (sum >> 16);
	}

	return (uint16_t)~sum;
}

static uint16_t icmpv6_checksum(const struct net_ipv6_hdr *ipv6,
				const uint8_t *icmp,
				size_t icmp_len)
{
	uint8_t pseudo[8] = {
		(uint8_t)(icmp_len >> 24),
		(uint8_t)(icmp_len >> 16),
		(uint8_t)(icmp_len >> 8),
		(uint8_t)icmp_len,
		0,
		0,
		0,
		IPPROTO_ICMPV6,
	};
	uint32_t sum = 0;

	sum += checksum_add(ipv6->src, sizeof(ipv6->src));
	sum += checksum_add(ipv6->dst, sizeof(ipv6->dst));
	sum += checksum_add(pseudo, sizeof(pseudo));
	sum += checksum_add(icmp, icmp_len);

	return checksum_finish(sum);
}

static uint16_t udp_checksum(const struct net_ipv6_hdr *ipv6,
			     const uint8_t *udp,
			     size_t udp_len)
{
	uint8_t pseudo[8] = {
		(uint8_t)(udp_len >> 24),
		(uint8_t)(udp_len >> 16),
		(uint8_t)(udp_len >> 8),
		(uint8_t)udp_len,
		0,
		0,
		0,
		IPPROTO_UDP,
	};
	uint32_t sum = 0;
	uint16_t checksum;

	sum += checksum_add(ipv6->src, sizeof(ipv6->src));
	sum += checksum_add(ipv6->dst, sizeof(ipv6->dst));
	sum += checksum_add(pseudo, sizeof(pseudo));
	sum += checksum_add(udp, udp_len);

	checksum = checksum_finish(sum);
	return checksum == 0 ? 0xffff : checksum;
}

static void *ping_l2_setup(void)
{
	uint8_t eui64[8];
	struct in6_addr primary_addr;
	int ret;

	zassert_true(IS_ENABLED(CONFIG_LICHEN_L2), "CONFIG_LICHEN_L2 is disabled");
	zassert_false(IS_ENABLED(CONFIG_NET_L2_DUMMY), "dummy L2 bypass is enabled");
	ret = lichen_hal_lora_device_get(&lora_dev);
	zassert_equal(ret, 0, "failed to get HAL LoRa device: %d", ret);

	test_iface = net_if_get_first_by_type(&NET_L2_GET_NAME(lichen_l2));
	zassert_not_null(test_iface, "no default LICHEN interface");

	ret = lichen_lora_l2_copy_eui64(eui64);
	zassert_equal(ret, 0, "failed to copy L2 EUI-64: %d", ret);

	lichen_app_identity_test_reset();

	ret = lichen_l2_test_load_key(test_seed, test_pubkey);
	zassert_equal(ret, 0, "failed to load deterministic test key: %d", ret);
	ret = lichen_yggdrasil_addr(test_pubkey, &primary_addr);
	zassert_equal(ret, 0, "failed to derive primary address: %d", ret);
	zassert_not_null(net_if_ipv6_addr_lookup_by_iface(test_iface, &primary_addr),
			 "key load did not install primary address");

	ret = lichen_l2_test_load_link_key(test_link_key);
	zassert_equal(ret, 0, "failed to load deterministic link key: %d", ret);

	ret = lichen_peer_add(eui64, test_pubkey);
	zassert_equal(ret, 0, "failed to add self peer: %d", ret);

	make_link_local_from_eui64(eui64, &test_ll_addr);
	memcpy(&peer_ll_addr, &test_ll_addr, sizeof(peer_ll_addr));
	peer_ll_addr.s6_addr[15] ^= 0x01;

	if (net_if_ipv6_addr_lookup(&test_ll_addr, NULL) == NULL) {
		struct net_if_addr *ifaddr;

		ifaddr = net_if_ipv6_addr_add(test_iface, &test_ll_addr,
					      NET_ADDR_MANUAL, 0);
		zassert_not_null(ifaddr, "failed to add LICHEN link-local address");
	}

	ret = net_if_up(test_iface);
	zassert_true(ret == 0 || ret == -EALREADY, "failed to bring iface up: %d", ret);

	build_ping_packet(expected_packet, &expected_packet_len);
	build_udp_packet(expected_udp_packet, &expected_udp_packet_len);

	return NULL;
}

static void build_ping_packet(uint8_t *packet, size_t *packet_len)
{
	struct net_ipv6_hdr *ipv6 = (struct net_ipv6_hdr *)packet;
	uint8_t *icmp = packet + sizeof(struct net_ipv6_hdr);
	size_t icmp_len = 8 + PING_DATA_SIZE;

	memset(packet, 0, sizeof(struct net_ipv6_hdr) + icmp_len);
	ipv6->vtc = 0x60;
	ipv6->len = sys_cpu_to_be16((uint16_t)icmp_len);
	ipv6->nexthdr = IPPROTO_ICMPV6;
	ipv6->hop_limit = 64;
	memcpy(ipv6->src, test_ll_addr.s6_addr, sizeof(ipv6->src));
	memcpy(ipv6->dst, peer_ll_addr.s6_addr, sizeof(ipv6->dst));

	icmp[0] = NET_ICMPV6_ECHO_REQUEST;
	icmp[1] = 0;
	icmp[2] = 0;
	icmp[3] = 0;
	icmp[4] = 0x4c;
	icmp[5] = 0x49;
	icmp[6] = 0;
	icmp[7] = 1;
	memcpy(&icmp[8], PING_DATA, PING_DATA_SIZE);
	sys_put_be16(icmpv6_checksum(ipv6, icmp, icmp_len), &icmp[2]);

	*packet_len = sizeof(struct net_ipv6_hdr) + icmp_len;
}

static void build_udp_packet(uint8_t *packet, size_t *packet_len)
{
	struct net_ipv6_hdr *ipv6 = (struct net_ipv6_hdr *)packet;
	uint8_t *udp = packet + sizeof(struct net_ipv6_hdr);
	size_t udp_len = 8 + sizeof(coap_test_payload);

	memset(packet, 0, sizeof(struct net_ipv6_hdr) + udp_len);
	ipv6->vtc = 0x60;
	ipv6->len = sys_cpu_to_be16((uint16_t)udp_len);
	ipv6->nexthdr = IPPROTO_UDP;
	ipv6->hop_limit = 64;
	memcpy(ipv6->src, peer_ll_addr.s6_addr, sizeof(ipv6->src));
	memcpy(ipv6->dst, test_ll_addr.s6_addr, sizeof(ipv6->dst));

	sys_put_be16(UDP_TEST_PORT, &udp[0]);
	sys_put_be16(UDP_TEST_PORT, &udp[2]);
	sys_put_be16((uint16_t)udp_len, &udp[4]);
	udp[6] = 0;
	udp[7] = 0;
	memcpy(&udp[8], coap_test_payload, sizeof(coap_test_payload));
	sys_put_be16(udp_checksum(ipv6, udp, udp_len), &udp[6]);

	*packet_len = sizeof(struct net_ipv6_hdr) + udp_len;
}

static int send_l2_packet(const uint8_t *packet, size_t packet_len,
			  uint8_t next_header)
{
	struct net_pkt *pkt;

	pkt = net_pkt_alloc_with_buffer(test_iface, packet_len, AF_INET6,
					next_header, K_SECONDS(1));
	if (pkt == NULL) {
		return -ENOMEM;
	}

	if (net_pkt_write(pkt, packet, packet_len) < 0) {
		goto drop;
	}

	net_pkt_cursor_init(pkt);

	if (net_if_l2(test_iface)->send(test_iface, pkt) < 0) {
		goto drop;
	}

	return 0;

drop:
	net_pkt_unref(pkt);
	return -EIO;
}

static int bind_udp_observer(void)
{
	struct sockaddr_in6 addr = {
		.sin6_family = AF_INET6,
		.sin6_port = htons(UDP_TEST_PORT),
		.sin6_scope_id = net_if_get_by_iface(test_iface),
	};
	struct timeval timeout = {
		.tv_sec = 1,
		.tv_usec = 0,
	};
	int sock;
	int ret;

	memcpy(&addr.sin6_addr, &test_ll_addr, sizeof(addr.sin6_addr));
	sock = zsock_socket(AF_INET6, SOCK_DGRAM, IPPROTO_UDP);
	if (sock < 0) {
		return -errno;
	}

	ret = zsock_setsockopt(sock, SOL_SOCKET, SO_RCVTIMEO,
			       &timeout, sizeof(timeout));
	if (ret < 0) {
		ret = -errno;
		goto fail;
	}

	ret = zsock_bind(sock, (const struct sockaddr *)&addr, sizeof(addr));
	if (ret < 0) {
		ret = -errno;
		goto fail;
	}

	return sock;

fail:
	(void)zsock_close(sock);
	return ret;
}

static int recv_udp_observer(int sock, uint8_t *buf, size_t buf_len)
{
	struct sockaddr_in6 src;
	socklen_t src_len = sizeof(src);
	int ret;

	ret = zsock_recvfrom(sock, buf, buf_len, 0,
			     (struct sockaddr *)&src, &src_len);
	if (ret < 0) {
		return -errno;
	}

	if (src.sin6_port != htons(UDP_TEST_PORT)) {
		return -EPROTO;
	}

	if (memcmp(&src.sin6_addr, &peer_ll_addr, sizeof(peer_ll_addr)) != 0) {
		return -EADDRNOTAVAIL;
	}

	return ret;
}

static bool packet_path_observed(const struct lichen_l2_test_stats *l2_before,
				 const struct lora_loopback_test_stats *loop_before,
				 const uint8_t *expected,
				 size_t expected_len)
{
	struct lichen_l2_test_stats l2_now;
	struct lora_loopback_test_stats loop_now;

	lichen_l2_test_get_stats(&l2_now);
	lora_loopback_test_get_stats(lora_dev, &loop_now);

	return l2_now.tx_packets > l2_before->tx_packets &&
	       l2_now.rx_frames > l2_before->rx_frames &&
	       l2_now.rx_injected_packets > l2_before->rx_injected_packets &&
	       loop_now.sent_packets > loop_before->sent_packets &&
	       loop_now.received_packets > loop_before->received_packets &&
	       l2_now.last_injected_len == expected_len &&
	       memcmp(l2_now.last_injected, expected, expected_len) == 0;
}

static bool wait_for_packet_path(const struct lichen_l2_test_stats *l2_before,
				 const struct lora_loopback_test_stats *loop_before,
				 const uint8_t *expected,
				 size_t expected_len)
{
	for (int i = 0; i < 500; i++) {
		if (packet_path_observed(l2_before, loop_before, expected,
					 expected_len)) {
			return true;
		}
		k_msleep(10);
	}

	return false;
}

ZTEST(ping_l2, test_full_l2_loopback_ping)
{
	struct lichen_l2_test_stats l2_before;
	struct lora_loopback_test_stats loop_before;
	int ret;

	/* Let startup MLD/ND frames drain before measuring the packet under test. */
	k_sleep(K_MSEC(100));

	lichen_l2_test_reset_stats();
	lora_loopback_test_reset(lora_dev);

	lichen_l2_test_get_stats(&l2_before);
	lora_loopback_test_get_stats(lora_dev, &loop_before);

	ret = send_l2_packet(expected_packet, expected_packet_len, IPPROTO_ICMPV6);
	zassert_equal(ret, 0, "failed to send Echo Request packet: %d", ret);

	zassert_true(wait_for_packet_path(&l2_before, &loop_before,
					  expected_packet, expected_packet_len),
		     "full LICHEN_L2 loopback packet path was not observed");
}

ZTEST(ping_l2, test_l2_publish_app_identity_uses_link_context_key)
{
	struct lichen_app_identity_self self;

	lichen_app_identity_test_reset();
	zassert_ok(lichen_l2_publish_app_identity("LICHEN", "LICHEN"));
	zassert_ok(lichen_app_identity_copy_self(&self));
	zassert_true(self.has_public_key);
	zassert_mem_equal(self.public_key, test_pubkey, sizeof(test_pubkey));
	zassert_mem_equal(self.display_name, "LICHEN", sizeof("LICHEN"));
	zassert_mem_equal(self.firmware_name, "LICHEN", sizeof("LICHEN"));
}

ZTEST(ping_l2, test_udp_payload_reaches_socket_after_l2_injection)
{
	struct lichen_l2_test_stats l2_before;
	struct lora_loopback_test_stats loop_before;
	uint8_t rx_buf[sizeof(coap_test_payload)];
	int sock;
	int ret;

	k_sleep(K_MSEC(100));

	sock = bind_udp_observer();
	zassert_true(sock >= 0, "failed to bind UDP observer: %d", sock);

	lichen_l2_test_reset_stats();
	lora_loopback_test_reset(lora_dev);

	lichen_l2_test_get_stats(&l2_before);
	lora_loopback_test_get_stats(lora_dev, &loop_before);

	ret = send_l2_packet(expected_udp_packet, expected_udp_packet_len,
			     IPPROTO_UDP);
	if (ret != 0) {
		(void)zsock_close(sock);
	}
	zassert_equal(ret, 0, "failed to send UDP packet: %d", ret);

	ret = recv_udp_observer(sock, rx_buf, sizeof(rx_buf));
	(void)zsock_close(sock);

	zassert_equal(ret, sizeof(coap_test_payload),
		      "UDP observer did not receive payload: %d", ret);
	zassert_mem_equal(rx_buf, coap_test_payload, sizeof(coap_test_payload));
	zassert_true(wait_for_packet_path(&l2_before, &loop_before,
					  expected_udp_packet,
					  expected_udp_packet_len),
		     "UDP packet was not observed through full L2 injection path");
}

ZTEST(ping_l2, test_adaptive_duty_permille_matches_ccp13_vectors)
{
	static const struct {
		const char *name;
		uint8_t density;
		uint8_t region;
		uint16_t expected_permille;
	} vectors[] = {
		{ "sparse_region0", 0, 0, 20 },
		{ "sparse_boundary_region0", 2, 0, 20 },
		{ "moderate_start_region0", 3, 0, 10 },
		{ "moderate_end_region0", 8, 0, 10 },
		{ "dense_start_region0", 9, 0, 5 },
		{ "dense_extreme_region0", 255, 0, 5 },
		{ "sparse_region1", 0, 1, 50 },
		{ "moderate_region1", 5, 1, 20 },
		{ "dense_start_region1", 9, 1, 10 },
		{ "dense_extreme_region1", 200, 1, 10 },
	};

	for (size_t i = 0; i < ARRAY_SIZE(vectors); i++) {
		zassert_equal(adaptive_duty_permille(vectors[i].density,
						     vectors[i].region),
			      vectors[i].expected_permille,
			      "vector %s failed", vectors[i].name);
	}
}

ZTEST(ping_l2, test_adaptive_duty_wiring_tracks_density)
{
	if (!IS_ENABLED(CONFIG_LICHEN_DUTY_CYCLE)) {
		ztest_test_skip();
	}

	uint16_t at_boot;
	uint16_t dense;
	uint16_t moderate;

	/* Default CONFIG_LICHEN_OP_CLASS_ID=0 is US/CA (duty_region 1);
	 * boot density 0 is sparse -> 50 permille per ccp13.json. */
	at_boot = lichen_lora_l2_current_duty_permille();

	lichen_lora_l2_set_density(9);
	dense = lichen_lora_l2_current_duty_permille();
	lichen_lora_l2_set_density(5);
	moderate = lichen_lora_l2_current_duty_permille();
	lichen_lora_l2_set_density(0);

	zassert_equal(at_boot, 50, "boot budget should be sparse US 50 permille");
	zassert_equal(dense, 10, "density 9 must shrink budget to 10 permille");
	zassert_equal(moderate, 20, "density 5 must yield 20 permille");
	zassert_equal(lichen_lora_l2_current_duty_permille(), 50,
		      "restore to sparse budget failed");
}

ZTEST(ping_l2, test_queue_stats_accessor_lifecycle)
{
	struct tx_queue_stats stats;
	int ret;

	/* Readable while the module is running. */
	ret = lichen_lora_l2_queue_stats_get(&stats);
	zassert_equal(ret, 0, "stats read failed while running: %d", ret);

	ret = net_if_down(test_iface);
	zassert_equal(ret, 0, "net_if_down failed: %d", ret);

	/* Still readable while merely stopped. */
	ret = lichen_lora_l2_queue_stats_get(&stats);
	zassert_equal(ret, 0, "stats read failed while stopped: %d", ret);

	/* Destroying the queue must fully quiesce the accessor instead of
	 * letting it read torn-down state. */
	ret = lichen_lora_l2_deinit();
	zassert_equal(ret, 0, "deinit failed: %d", ret);
	ret = lichen_lora_l2_queue_stats_get(&stats);
	zassert_equal(ret, -ENODEV, "stats must reject after destroy: %d", ret);

	/* Re-initialization restores a usable queue only after a clean
	 * destroy, proving the accessor serialization held. */
	ret = lichen_lora_l2_init();
	zassert_equal(ret, 0, "re-init failed: %d", ret);
	ret = lichen_lora_l2_queue_stats_get(&stats);
	zassert_equal(ret, 0, "stats read failed after re-init: %d", ret);

	ret = net_if_up(test_iface);
	zassert_true(ret == 0 || ret == -EALREADY, "net_if_up failed: %d", ret);
}

ZTEST(ping_l2, test_disable_retries_incomplete_queue_destruction)
{
	struct tx_queue_stats stats;
	struct lichen_frame_handle saved_handle;
	uint8_t payload = 0xa5;
	int slot = -1;
	int ret;

	k_sleep(K_MSEC(100));

	/* Stop the module while the net iface stays up: the common disable
	 * path below must recognize the pending destroy retry instead of
	 * reporting a complete teardown. */
	ret = lichen_lora_l2_stop();
	zassert_equal(ret, 0, "stop failed: %d", ret);

	/* Queue a packet and corrupt its pool handle so queue destruction
	 * fails the way a mid-teardown failure would. */
	ret = tx_queue_push(&tx_queue, &payload, sizeof(payload),
			    TX_PRIORITY_BULK, k_uptime_get_32() + 60000U);
	zassert_equal(ret, 0, "queue push failed: %d", ret);
	for (int i = 0; i < TX_QUEUE_SIZE; i++) {
		if (tx_queue.entries[i].valid) {
			slot = i;
			break;
		}
	}
	zassert_true(slot >= 0, "queued entry not found");
	saved_handle = tx_queue.entries[slot].buffer;
	tx_queue.entries[slot].buffer.generation++;

	/* First teardown attempt: destroy fails, retry stays pending. */
	ret = lichen_lora_l2_deinit();
	zassert_true(ret < 0, "deinit unexpectedly succeeded with corrupted queue");
	zassert_true(lichen_lora_l2_needs_destroy_retry(),
		     "destroy retry flag not set");
	zassert_equal(lichen_lora_l2_queue_stats_get(&stats), -ECANCELED,
		      "stats must reject while destroy retry is pending");
	zassert_equal(lichen_lora_l2_init(), -ECANCELED,
		      "init must refuse incomplete teardown");

	/* Repair the handle; the disable path must retry the deinit and
	 * complete the queue destruction. */
	tx_queue.entries[slot].buffer = saved_handle;
	ret = net_if_down(test_iface);
	zassert_equal(ret, 0, "net_if_down did not complete teardown: %d", ret);
	zassert_false(lichen_lora_l2_needs_destroy_retry(),
		      "disable did not complete the destroy retry");

	/* A completed destroy leaves the module re-initializable. */
	zassert_ok(lichen_lora_l2_init(), "re-init after destroy retry failed");
	zassert_ok(lichen_lora_l2_queue_stats_get(&stats),
		   "stats unusable after re-init");

	ret = net_if_up(test_iface);
	zassert_true(ret == 0 || ret == -EALREADY, "net_if_up failed: %d", ret);
}

ZTEST_SUITE(ping_l2, NULL, ping_l2_setup, NULL, NULL, NULL);
```
