## CMakeLists.txt
```
# SPDX-License-Identifier: GPL-3.0-or-later
# SPDX-FileCopyrightText: The contributors to the LICHEN project

cmake_minimum_required(VERSION 3.20.0)
find_package(Zephyr REQUIRED HINTS $ENV{ZEPHYR_BASE})
project(hal_serial_precedence)

target_sources(app PRIVATE src/main.c)
```

## prj.conf
```kconfig
# SPDX-License-Identifier: GPL-3.0-or-later
# SPDX-FileCopyrightText: The contributors to the LICHEN project

CONFIG_ZTEST=y
CONFIG_LICHEN=y
CONFIG_LICHEN_HAL=y
CONFIG_LICHEN_HAS_SERIAL_LOCAL=y
CONFIG_LICHEN_IPV6=n
CONFIG_LICHEN_BOARD_NAME="hal-serial-precedence-test"
CONFIG_MAIN_STACK_SIZE=2048

# C Safety Policy - spec/appendix-c-safety.md
CONFIG_STACK_CANARIES=y
CONFIG_STACK_SENTINEL=y
CONFIG_ASSERT=y
CONFIG_ASSERT_VERBOSE=y
```

## boards/r1_neo_nrf52840.conf
```kconfig
# SPDX-License-Identifier: GPL-3.0-or-later
# SPDX-FileCopyrightText: The contributors to the LICHEN project

# R1 Neo serial precedence test - validates USB CDC ACM device.
# Uses the same USB device stack already enabled in the board defconfig.
```

## boards/qemu_x86_console.overlay
```dts
/* SPDX-License-Identifier: GPL-3.0-or-later */
/* SPDX-FileCopyrightText: The contributors to the LICHEN project */

/ {
	chosen {
		/delete-property/ zephyr,uart-pipe;
		/delete-property/ zephyr,shell-uart;
		zephyr,console = &uart0;
	};
};
```

## boards/qemu_x86_native_uart.overlay
```dts
/* SPDX-License-Identifier: GPL-3.0-or-later */
/* SPDX-FileCopyrightText: The contributors to the LICHEN project */

/ {
	chosen {
		lichen,native-uart = &uart1;
		zephyr,uart-pipe = &uart0;
		zephyr,slip-uart = &uart0;
		zephyr,shell-uart = &uart0;
		zephyr,console = &uart0;
	};
};
```

## boards/qemu_x86_shell_uart.overlay
```dts
/* SPDX-License-Identifier: GPL-3.0-or-later */
/* SPDX-FileCopyrightText: The contributors to the LICHEN project */

/ {
	chosen {
		/delete-property/ zephyr,uart-pipe;
		zephyr,shell-uart = &uart1;
		zephyr,console = &uart0;
	};
};
```

## boards/qemu_x86_slip_uart.overlay
```dts
/* SPDX-License-Identifier: GPL-3.0-or-later */
/* SPDX-FileCopyrightText: The contributors to the LICHEN project */

/ {
	chosen {
		/delete-property/ zephyr,uart-pipe;
		zephyr,slip-uart = &uart1;
		zephyr,shell-uart = &uart0;
		zephyr,console = &uart0;
	};
};
```

## boards/qemu_x86_uart_pipe.overlay
```dts
/* SPDX-License-Identifier: GPL-3.0-or-later */
/* SPDX-FileCopyrightText: The contributors to the LICHEN project */

/ {
	chosen {
		zephyr,uart-pipe = &uart1;
		zephyr,slip-uart = &uart0;
		zephyr,shell-uart = &uart0;
		zephyr,console = &uart0;
	};
};
```

## boards/r1_neo_nrf52840.overlay
```dts
/* SPDX-License-Identifier: GPL-3.0-or-later */
/* SPDX-FileCopyrightText: The contributors to the LICHEN project */

/*
 * R1 Neo serial precedence test overlay.
 * Sets lichen,native-uart to the USB CDC ACM device for explicit precedence
 * testing, matching the pattern used by the puck application.
 */
/ {
	chosen {
		lichen,native-uart = &cdc_acm_uart0;
	};
};
```

## src/main.c
```c
/* SPDX-License-Identifier: GPL-3.0-or-later */
/* SPDX-FileCopyrightText: The contributors to the LICHEN project */

#include <errno.h>

#include <zephyr/device.h>
#include <zephyr/devicetree.h>
#include <zephyr/ztest.h>

#include <lichen/hal.h>

#if DT_NODE_HAS_STATUS(DT_CHOSEN(lichen_native_uart), okay)
#define TEST_EXPECTED_SERIAL_NODE DT_CHOSEN(lichen_native_uart)
#define TEST_EXPECTED_SERIAL_CHOSEN "lichen,native-uart"
#elif DT_NODE_HAS_STATUS(DT_CHOSEN(zephyr_uart_pipe), okay)
#define TEST_EXPECTED_SERIAL_NODE DT_CHOSEN(zephyr_uart_pipe)
#define TEST_EXPECTED_SERIAL_CHOSEN "zephyr,uart-pipe"
#elif DT_NODE_HAS_STATUS(DT_CHOSEN(zephyr_slip_uart), okay)
#define TEST_EXPECTED_SERIAL_NODE DT_CHOSEN(zephyr_slip_uart)
#define TEST_EXPECTED_SERIAL_CHOSEN "zephyr,slip-uart"
#elif DT_NODE_HAS_STATUS(DT_CHOSEN(zephyr_shell_uart), okay)
#define TEST_EXPECTED_SERIAL_NODE DT_CHOSEN(zephyr_shell_uart)
#define TEST_EXPECTED_SERIAL_CHOSEN "zephyr,shell-uart"
#elif DT_NODE_HAS_STATUS(DT_CHOSEN(zephyr_console), okay)
#define TEST_EXPECTED_SERIAL_NODE DT_CHOSEN(zephyr_console)
#define TEST_EXPECTED_SERIAL_CHOSEN "zephyr,console"
#else
#error "hal_serial_precedence requires an okay chosen serial-local device"
#endif

ZTEST(hal_serial_precedence, test_serial_local_chosen_precedence)
{
	const struct lichen_hal_capabilities *caps = lichen_hal_capabilities_get();
	const struct device *expected = DEVICE_DT_GET(TEST_EXPECTED_SERIAL_NODE);
	const struct device *actual = NULL;

	zassert_true(IS_ENABLED(CONFIG_LICHEN_HAS_SERIAL_LOCAL));
	zassert_true((caps->flags & LICHEN_HAL_CAP_SERIAL_LOCAL) != 0U);
	zassert_true(device_is_ready(expected),
		     "%s expected device must be ready",
		     TEST_EXPECTED_SERIAL_CHOSEN);

	zassert_equal(lichen_hal_serial_local_status(), 0);
	zassert_equal(lichen_hal_capability_status(LICHEN_HAL_CAP_SERIAL_LOCAL), 0);
	zassert_equal(lichen_hal_serial_device_get(&actual), 0);
	zassert_not_null(actual);
	zassert_true(actual == expected,
		     "HAL selected %s instead of %s",
		     actual->name, expected->name);

	actual = (const struct device *)0x1;
	zassert_equal(lichen_hal_serial_device_get(NULL), -EINVAL);
	zassert_equal(lichen_hal_serial_device_get(&actual), 0);
	zassert_true(actual == expected);
}

ZTEST_SUITE(hal_serial_precedence, NULL, NULL, NULL, NULL, NULL);
```
