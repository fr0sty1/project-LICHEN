## lichen/tests/link_epoch/testcase.yaml
```yaml
# SPDX-License-Identifier: GPL-3.0-or-later
# SPDX-FileCopyrightText: The contributors to the LICHEN project

tests:
  lichen.link.epoch_persist:
    tags:
      - lichen
      - link
      - settings
      - persistence
    platform_allow:
      - native_sim
      - native_sim/native/64
    integration_platforms:
      - native_sim
      - native_sim/native/64
```

## lichen/tests/meshcore_adapter/testcase.yaml
```yaml
# SPDX-License-Identifier: GPL-3.0-or-later
# SPDX-FileCopyrightText: The contributors to the LICHEN project

tests:
  net.lichen.meshcore_adapter:
    platform_allow:
      - native_sim
      - native_sim/native/64
    tags: meshcore
  net.lichen.meshcore_adapter.identity:
    platform_allow:
      - native_sim
      - native_sim/native/64
    tags: meshcore app-identity
    extra_args:
      - CONF_FILE=prj.conf;prj_identity.conf
```

## lichen/tests/meshcore_ble/testcase.yaml
```yaml
# SPDX-License-Identifier: GPL-3.0-or-later
# SPDX-FileCopyrightText: The contributors to the LICHEN project

tests:
  net.lichen.meshcore_ble:
    platform_allow:
      - native_sim
      - native_sim/native/64
    tags: bluetooth meshcore
```

## lichen/tests/meshcore_codec/testcase.yaml
```yaml
# SPDX-License-Identifier: GPL-3.0-or-later
# SPDX-FileCopyrightText: The contributors to the LICHEN project

tests:
  net.lichen.meshcore_codec:
    tags:
      - lichen
      - meshcore
      - codec
    platform_allow:
      - native_sim
      - qemu_x86
    integration_platforms:
      - native_sim
```

## lichen/tests/meshcore_gateway_adapter/testcase.yaml
```yaml
# SPDX-License-Identifier: GPL-3.0-or-later
# SPDX-FileCopyrightText: The contributors to the LICHEN project

tests:
  net.lichen.meshcore_gateway_adapter:
    platform_allow:
      - native_sim
      - native_sim/native/64
    tags: meshcore gateway
  net.lichen.meshcore_gateway_adapter.settings_nvs:
    platform_allow:
      - native_sim
      - native_sim/native/64
      - qemu_x86
    integration_platforms:
      - native_sim
      - native_sim/native/64
    tags: meshcore gateway settings nvs
    extra_args:
      - CONF_FILE=prj.conf;prj_settings_nvs.conf
```

## lichen/tests/meshtastic_ble/testcase.yaml
```yaml
common:
  tags:
    - lichen
    - meshtastic
    - bluetooth
tests:
  lichen.meshtastic_ble:
    platform_allow:
      - native_sim/native/64
```

## lichen/tests/meshtastic_gateway_adapter/testcase.yaml
```yaml
common:
  tags:
    - lichen
    - meshtastic
    - gateway
tests:
  net.lichen.meshtastic_gateway_adapter.native:
    platform_allow:
      - native_sim
    integration_platforms:
      - native_sim
    extra_configs:
      - CONFIG_BT=y
      - CONFIG_BT_PERIPHERAL=y
      - CONFIG_BT_MAX_CONN=1
      - CONFIG_LORA_LICHEN_MESHTASTIC_BLE=y
  net.lichen.meshtastic_gateway_adapter.qemu:
    platform_allow:
      - qemu_x86
    integration_platforms:
      - qemu_x86
    extra_configs:
      - CONFIG_NET_TEST=y
      - CONFIG_LICHEN_MESHTASTIC_GATEWAY_ADAPTER_TEST_SURFACE=y
```

## lichen/tests/native_init/testcase.yaml
```yaml
# SPDX-License-Identifier: GPL-3.0-or-later
# SPDX-FileCopyrightText: The contributors to the LICHEN project

tests:
  net.lichen.native_init.no_serial:
    tags:
      - net
      - lichen
      - native
      - hal
    platform_allow:
      - qemu_x86
    integration_platforms:
      - qemu_x86
    extra_configs:
      - CONFIG_LICHEN_HAS_SERIAL_LOCAL=n
  net.lichen.native_init.native_uart:
    tags:
      - net
      - lichen
      - native
      - hal
    platform_allow:
      - qemu_x86
    integration_platforms:
      - qemu_x86
    extra_args:
      - DTC_OVERLAY_FILE=../hal_serial_precedence/boards/qemu_x86_native_uart.overlay
    extra_configs:
      - CONFIG_LICHEN_HAS_SERIAL_LOCAL=y
  net.lichen.native_init.uart_pipe:
    tags:
      - net
      - lichen
      - native
      - hal
    platform_allow:
      - qemu_x86
    integration_platforms:
      - qemu_x86
    extra_args:
      - DTC_OVERLAY_FILE=../hal_serial_precedence/boards/qemu_x86_uart_pipe.overlay
    extra_configs:
      - CONFIG_LICHEN_HAS_SERIAL_LOCAL=y
  net.lichen.native_init.slip_uart:
    tags:
      - net
      - lichen
      - native
      - hal
    platform_allow:
      - qemu_x86
    integration_platforms:
      - qemu_x86
    extra_args:
      - DTC_OVERLAY_FILE=../hal_serial_precedence/boards/qemu_x86_slip_uart.overlay
    extra_configs:
      - CONFIG_LICHEN_HAS_SERIAL_LOCAL=y
```

## lichen/tests/native_parse/testcase.yaml
```yaml
# SPDX-License-Identifier: GPL-3.0-or-later
# SPDX-FileCopyrightText: The contributors to the LICHEN project

tests:
  net.lichen.native_parse:
    tags:
      - net
      - lichen
      - native
      - cbor
    platform_allow:
      - qemu_x86
    integration_platforms:
      - qemu_x86
```

## lichen/tests/nvs_persistence/testcase.yaml
```yaml
# SPDX-License-Identifier: GPL-3.0-or-later
# SPDX-FileCopyrightText: The contributors to the LICHEN project

# Test NVS persistence using the flash simulator.
#
# Within a single run, this test:
#   1. Writes values to NVS/settings
#   2. Unmounts and remounts NVS (simulating restart)
#   3. Verifies values persist
#
# For actual file persistence testing across binary restarts, run:
#   ./build/zephyr/zephyr.exe --flash=test_flash.bin
#   # First run writes values and exits
#   ./build/zephyr/zephyr.exe --flash=test_flash.bin
#   # Second run should read persisted values
#
# To erase flash at startup:
#   ./build/zephyr/zephyr.exe --flash=test_flash.bin --flash_erase
#
# To remove flash file on exit:
#   ./build/zephyr/zephyr.exe --flash=test_flash.bin --flash_rm

tests:
  fs.lichen.nvs_persistence:
    tags:
      - lichen
      - nvs
      - settings
      - persistence
    platform_allow:
      - native_sim
      - native_sim/native/64
    integration_platforms:
      - native_sim
      - native_sim/native/64
```

## lichen/tests/oscore/testcase.yaml
```yaml
# SPDX-License-Identifier: GPL-3.0-or-later
# SPDX-FileCopyrightText: The contributors to the LICHEN project

tests:
  net.lichen.oscore:
    tags:
      - net
      - lichen
      - oscore
    platform_allow:
      - native_sim
      - native_sim/native/64
      - qemu_x86
    integration_platforms:
      - native_sim
      - native_sim/native/64
```

## lichen/tests/ping_l2/testcase.yaml
```yaml
# SPDX-License-Identifier: GPL-3.0-or-later
# SPDX-FileCopyrightText: The contributors to the LICHEN project

tests:
  net.lichen.ping_l2_full_path:
    tags:
      - net
      - icmpv6
      - lichen
      - l2
    platform_allow:
      - native_sim
      - native_sim/native/64
    integration_platforms:
      - native_sim
      - native_sim/native/64
    extra_configs:
      # False positive with CONFIG_STACK_CANARIES on native_sim: Zephyr seeds
      # __stack_chk_guard in z_cstart (on a Zephyr thread) after the host
      # runner's boot shim already stored the old guard, and this suite idles
      # mid-test, returning through nsif_cpu0_boot -> K_ERR_STACK_CHK_FAIL.
      # Canaries stay enabled for hardware builds via prj.conf.
      - CONFIG_STACK_CANARIES=n
```

## lichen/tests/puck_location/testcase.yaml
```yaml
# SPDX-License-Identifier: GPL-3.0-or-later
# SPDX-FileCopyrightText: The contributors to the LICHEN project

tests:
  app.puck.location_provider:
    tags:
      - lichen
      - puck
      - location
      - gnss
    platform_allow:
      - native_sim
      - native_sim/native/64
      - qemu_x86
    integration_platforms:
      - native_sim
      - native_sim/native/64
      - qemu_x86
```

## lichen/tests/routing_announce/testcase.yaml
```yaml
common:
  tags:
    - lichen
    - routing
tests:
  net.lichen.routing_announce:
    platform_allow:
      - native_sim
      - native_sim/native/64
      - qemu_x86
    integration_platforms:
      - native_sim
      - native_sim/native/64
      - qemu_x86
```

## lichen/tests/routing_gpsr/testcase.yaml
```yaml
common:
  tags:
    - lichen
    - routing
tests:
  net.lichen.routing_gpsr:
    platform_allow:
      - native_sim
      - qemu_x86
    integration_platforms:
      - native_sim
      - qemu_x86
```

## lichen/tests/rpl_routing/testcase.yaml
```yaml
common:
  tags:
    - lichen
    - rpl
    - routing
tests:
  net.lichen.rpl_routing:
    platform_allow:
      - native_sim
      - native_sim/native/64
    integration_platforms:
      - native_sim/native/64
```

## lichen/tests/schc_generic/testcase.yaml
```yaml
# SPDX-License-Identifier: GPL-3.0-or-later
# SPDX-FileCopyrightText: The contributors to the LICHEN project

tests:
  net.schc.generic:
    tags:
      - net
      - schc
    platform_allow:
      - native_sim
      - qemu_x86
    integration_platforms:
      - native_sim
```

## lichen/tests/slip_transport/testcase.yaml
```yaml
# SPDX-License-Identifier: GPL-3.0-or-later
# SPDX-FileCopyrightText: The contributors to the LICHEN project

tests:
  lichen.transport.slip:
    tags: slip transport lci serial
    platform_allow:
      - native_sim
      - native_sim/native/64
```

## lichen/tests/util/testcase.yaml
```yaml
# SPDX-License-Identifier: GPL-3.0-or-later
# SPDX-FileCopyrightText: The contributors to the LICHEN project

tests:
  lichen.util.sha256:
    tags:
      - lichen
      - crypto
    platform_allow:
      - native_sim
      - qemu_x86
    integration_platforms:
      - native_sim
```

## lichen/west.yml
```yaml
manifest:
  version: "0.13"

  self:
    path: lichen

  defaults:
    remote: zephyrproject

  remotes:
    - name: zephyrproject
      url-base: https://github.com/zephyrproject-rtos

  projects:
    - name: zephyr
      remote: zephyrproject
      revision: v3.7.0
      import: true
```

## lichen/zephyr/Kconfig
```kconfig
# SPDX-License-Identifier: GPL-3.0-or-later
# SPDX-FileCopyrightText: The contributors to the LICHEN project

# LICHEN Zephyr module Kconfig extension

rsource "../drivers/Kconfig"
rsource "../lib/Kconfig"
rsource "../subsys/Kconfig"

# L2 integration from bridge-zephyr (Zephyr network stack integration)
rsource "../../firmware/bridge-zephyr/subsys/lichen/Kconfig"
```

## twister-out.2/native_sim/net.lichen.coap_keys.store/Kconfig/soc/Kconfig
```kconfig
# Load Zephyr SoC Kconfig descriptions.
osource "/mnt/lichen-zephyr/work/zephyr/soc/xlnx/zynqmp/Kconfig"
osource "/mnt/lichen-zephyr/work/zephyr/soc/xlnx/zynq7000/Kconfig"
osource "/mnt/lichen-zephyr/work/zephyr/soc/xen/Kconfig"
osource "/mnt/lichen-zephyr/work/zephyr/soc/ti/simplelink/Kconfig"
osource "/mnt/lichen-zephyr/work/zephyr/soc/ti/lm3s6965/Kconfig"
osource "/mnt/lichen-zephyr/work/zephyr/soc/ti/k3/Kconfig"
osource "/mnt/lichen-zephyr/work/zephyr/soc/telink/tlsr/Kconfig"
osource "/mnt/lichen-zephyr/work/zephyr/soc/starfive/jh71xx/Kconfig"
osource "/mnt/lichen-zephyr/work/zephyr/soc/st/stm32/Kconfig"
osource "/mnt/lichen-zephyr/work/zephyr/soc/snps/qemu_arc/Kconfig"
osource "/mnt/lichen-zephyr/work/zephyr/soc/snps/nsim/arc_v/Kconfig"
osource "/mnt/lichen-zephyr/work/zephyr/soc/snps/nsim/arc_classic/Kconfig"
osource "/mnt/lichen-zephyr/work/zephyr/soc/snps/hsdk4xd/Kconfig"
osource "/mnt/lichen-zephyr/work/zephyr/soc/snps/hsdk/Kconfig"
osource "/mnt/lichen-zephyr/work/zephyr/soc/snps/emsk/Kconfig"
osource "/mnt/lichen-zephyr/work/zephyr/soc/snps/emsdp/Kconfig"
osource "/mnt/lichen-zephyr/work/zephyr/soc/snps/arc_iot/Kconfig"
osource "/mnt/lichen-zephyr/work/zephyr/soc/silabs/Kconfig"
osource "/mnt/lichen-zephyr/work/zephyr/soc/sifive/sifive_freedom/Kconfig"
osource "/mnt/lichen-zephyr/work/zephyr/soc/rockchip/Kconfig"
osource "/mnt/lichen-zephyr/work/zephyr/soc/renode/riscv_virtual/Kconfig"
osource "/mnt/lichen-zephyr/work/zephyr/soc/renesas/smartbond/Kconfig"
osource "/mnt/lichen-zephyr/work/zephyr/soc/renesas/rzt2m/Kconfig"
osource "/mnt/lichen-zephyr/work/zephyr/soc/renesas/rcar/Kconfig"
osource "/mnt/lichen-zephyr/work/zephyr/soc/renesas/ra/Kconfig"
osource "/mnt/lichen-zephyr/work/zephyr/soc/raspberrypi/Kconfig"
osource "/mnt/lichen-zephyr/work/zephyr/soc/quicklogic/eos_s3/Kconfig"
osource "/mnt/lichen-zephyr/work/zephyr/soc/qemu/virt_riscv/Kconfig"
osource "/mnt/lichen-zephyr/work/zephyr/soc/qemu/malta/Kconfig"
osource "/mnt/lichen-zephyr/work/zephyr/soc/openisa/rv32m1/Kconfig"
osource "/mnt/lichen-zephyr/work/zephyr/soc/nxp/s32/Kconfig"
osource "/mnt/lichen-zephyr/work/zephyr/soc/nxp/rw/Kconfig"
osource "/mnt/lichen-zephyr/work/zephyr/soc/nxp/mcx/Kconfig"
osource "/mnt/lichen-zephyr/work/zephyr/soc/nxp/lpc/Kconfig"
osource "/mnt/lichen-zephyr/work/zephyr/soc/nxp/layerscape/Kconfig"
osource "/mnt/lichen-zephyr/work/zephyr/soc/nxp/kinetis/Kconfig"
osource "/mnt/lichen-zephyr/work/zephyr/soc/nxp/imxrt/Kconfig"
osource "/mnt/lichen-zephyr/work/zephyr/soc/nxp/imx/Kconfig"
osource "/mnt/lichen-zephyr/work/zephyr/soc/nuvoton/numicro/Kconfig"
osource "/mnt/lichen-zephyr/work/zephyr/soc/nuvoton/numaker/Kconfig"
osource "/mnt/lichen-zephyr/work/zephyr/soc/nuvoton/npcx/Kconfig"
osource "/mnt/lichen-zephyr/work/zephyr/soc/nordic/Kconfig"
osource "/mnt/lichen-zephyr/work/zephyr/soc/neorv32/Kconfig"
osource "/mnt/lichen-zephyr/work/zephyr/soc/native/inf_clock/Kconfig"
osource "/mnt/lichen-zephyr/work/zephyr/soc/microchip/miv/Kconfig"
osource "/mnt/lichen-zephyr/work/zephyr/soc/microchip/mec/Kconfig"
osource "/mnt/lichen-zephyr/work/zephyr/soc/mediatek/mtk_adsp/Kconfig"
osource "/mnt/lichen-zephyr/work/zephyr/soc/lowrisc/opentitan/Kconfig"
osource "/mnt/lichen-zephyr/work/zephyr/soc/litex/litex_vexriscv/Kconfig"
osource "/mnt/lichen-zephyr/work/zephyr/soc/ite/ec/Kconfig"
osource "/mnt/lichen-zephyr/work/zephyr/soc/intel/raptor_lake/Kconfig"
osource "/mnt/lichen-zephyr/work/zephyr/soc/intel/lakemont/Kconfig"
osource "/mnt/lichen-zephyr/work/zephyr/soc/intel/intel_socfpga_std/Kconfig"
osource "/mnt/lichen-zephyr/work/zephyr/soc/intel/intel_socfpga/Kconfig"
osource "/mnt/lichen-zephyr/work/zephyr/soc/intel/intel_niosv/Kconfig"
osource "/mnt/lichen-zephyr/work/zephyr/soc/intel/intel_ish/Kconfig"
osource "/mnt/lichen-zephyr/work/zephyr/soc/intel/intel_adsp/Kconfig"
osource "/mnt/lichen-zephyr/work/zephyr/soc/intel/elkhart_lake/Kconfig"
osource "/mnt/lichen-zephyr/work/zephyr/soc/intel/atom/Kconfig"
osource "/mnt/lichen-zephyr/work/zephyr/soc/intel/apollo_lake/Kconfig"
osource "/mnt/lichen-zephyr/work/zephyr/soc/intel/alder_lake/Kconfig"
osource "/mnt/lichen-zephyr/work/zephyr/soc/infineon/cat3/Kconfig"
osource "/mnt/lichen-zephyr/work/zephyr/soc/infineon/cat1b/Kconfig"
osource "/mnt/lichen-zephyr/work/zephyr/soc/infineon/cat1a/Kconfig"
osource "/mnt/lichen-zephyr/work/zephyr/soc/gd/gd32/Kconfig"
osource "/mnt/lichen-zephyr/work/zephyr/soc/gaisler/leon3/Kconfig"
osource "/mnt/lichen-zephyr/work/zephyr/soc/gaisler/gr716a/Kconfig"
osource "/mnt/lichen-zephyr/work/zephyr/soc/espressif/Kconfig"
osource "/mnt/lichen-zephyr/work/zephyr/soc/ene/kb1200/Kconfig"
osource "/mnt/lichen-zephyr/work/zephyr/soc/efinix/sapphire/Kconfig"
osource "/mnt/lichen-zephyr/work/zephyr/soc/cdns/xtensa_sample_controller/Kconfig"
osource "/mnt/lichen-zephyr/work/zephyr/soc/cdns/dc233c/Kconfig"
osource "/mnt/lichen-zephyr/work/zephyr/soc/brcm/bcmvk/Kconfig"
osource "/mnt/lichen-zephyr/work/zephyr/soc/brcm/bcm2712/Kconfig"
osource "/mnt/lichen-zephyr/work/zephyr/soc/brcm/bcm2711/Kconfig"
osource "/mnt/lichen-zephyr/work/zephyr/soc/atmel/sam0/Kconfig"
osource "/mnt/lichen-zephyr/work/zephyr/soc/atmel/sam/Kconfig"
osource "/mnt/lichen-zephyr/work/zephyr/soc/aspeed/Kconfig"
osource "/mnt/lichen-zephyr/work/zephyr/soc/arm/Kconfig"
osource "/mnt/lichen-zephyr/work/zephyr/soc/arm/beetle/Kconfig"
osource "/mnt/lichen-zephyr/work/zephyr/soc/andestech/Kconfig"
osource "/mnt/lichen-zephyr/work/zephyr/soc/ambiq/Kconfig"
osource "/mnt/lichen-zephyr/work/zephyr/soc/altr/zephyr_nios2f/Kconfig"
osource "/mnt/lichen-zephyr/work/zephyr/soc/altr/qemu_nios2/Kconfig"
osource "/mnt/lichen-zephyr/work/zephyr/soc/adi/max32/Kconfig"
```
