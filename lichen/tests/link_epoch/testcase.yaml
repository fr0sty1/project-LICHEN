## twister-out.2/native_sim/net.lichen.coap_keys.store/Kconfig/soc/Kconfig.sysbuild
```kconfig
# Load SoC sysbuild Kconfig descriptions.
osource "/mnt/lichen-zephyr/work/zephyr/soc/xlnx/zynqmp/Kconfig.sysbuild"
osource "/mnt/lichen-zephyr/work/zephyr/soc/xlnx/zynq7000/Kconfig.sysbuild"
osource "/mnt/lichen-zephyr/work/zephyr/soc/xen/Kconfig.sysbuild"
osource "/mnt/lichen-zephyr/work/zephyr/soc/ti/simplelink/Kconfig.sysbuild"
osource "/mnt/lichen-zephyr/work/zephyr/soc/ti/lm3s6965/Kconfig.sysbuild"
osource "/mnt/lichen-zephyr/work/zephyr/soc/ti/k3/Kconfig.sysbuild"
osource "/mnt/lichen-zephyr/work/zephyr/soc/telink/tlsr/Kconfig.sysbuild"
osource "/mnt/lichen-zephyr/work/zephyr/soc/starfive/jh71xx/Kconfig.sysbuild"
osource "/mnt/lichen-zephyr/work/zephyr/soc/st/stm32/Kconfig.sysbuild"
osource "/mnt/lichen-zephyr/work/zephyr/soc/snps/qemu_arc/Kconfig.sysbuild"
osource "/mnt/lichen-zephyr/work/zephyr/soc/snps/nsim/arc_v/Kconfig.sysbuild"
osource "/mnt/lichen-zephyr/work/zephyr/soc/snps/nsim/arc_classic/Kconfig.sysbuild"
osource "/mnt/lichen-zephyr/work/zephyr/soc/snps/hsdk4xd/Kconfig.sysbuild"
osource "/mnt/lichen-zephyr/work/zephyr/soc/snps/hsdk/Kconfig.sysbuild"
osource "/mnt/lichen-zephyr/work/zephyr/soc/snps/emsk/Kconfig.sysbuild"
osource "/mnt/lichen-zephyr/work/zephyr/soc/snps/emsdp/Kconfig.sysbuild"
osource "/mnt/lichen-zephyr/work/zephyr/soc/snps/arc_iot/Kconfig.sysbuild"
osource "/mnt/lichen-zephyr/work/zephyr/soc/silabs/Kconfig.sysbuild"
osource "/mnt/lichen-zephyr/work/zephyr/soc/sifive/sifive_freedom/Kconfig.sysbuild"
osource "/mnt/lichen-zephyr/work/zephyr/soc/rockchip/Kconfig.sysbuild"
osource "/mnt/lichen-zephyr/work/zephyr/soc/renode/riscv_virtual/Kconfig.sysbuild"
osource "/mnt/lichen-zephyr/work/zephyr/soc/renesas/smartbond/Kconfig.sysbuild"
osource "/mnt/lichen-zephyr/work/zephyr/soc/renesas/rzt2m/Kconfig.sysbuild"
osource "/mnt/lichen-zephyr/work/zephyr/soc/renesas/rcar/Kconfig.sysbuild"
osource "/mnt/lichen-zephyr/work/zephyr/soc/renesas/ra/Kconfig.sysbuild"
osource "/mnt/lichen-zephyr/work/zephyr/soc/raspberrypi/Kconfig.sysbuild"
osource "/mnt/lichen-zephyr/work/zephyr/soc/quicklogic/eos_s3/Kconfig.sysbuild"
osource "/mnt/lichen-zephyr/work/zephyr/soc/qemu/virt_riscv/Kconfig.sysbuild"
osource "/mnt/lichen-zephyr/work/zephyr/soc/qemu/malta/Kconfig.sysbuild"
osource "/mnt/lichen-zephyr/work/zephyr/soc/openisa/rv32m1/Kconfig.sysbuild"
osource "/mnt/lichen-zephyr/work/zephyr/soc/nxp/s32/Kconfig.sysbuild"
osource "/mnt/lichen-zephyr/work/zephyr/soc/nxp/rw/Kconfig.sysbuild"
osource "/mnt/lichen-zephyr/work/zephyr/soc/nxp/mcx/Kconfig.sysbuild"
osource "/mnt/lichen-zephyr/work/zephyr/soc/nxp/lpc/Kconfig.sysbuild"
osource "/mnt/lichen-zephyr/work/zephyr/soc/nxp/layerscape/Kconfig.sysbuild"
osource "/mnt/lichen-zephyr/work/zephyr/soc/nxp/kinetis/Kconfig.sysbuild"
osource "/mnt/lichen-zephyr/work/zephyr/soc/nxp/imxrt/Kconfig.sysbuild"
osource "/mnt/lichen-zephyr/work/zephyr/soc/nxp/imx/Kconfig.sysbuild"
osource "/mnt/lichen-zephyr/work/zephyr/soc/nuvoton/numicro/Kconfig.sysbuild"
osource "/mnt/lichen-zephyr/work/zephyr/soc/nuvoton/numaker/Kconfig.sysbuild"
osource "/mnt/lichen-zephyr/work/zephyr/soc/nuvoton/npcx/Kconfig.sysbuild"
osource "/mnt/lichen-zephyr/work/zephyr/soc/nordic/Kconfig.sysbuild"
osource "/mnt/lichen-zephyr/work/zephyr/soc/neorv32/Kconfig.sysbuild"
osource "/mnt/lichen-zephyr/work/zephyr/soc/native/inf_clock/Kconfig.sysbuild"
osource "/mnt/lichen-zephyr/work/zephyr/soc/microchip/miv/Kconfig.sysbuild"
osource "/mnt/lichen-zephyr/work/zephyr/soc/microchip/mec/Kconfig.sysbuild"
osource "/mnt/lichen-zephyr/work/zephyr/soc/mediatek/mtk_adsp/Kconfig.sysbuild"
osource "/mnt/lichen-zephyr/work/zephyr/soc/lowrisc/opentitan/Kconfig.sysbuild"
osource "/mnt/lichen-zephyr/work/zephyr/soc/litex/litex_vexriscv/Kconfig.sysbuild"
osource "/mnt/lichen-zephyr/work/zephyr/soc/ite/ec/Kconfig.sysbuild"
osource "/mnt/lichen-zephyr/work/zephyr/soc/intel/raptor_lake/Kconfig.sysbuild"
osource "/mnt/lichen-zephyr/work/zephyr/soc/intel/lakemont/Kconfig.sysbuild"
osource "/mnt/lichen-zephyr/work/zephyr/soc/intel/intel_socfpga_std/Kconfig.sysbuild"
osource "/mnt/lichen-zephyr/work/zephyr/soc/intel/intel_socfpga/Kconfig.sysbuild"
osource "/mnt/lichen-zephyr/work/zephyr/soc/intel/intel_niosv/Kconfig.sysbuild"
osource "/mnt/lichen-zephyr/work/zephyr/soc/intel/intel_ish/Kconfig.sysbuild"
osource "/mnt/lichen-zephyr/work/zephyr/soc/intel/intel_adsp/Kconfig.sysbuild"
osource "/mnt/lichen-zephyr/work/zephyr/soc/intel/elkhart_lake/Kconfig.sysbuild"
osource "/mnt/lichen-zephyr/work/zephyr/soc/intel/atom/Kconfig.sysbuild"
osource "/mnt/lichen-zephyr/work/zephyr/soc/intel/apollo_lake/Kconfig.sysbuild"
osource "/mnt/lichen-zephyr/work/zephyr/soc/intel/alder_lake/Kconfig.sysbuild"
osource "/mnt/lichen-zephyr/work/zephyr/soc/infineon/cat3/Kconfig.sysbuild"
osource "/mnt/lichen-zephyr/work/zephyr/soc/infineon/cat1b/Kconfig.sysbuild"
osource "/mnt/lichen-zephyr/work/zephyr/soc/infineon/cat1a/Kconfig.sysbuild"
osource "/mnt/lichen-zephyr/work/zephyr/soc/gd/gd32/Kconfig.sysbuild"
osource "/mnt/lichen-zephyr/work/zephyr/soc/gaisler/leon3/Kconfig.sysbuild"
osource "/mnt/lichen-zephyr/work/zephyr/soc/gaisler/gr716a/Kconfig.sysbuild"
osource "/mnt/lichen-zephyr/work/zephyr/soc/espressif/Kconfig.sysbuild"
osource "/mnt/lichen-zephyr/work/zephyr/soc/ene/kb1200/Kconfig.sysbuild"
osource "/mnt/lichen-zephyr/work/zephyr/soc/efinix/sapphire/Kconfig.sysbuild"
osource "/mnt/lichen-zephyr/work/zephyr/soc/cdns/xtensa_sample_controller/Kconfig.sysbuild"
osource "/mnt/lichen-zephyr/work/zephyr/soc/cdns/dc233c/Kconfig.sysbuild"
osource "/mnt/lichen-zephyr/work/zephyr/soc/brcm/bcmvk/Kconfig.sysbuild"
osource "/mnt/lichen-zephyr/work/zephyr/soc/brcm/bcm2712/Kconfig.sysbuild"
osource "/mnt/lichen-zephyr/work/zephyr/soc/brcm/bcm2711/Kconfig.sysbuild"
osource "/mnt/lichen-zephyr/work/zephyr/soc/atmel/sam0/Kconfig.sysbuild"
osource "/mnt/lichen-zephyr/work/zephyr/soc/atmel/sam/Kconfig.sysbuild"
osource "/mnt/lichen-zephyr/work/zephyr/soc/aspeed/Kconfig.sysbuild"
osource "/mnt/lichen-zephyr/work/zephyr/soc/arm/Kconfig.sysbuild"
osource "/mnt/lichen-zephyr/work/zephyr/soc/arm/beetle/Kconfig.sysbuild"
osource "/mnt/lichen-zephyr/work/zephyr/soc/andestech/Kconfig.sysbuild"
osource "/mnt/lichen-zephyr/work/zephyr/soc/ambiq/Kconfig.sysbuild"
osource "/mnt/lichen-zephyr/work/zephyr/soc/altr/zephyr_nios2f/Kconfig.sysbuild"
osource "/mnt/lichen-zephyr/work/zephyr/soc/altr/qemu_nios2/Kconfig.sysbuild"
osource "/mnt/lichen-zephyr/work/zephyr/soc/adi/max32/Kconfig.sysbuild"
```

## zephyr/west.yml
```yaml
manifest:
  version: "0.13"

  self:
    path: zephyr

  defaults:
    remote:
      name: zephyrproject
      url-base: https://github.com/zephyrproject-rtos

  remotes:
    - name: zephyrproject
      url-base: https://github.com/zephyrproject-rtos

  projects:
    - name: zephyr
      remote: zephyrproject
      revision: v3.7.0
      import: true
```
