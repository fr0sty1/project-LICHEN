## CMakeLists.txt
```
# SPDX-License-Identifier: GPL-3.0-or-later
# SPDX-FileCopyrightText: The contributors to the LICHEN project

cmake_minimum_required(VERSION 3.20.0)
find_package(Zephyr REQUIRED HINTS $ENV{ZEPHYR_BASE})
project(native_init)

target_sources(app PRIVATE src/main.c)
```

## prj.conf
```kconfig
# SPDX-License-Identifier: GPL-3.0-or-later
# SPDX-FileCopyrightText: The contributors to the LICHEN project

CONFIG_ZTEST=y
CONFIG_ZTEST_STACK_SIZE=2048

CONFIG_LOG=y
CONFIG_SERIAL=y
CONFIG_UART_INTERRUPT_DRIVEN=y

CONFIG_LICHEN=y
CONFIG_LICHEN_HAL=y
CONFIG_LICHEN_IPV6=n
CONFIG_ZCBOR=y
CONFIG_LICHEN_NATIVE=y

CONFIG_MAIN_STACK_SIZE=2048

# C Safety Policy - spec/appendix-c-safety.md
CONFIG_STACK_CANARIES=y
CONFIG_STACK_SENTINEL=y
CONFIG_ASSERT=y
CONFIG_ASSERT_VERBOSE=y
```

## src/main.c
```c
/* SPDX-License-Identifier: GPL-3.0-or-later */
/* SPDX-FileCopyrightText: The contributors to the LICHEN project */

#include <errno.h>

#include <zephyr/ztest.h>

#include <lichen/native.h>

#if IS_ENABLED(CONFIG_LICHEN_HAS_SERIAL_LOCAL)
#define EXPECTED_NATIVE_INIT_RET 0
#else
#define EXPECTED_NATIVE_INIT_RET -ENOTSUP
#endif

static void native_init_rx(uint8_t msg_type, const uint8_t *buf, size_t len)
{
	ARG_UNUSED(msg_type);
	ARG_UNUSED(buf);
	ARG_UNUSED(len);
}

ZTEST(native_init, test_native_init_uses_hal_serial_local_status)
{
	zassert_equal(lichen_native_init(native_init_rx), EXPECTED_NATIVE_INIT_RET);
	zassert_equal(lichen_native_init(native_init_rx), EXPECTED_NATIVE_INIT_RET);
}

ZTEST_SUITE(native_init, NULL, NULL, NULL, NULL, NULL);
```
