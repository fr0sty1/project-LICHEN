## CMakeLists.txt
```
# SPDX-License-Identifier: GPL-3.0-or-later
# SPDX-FileCopyrightText: The contributors to the LICHEN project

cmake_minimum_required(VERSION 3.20.0)
find_package(Zephyr REQUIRED HINTS $ENV{ZEPHYR_BASE})
project(edhoc_export)

target_sources(app PRIVATE src/main.c)
```

## prj.conf
```kconfig
# SPDX-License-Identifier: GPL-3.0-or-later
# SPDX-FileCopyrightText: The contributors to the LICHEN project

CONFIG_ZTEST=y
CONFIG_ZTEST_STACK_SIZE=4096
CONFIG_MAIN_STACK_SIZE=4096

CONFIG_LICHEN=y
CONFIG_LICHEN_CRYPTO_MONOCYPHER=y
CONFIG_LICHEN_EDHOC=y
CONFIG_ZCBOR=y
CONFIG_TINYCRYPT=y
CONFIG_TINYCRYPT_SHA256=y
CONFIG_TINYCRYPT_SHA256_HMAC=y
CONFIG_TEST_RANDOM_GENERATOR=y

CONFIG_ASSERT=y
CONFIG_STACK_CANARIES=y
CONFIG_STACK_SENTINEL=y
```

## src/main.c
```c
/* SPDX-License-Identifier: GPL-3.0-or-later */
/* SPDX-FileCopyrightText: The contributors to the LICHEN project */

#include <errno.h>
#include <string.h>

#include <zephyr/ztest.h>

#include <lichen/edhoc.h>

#include "../../../subsys/lichen/edhoc/edhoc_internal.h"
#include "fixture.h"

ZTEST(edhoc_export, test_rfc9529_export_chain)
{
	uint8_t actual[32] = {0};

	zassert_equal(edhoc_kdf_int(prk_4e3m, 7, th_4, sizeof(th_4),
				    actual, sizeof(actual)), 0);
	zassert_mem_equal(actual, prk_out, sizeof(prk_out));
	zassert_equal(edhoc_kdf_int(actual, 10, NULL, 0,
				    actual, sizeof(actual)), 0);
	zassert_mem_equal(actual, prk_exporter, sizeof(prk_exporter));
	zassert_equal(edhoc_kdf_int(actual, 0, NULL, 0,
				    actual, sizeof(master_secret)), 0);
	zassert_mem_equal(actual, master_secret, sizeof(master_secret));
	zassert_equal(edhoc_kdf_int(prk_exporter, 1, NULL, 0,
				    actual, sizeof(master_salt)), 0);
	zassert_mem_equal(actual, master_salt, sizeof(master_salt));
}

ZTEST(edhoc_export, test_rfc9528_role_mapping_and_atomic_lifecycle)
{
	struct edhoc_initiator initiator = {0};
	struct edhoc_responder responder = {0};
	struct edhoc_oscore_ctx initiator_oscore = {0};
	struct edhoc_oscore_ctx responder_oscore = {0};

	initiator.state = EDHOC_STATE_COMPLETED;
	memcpy(initiator.prk_4e3m, prk_4e3m, sizeof(prk_4e3m));
	memcpy(initiator.th_4, th_4, sizeof(th_4));
	memcpy(initiator.c_i, c_i, sizeof(c_i));
	initiator.c_i_len = sizeof(c_i);
	memcpy(initiator.c_r, c_r, sizeof(c_r));
	initiator.c_r_len = sizeof(c_r);

	responder.state = EDHOC_STATE_COMPLETED;
	memcpy(responder.prk_4e3m, prk_4e3m, sizeof(prk_4e3m));
	memcpy(responder.th_4, th_4, sizeof(th_4));
	memcpy(responder.c_i, c_i, sizeof(c_i));
	responder.c_i_len = sizeof(c_i);
	memcpy(responder.c_r, c_r, sizeof(c_r));
	responder.c_r_len = sizeof(c_r);

	zassert_equal(edhoc_initiator_export_oscore(&initiator, &initiator_oscore), 0);
	zassert_equal(edhoc_responder_export_oscore(&responder, &responder_oscore), 0);
	zassert_mem_equal(initiator_oscore.master_secret, master_secret,
			  sizeof(master_secret));
	zassert_mem_equal(responder_oscore.master_secret, master_secret,
			  sizeof(master_secret));
	zassert_mem_equal(initiator_oscore.master_salt, master_salt,
			  sizeof(master_salt));
	zassert_mem_equal(responder_oscore.master_salt, master_salt,
			  sizeof(master_salt));
	zassert_mem_equal(initiator_oscore.sender_id, initiator_sender_id,
			  sizeof(initiator_sender_id));
	zassert_mem_equal(initiator_oscore.recipient_id, initiator_recipient_id,
			  sizeof(initiator_recipient_id));
	zassert_mem_equal(responder_oscore.sender_id, responder_sender_id,
			  sizeof(responder_sender_id));
	zassert_mem_equal(responder_oscore.recipient_id, responder_recipient_id,
			  sizeof(responder_recipient_id));
	zassert_equal(initiator.state, EDHOC_STATE_EXPORTED);
	zassert_equal(responder.state, EDHOC_STATE_EXPORTED);
	zassert_mem_equal(initiator.prk_4e3m, (uint8_t[32]){0}, 32);
	zassert_mem_equal(responder.prk_4e3m, (uint8_t[32]){0}, 32);

	/* Re-export and pre-completion export fail before mutating output. */
	memset(&initiator_oscore, 0xa5, sizeof(initiator_oscore));
	zassert_equal(edhoc_initiator_export_oscore(&initiator, &initiator_oscore),
		      -EBUSY);
	zassert_equal(initiator_oscore.master_secret[0], 0xa5);
	memset(&responder_oscore, 0x5a, sizeof(responder_oscore));
	responder.state = EDHOC_STATE_MSG2_SENT;
	zassert_equal(edhoc_responder_export_oscore(&responder, &responder_oscore),
		      -EBUSY);
	zassert_equal(responder_oscore.master_secret[0], 0x5a);
}

ZTEST_SUITE(edhoc_export, NULL, NULL, NULL, NULL, NULL);
```

## src/fixture.h
```c
/* Generated from test/vectors/edhoc_export_rfc9529.json. */
#ifndef LICHEN_TEST_EDHOC_EXPORT_FIXTURE_H_
#define LICHEN_TEST_EDHOC_EXPORT_FIXTURE_H_

#include <stdint.h>

static const uint8_t prk_4e3m[32] = {0xd5, 0x84, 0xac, 0x2e, 0x5d, 0xad, 0x5a, 0x77, 0xd1, 0x4b, 0x53, 0xeb, 0xe7, 0x2e, 0xf1, 0xd5, 0xda, 0xa8, 0x86, 0x0d, 0x39, 0x93, 0x73, 0xbf, 0x2c, 0x24, 0x0a, 0xfa, 0x7b, 0xa8, 0x04, 0xda};
static const uint8_t th_4[32] = {0x0e, 0xb8, 0x68, 0xf2, 0x63, 0xcf, 0x35, 0x55, 0xdc, 0xcd, 0x39, 0x6d, 0xd8, 0xde, 0xc2, 0x9d, 0x37, 0x50, 0xd5, 0x99, 0xbe, 0x42, 0xd5, 0xa4, 0x1a, 0x5a, 0x37, 0xc8, 0x96, 0xf2, 0x94, 0xac};
static const uint8_t prk_out[32] = {0xb7, 0x44, 0xcb, 0x7d, 0x8a, 0x87, 0xcc, 0x04, 0x47, 0xc3, 0x35, 0x0e, 0x16, 0x5b, 0x25, 0x0d, 0xab, 0x12, 0xec, 0x45, 0x33, 0x25, 0xab, 0xb9, 0x22, 0xb3, 0x03, 0x07, 0xe5, 0xc3, 0x68, 0xf0};
static const uint8_t prk_exporter[32] = {0x2a, 0xae, 0xc8, 0xfc, 0x4a, 0xb3, 0xbc, 0x32, 0x95, 0xde, 0xf6, 0xb5, 0x51, 0x05, 0x1a, 0x2f, 0xa5, 0x61, 0x42, 0x4d, 0xb3, 0x01, 0xfa, 0x84, 0xf6, 0x42, 0xf5, 0x57, 0x8a, 0x6d, 0xf5, 0x1a};
static const uint8_t master_secret[16] = {0x1e, 0x1c, 0x6b, 0xea, 0xc3, 0xa8, 0xa1, 0xca, 0xc4, 0x35, 0xde, 0x7e, 0x2f, 0x9a, 0xe7, 0xff};
static const uint8_t master_salt[8] = {0xce, 0x7a, 0xb8, 0x44, 0xc0, 0x10, 0x6d, 0x73};
static const uint8_t c_i[1] = {0x2d};
static const uint8_t c_r[1] = {0x18};
static const uint8_t initiator_sender_id[1] = {0x18};
static const uint8_t initiator_recipient_id[1] = {0x2d};
static const uint8_t responder_sender_id[1] = {0x2d};
static const uint8_t responder_recipient_id[1] = {0x18};

#endif
```
