## CMakeLists.txt
```
# SPDX-License-Identifier: GPL-3.0-or-later
# SPDX-FileCopyrightText: The contributors to the LICHEN project

cmake_minimum_required(VERSION 3.20.0)
find_package(Zephyr REQUIRED HINTS $ENV{ZEPHYR_BASE})
project(coap_keys)

FILE(GLOB app_sources src/*.c)
target_sources(app PRIVATE ${app_sources})
```

## prj.conf
```kconfig
# SPDX-License-Identifier: GPL-3.0-or-later
# SPDX-FileCopyrightText: The contributors to the LICHEN project

CONFIG_ZTEST=y
CONFIG_MAIN_STACK_SIZE=4096
CONFIG_HEAP_MEM_POOL_SIZE=2048

CONFIG_NETWORKING=y
CONFIG_NET_IPV6=y
CONFIG_NET_IPV4=n
CONFIG_NET_SOCKETS=y
# SLIP transport registers a dummy L2 network device
CONFIG_NET_L2_DUMMY=y
CONFIG_SERIAL=y
CONFIG_RING_BUFFER=y

CONFIG_LICHEN=y
CONFIG_LICHEN_COAP=y
CONFIG_LICHEN_COAP_SERVER=y
CONFIG_LICHEN_COAP_STATUS=n
# No client thread in this test (its default priority 15 panics on
# native_sim's 15-priority preempt range).
CONFIG_LICHEN_COAP_CLIENT=n
# The subject under test. Depends on LICHEN_SLIP_TRANSPORT (bd a2a2): it
# scopes admin access to the SLIP LCI interface, so that must be present
# for the module to compile and link.
CONFIG_LICHEN_SLIP_TRANSPORT=y
CONFIG_LICHEN_OSCORE=y
CONFIG_LICHEN_COAP_SERVER_OSCORE=y
CONFIG_LICHEN_COAP_KEYS=y
CONFIG_LICHEN_COAP_KEYS_TEST_HOOKS=y

# coap_keys_store.c TOFU validation links lichen_key_pubkey_to_iid(), which
# is defined in subsys/lichen/link/identity_addr.c. The link directory is
# only added under CONFIG_LICHEN_LINK, so without this the test cannot link
# (bd 6mij.2.2.4 follow-up).
CONFIG_LICHEN_LINK=y

# Exercise the authenticated two-generation TOFU persistence adapter. The
# focused tests inject a deterministic fake backend; enabling Settings here
# also compile-checks the production Settings/NVS binding.
CONFIG_FLASH=y
CONFIG_FLASH_MAP=y
CONFIG_NVS=y
CONFIG_SETTINGS=y
CONFIG_SETTINGS_NVS=y

CONFIG_TINYCRYPT=y
CONFIG_TINYCRYPT_SHA256=y

# C Safety Policy - spec/appendix-c-safety.md
CONFIG_STACK_CANARIES=y
CONFIG_STACK_SENTINEL=y
CONFIG_ASSERT=y
CONFIG_ASSERT_VERBOSE=y
```

## overlay-deaddrop-proof.conf
```kconfig
# SPDX-License-Identifier: GPL-3.0-or-later
# SPDX-FileCopyrightText: The contributors to the LICHEN project

# Compile/link proof overlay for CONFIG_LICHEN_COAP_DEADDROP (bd
# project-LICHEN-worker6-4xln et al.). No test in-tree enables the deaddrop
# resource, so this pulls in its full dependency chain on top of prj.conf:
#   LICHEN_COAP_DEADDROP depends on LICHEN_COAP_SERVER + LICHEN_OSCORE +
#   LICHEN_DTN (needs LICHEN_ROUTING) and coap_dtn.c uses the SenML encoder
#   (LICHEN_SENML). LICHEN_COAP_CLIENT is deliberately left at prj.conf's
#   default n: coap_client.c has a known pre-existing compile failure
# (bd project-LICHEN-worker6-zhuq verification notes) and is not a Kconfig
# dependency of LICHEN_COAP_DEADDROP. Build with:
#     west build -b qemu_x86 -DEXTRA_CONF_FILE=overlay-deaddrop-proof.conf
CONFIG_LICHEN_ROUTING=y
CONFIG_LICHEN_DTN=y
CONFIG_LICHEN_SENML=y
CONFIG_LICHEN_COAP_DEADDROP=y
# Also compile lichen's coap_server.c (config_put/msg_inbox_post), which no
# in-tree target builds: STANDALONE defaults n everywhere and coap_keys uses
# the modular service. Requires !LICHEN_COAP_CONFIG (not set in prj.conf).
CONFIG_LICHEN_COAP_SERVER_STANDALONE=y
# coap_server.c:449 BUILD_ASSERT: LICHEN_COAP_SERVER_MAX_PAYLOAD (512) + 128
# must fit CONFIG_COAP_SERVER_MESSAGE_SIZE (default 256 is too small here).
CONFIG_COAP_SERVER_MESSAGE_SIZE=768
```

## src/tofu_edge_vectors.h
```c
/* SPDX-License-Identifier: GPL-3.0-or-later */
/* Generated by test/vectors/generate_tofu_c_header.py; do not edit. */
#ifndef LICHEN_TEST_TOFU_EDGE_VECTORS_H_
#define LICHEN_TEST_TOFU_EDGE_VECTORS_H_

#define TOFU_EDGE_VECTOR_COUNT 14U
#define TOFU_EDGE_ALICE_PUBKEY_BYTES 0x4c, 0xb5, 0xab, 0xf6, 0xad, 0x79, 0xfb, 0xf5, 0xab, 0xbc, 0xca, 0xfc, 0xc2, 0x69, 0xd8, 0x5c, 0xd2, 0x65, 0x1e, 0xd4, 0xb8, 0x85, 0xb5, 0x86, 0x9f, 0x24, 0x1a, 0xed, 0xf0, 0xa5, 0xba, 0x29
#define TOFU_EDGE_ALICE_IID_BYTES 0xfd, 0x6b, 0x26, 0x5c, 0x85, 0x85, 0x36, 0x9b
#define TOFU_EDGE_BOB_PUBKEY_BYTES 0x74, 0x22, 0xb9, 0x88, 0x75, 0x98, 0x06, 0x8e, 0x32, 0xc4, 0x44, 0x8a, 0x94, 0x9a, 0xdb, 0x29, 0x0d, 0x0f, 0x4e, 0x35, 0xb9, 0xe0, 0x1b, 0x0e, 0xe5, 0xf1, 0xa1, 0xe6, 0x00, 0xfe, 0x26, 0x74
#define TOFU_EDGE_BOB_IID_BYTES 0x88, 0x8b, 0xcf, 0x64, 0xcf, 0xef, 0xa3, 0x04
#define TOFU_EDGE_CONCURRENT_OBSERVERS 2U
#define TOFU_EDGE_REPLAY_REPETITIONS 3U
#define TOFU_EDGE_FIRST_CONTACT_ENTRIES 1U
#define TOFU_EDGE_INDEPENDENT_ENTRIES 2U

#endif /* LICHEN_TEST_TOFU_EDGE_VECTORS_H_ */
```
