## CMakeLists.txt
```
# SPDX-License-Identifier: GPL-3.0-or-later
# SPDX-FileCopyrightText: The contributors to the LICHEN project

cmake_minimum_required(VERSION 3.20.0)
find_package(Zephyr REQUIRED HINTS $ENV{ZEPHYR_BASE})
project(ble_app_owner)

target_include_directories(app PRIVATE
  ../../apps/gateway/src
  ../../subsys/lichen/transport/include)
if(DEFINED BLE_APP_OWNER_TEST_MODE)
  if(BLE_APP_OWNER_TEST_MODE STREQUAL "native")
    target_compile_definitions(app PRIVATE CONFIG_LORA_LICHEN_BLE=1)
  elseif(BLE_APP_OWNER_TEST_MODE STREQUAL "native_legacy")
    target_compile_definitions(app PRIVATE
      CONFIG_LORA_LICHEN_BLE=1
      CONFIG_LORA_LICHEN_BLE_LEGACY_NUS=1)
  elseif(BLE_APP_OWNER_TEST_MODE STREQUAL "meshtastic")
    target_compile_definitions(app PRIVATE CONFIG_LORA_LICHEN_MESHTASTIC_BLE=1)
  elseif(BLE_APP_OWNER_TEST_MODE STREQUAL "meshcore")
    target_compile_definitions(app PRIVATE CONFIG_LORA_LICHEN_MESHCORE_BLE=1)
  else()
    message(FATAL_ERROR "Unsupported BLE_APP_OWNER_TEST_MODE=${BLE_APP_OWNER_TEST_MODE}")
  endif()
endif()
target_sources(app PRIVATE
  ../../apps/gateway/src/ble_app_owner.c
  ../../apps/gateway/src/ble_uart.c
  src/ble_ingress_stub.c
  src/main.c)
```

## prj.conf
```kconfig
# SPDX-License-Identifier: GPL-3.0-or-later
# SPDX-FileCopyrightText: The contributors to the LICHEN project

CONFIG_ZTEST=y
CONFIG_ZTEST_STACK_SIZE=2048

CONFIG_BT=y
CONFIG_BT_PERIPHERAL=y
CONFIG_BT_MAX_CONN=1
CONFIG_BT_DEVICE_NAME="LICHEN"
CONFIG_BT_USERCHAN=n

CONFIG_LICHEN=y
CONFIG_LICHEN_IPV6=n
CONFIG_LICHEN_LORA_L2=n
CONFIG_LICHEN_L2=n

CONFIG_MAIN_STACK_SIZE=2048

# C Safety Policy - spec/appendix-c-safety.md
CONFIG_STACK_CANARIES=y
CONFIG_STACK_SENTINEL=y
CONFIG_ASSERT=y
CONFIG_ASSERT_VERBOSE=y
```

## src/ble_ingress_stub.c
```c
/* SPDX-License-Identifier: GPL-3.0-or-later */
/* SPDX-FileCopyrightText: The contributors to the LICHEN project */

#include <errno.h>
#include <stddef.h>
#include <stdint.h>
#include <string.h>

#include <zephyr/sys/util.h>

struct net_if;

static uint8_t s_last_ipv6[1280];
static size_t s_last_len;
static uint32_t s_call_count;
static int s_return_value = -ENODEV;
static uint8_t s_fake_netif;

struct net_if *ble_lci_netif_get(void)
{
	return (struct net_if *)&s_fake_netif;
}

void ble_ingress_stub_reset(int return_value)
{
	memset(s_last_ipv6, 0, sizeof(s_last_ipv6));
	s_last_len = 0U;
	s_call_count = 0U;
	s_return_value = return_value;
}

uint32_t ble_ingress_stub_call_count(void)
{
	return s_call_count;
}

size_t ble_ingress_stub_last_len(void)
{
	return s_last_len;
}

int ble_ingress_stub_copy_last(uint8_t *buf, size_t cap)
{
	if (buf == NULL && cap > 0U) {
		return -EINVAL;
	}
	if (cap < s_last_len) {
		return -ENOMEM;
	}
	memcpy(buf, s_last_ipv6, s_last_len);
	return 0;
}

int ble_ingress_ipv6(struct net_if *iface, const uint8_t *ipv6, size_t len)
{
	ARG_UNUSED(iface);

	s_call_count++;
	s_last_len = MIN(len, sizeof(s_last_ipv6));
	memcpy(s_last_ipv6, ipv6, s_last_len);
	return s_return_value;
}

int ble_ingress_ipv6_default(const uint8_t *ipv6, size_t len)
{
	return ble_ingress_ipv6(ble_lci_netif_get(), ipv6, len);
}
```
