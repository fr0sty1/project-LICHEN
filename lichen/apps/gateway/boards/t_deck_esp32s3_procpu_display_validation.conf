## lichen/apps/gateway/boards/t_deck_esp32s3_procpu_display_validation.conf
```kconfig
# SPDX-License-Identifier: GPL-3.0-or-later
# SPDX-FileCopyrightText: The contributors to the LICHEN project
#
# Optional no-hardware T-Deck display validation fragment.  Pass this
# explicitly with:
#
#   -DEXTRA_CONF_FILE=boards/t_deck_esp32s3_procpu_display_validation.conf
#
# Do not use FILE_SUFFIX=display for this check: suffixed board fragments
# replace the base app board fragment instead of extending it.

CONFIG_DISPLAY=y
CONFIG_MIPI_DBI=y
CONFIG_MIPI_DBI_SPI=y
CONFIG_ST7789V=y
CONFIG_LICHEN_HAS_DISPLAY=y
```

## lichen/apps/gateway/boards/t_deck_esp32s3_procpu_sd_validation.conf
```kconfig
# SPDX-License-Identifier: GPL-3.0-or-later
# SPDX-FileCopyrightText: The contributors to the LICHEN project
#
# Optional no-hardware T-Deck SD-card validation fragment.  Pass this
# explicitly with:
#
#   -DEXTRA_CONF_FILE=boards/t_deck_esp32s3_procpu_sd_validation.conf
#
# Do not use FILE_SUFFIX=sd for this check: suffixed board fragments replace
# the base app board fragment instead of extending it.

CONFIG_SDHC=y
CONFIG_DISK_ACCESS=y
CONFIG_DISK_DRIVERS=y
CONFIG_DISK_DRIVER_SDMMC=y

# Removable SD cards should use FAT for bring-up smoke tests.  Internal flash
# storage keeps the existing product partitioning and is not enabled here.
CONFIG_FILE_SYSTEM=y
CONFIG_FAT_FILESYSTEM_ELM=y
CONFIG_FS_FATFS_MOUNT_MKFS=n

# Provide an interactive UART smoke path for physical follow-up without adding
# product app SD logic.  Keep mkfs disabled so shell mounts do not reformat a
# non-sacrificial removable card on mount failure.
CONFIG_SHELL=y
CONFIG_HEAP_MEM_POOL_SIZE=4096
CONFIG_FILE_SYSTEM_SHELL=y
CONFIG_FILE_SYSTEM_SHELL_TEST_COMMANDS=y
```

## lichen/apps/gateway/boards/t_echo_nrf52840.conf
```kconfig
# T-Echo gateway config — nRF52840 + SX1262 + BLE

# The T-Echo gateway exposes the local client interface over BLE NUS, not
# Zephyr's wired SLIP driver.  Keep CONFIG_SLIP disabled so Zephyr does not
# require UART/serial support for this BLE-only gateway variant.
CONFIG_SLIP=n

# SX1262 LoRa driver
CONFIG_LORA_SX126X=y
CONFIG_LICHEN_HAS_LORA=y
CONFIG_LICHEN_RADIO_MODEL_SX126X=y

# BLE UART bridge (LICHEN gateway feature)
CONFIG_BT=y
CONFIG_BT_PERIPHERAL=y
CONFIG_BT_DEVICE_NAME="LICHEN"
CONFIG_BT_MAX_CONN=1

CONFIG_BT_L2CAP_TX_MTU=247
CONFIG_BT_BUF_ACL_TX_SIZE=251
CONFIG_BT_BUF_ACL_RX_SIZE=251

CONFIG_LORA_LICHEN_BLE=y
CONFIG_LORA_LICHEN_BLE_LEGACY_NUS=y
CONFIG_LICHEN_HAS_BLE_LOCAL=y
```

## lichen/apps/puck/boards/t1000_e_nrf52840.conf
```kconfig
# Seeed T1000-E puck config — nRF52840 + LR1110

CONFIG_LORA_LR1110=y
CONFIG_LICHEN_HAS_LORA=y
CONFIG_LICHEN_RADIO_MODEL_LR1110=y
CONFIG_LICHEN_MULTI_CHANNEL_ENABLED=y
CONFIG_LICHEN_N_CHANNELS=8

# DEBUG: silence the very noisy USB stack logs so LR1110 diagnostic lines
# survive in the deferred log ring buffer and flush reliably.
CONFIG_USBD_LOG_LEVEL_ERR=y
CONFIG_UDC_DRIVER_LOG_LEVEL_ERR=y

# 5 s beacon for bench testing (default 60 s) — matches the T-Echo so the
# two nodes exchange beacons quickly for the RX demo.
CONFIG_LICHEN_PUCK_BEACON_INTERVAL_MS=5000

CONFIG_SERIAL=y
CONFIG_UART_INTERRUPT_DRIVEN=y

CONFIG_GNSS=y
CONFIG_GNSS_AG3335=y
CONFIG_LICHEN_HAS_GNSS=y
CONFIG_LICHEN_LOCATION_PROVIDER_GNSS=y
CONFIG_LICHEN_TIME_PROVIDER_GNSS=y
CONFIG_PM_DEVICE=y

# OLD USB device stack (not NEXT). A/B testing proved the USB-CDC-NEXT stack
# causes watchdog reboots under sustained host monitoring (see the bring-up
# notes / bd issue); the old stack is reboot-free. buzz_n and the 1200-bps
# DFU-touch handler are stack-agnostic in native.c, so headless reflash works.
CONFIG_USB_DEVICE_STACK=y
CONFIG_USB_CDC_ACM=y
CONFIG_USB_DEVICE_STACK_NEXT=n
CONFIG_USBD_CDC_ACM_CLASS=n
CONFIG_USB_COMPOSITE_DEVICE=y
CONFIG_USB_DEVICE_VID=0x2FE3
CONFIG_USB_DEVICE_PID=0x0100
CONFIG_USB_DEVICE_PRODUCT="LICHEN Node"
CONFIG_USB_DEVICE_MANUFACTURER="LICHEN Project"
CONFIG_UART_LINE_CTRL=y
CONFIG_LICHEN_NATIVE=y
CONFIG_LICHEN_NATIVE_BUZZER=y
CONFIG_LICHEN_HAS_SERIAL_LOCAL=y

# L2/CoAP mode (bd r002 milestone): the LICHEN net interface owns the radio
# (main.c raw beacon loop compiles out under CONFIG_LICHEN_L2); the app sends
# a periodic CoAP GET /status to the dev-provisioned gateway peer.
CONFIG_LICHEN_COAP=y
# lichen_coap_request() k_malloc()s per-request state.
CONFIG_HEAP_MEM_POOL_SIZE=2048
# SECURITY: bench-only dev link security — publicly-known fixed Schnorr key
# (see LICHEN_L2_DEV_PROVISIONING help) and CRC32 MIC instead of AES-CCM.
CONFIG_LICHEN_LINK_INSECURE_CRC32_MIC=y
CONFIG_LICHEN_L2_DEV_PROVISIONING=y
# The bench Heltec gateway (fe80::ec45:2f74:419c:f281, U/L flipped back).
# Gateway only — same policy as the T-Echo conf: every pinned peer costs one
# Schnorr verify per demodulated frame (constant-time all-peers loop), which
# a 64 MHz nRF52840 cannot afford while keeping the radio armed.
CONFIG_LICHEN_L2_DEV_PEER_EUI64="ee452f74419cf281"
# NOTE: DAD must stay enabled — without it the iface's link-local address
# never leaves tentative, source selection yields "::", and receivers drop
# every packet with "src addr is unspecified" (bd lora_ipv6_mesh-r002).

# MCUboot bootloader integration
CONFIG_BOOTLOADER_MCUBOOT=y

# SMP image management over USB CDC-ACM (cdc_acm_uart1, port separate from LICHEN Native)
# MCUMGR depends on NET_BUF + ZCBOR; transport depends on BASE64 + CRC; IMG on FLASH.
CONFIG_FLASH=y
CONFIG_FLASH_MAP=y
CONFIG_NET_BUF=y
CONFIG_ZCBOR=y
CONFIG_BASE64=y
CONFIG_CRC=y
CONFIG_MCUMGR=y
CONFIG_MCUMGR_TRANSPORT_UART=y
CONFIG_MCUMGR_TRANSPORT_UART_MTU=512
CONFIG_MCUMGR_GRP_IMG=y
CONFIG_MCUMGR_GRP_OS=y
CONFIG_IMG_MANAGER=y
CONFIG_STREAM_FLASH=y
CONFIG_MPU_ALLOW_FLASH_WRITE=y
# Erase slot1 page-by-page as the upload advances. Without this, img_mgmt
# erases the whole slot on the first chunk; nRF52 NVMC erase halts the CPU,
# the 4 s hardware watchdog can't be fed, and the SoC resets mid-upload.
CONFIG_IMG_ERASE_PROGRESSIVELY=y

# USB wedge recovery observability (bd 1jqj): export USB bus-health counters
# as a STATS group readable over SMP (if02), so USB state can be inspected
# without opening the native port (if00) that triggers the wedge.
CONFIG_STATS=y
CONFIG_STATS_NAMES=y
CONFIG_MCUMGR_GRP_STAT=y

# Persist the link TX epoch across reboots (bd 3uhb): advance it +1 each
# boot so a rebooted node's counter stays ahead of peers' replay windows,
# eliminating the reboot replay coin-flip. Settings-on-NVS backed by the
# board's storage_partition (FLASH/FLASH_MAP already enabled above).
CONFIG_NVS=y
CONFIG_SETTINGS=y
CONFIG_SETTINGS_NVS=y
CONFIG_LICHEN_LINK_EPOCH_PERSIST=y

# CCP time sync example (LICHEN_CCP_TIME_SYNC from link/Kconfig)
# CONFIG_LICHEN_CCP_TIME_SYNC=y
```

## lichen/apps/puck/boards/t_deck_esp32s3_procpu.conf
```kconfig
# SPDX-License-Identifier: GPL-3.0-or-later
# SPDX-FileCopyrightText: The contributors to the LICHEN project
#
# LilyGO T-Deck puck config — ESP32-S3 + SX1262 + LVGL. Matches gateway radio, test/vectors, heltec puck.
CONFIG_LORA_SX126X=y
CONFIG_LICHEN_HAS_LORA=y
CONFIG_LICHEN_RADIO_MODEL_SX126X=y
CONFIG_LICHEN_COAP=y
CONFIG_LICHEN_LORA_L2=y
CONFIG_LICHEN_L2=y
# lichen_coap_request() k_malloc()s per-request state.
CONFIG_HEAP_MEM_POOL_SIZE=4096
# 5 s beacon for bench testing (default 60 s) — matches the nRF pucks.
CONFIG_LICHEN_PUCK_BEACON_INTERVAL_MS=5000
CONFIG_LVGL=y
CONFIG_LV_USE_KEYPAD=y
CONFIG_LV_FONT_MONTSERRAT_14=y
# Battery support for real hardware test (N30 1100mAh).
CONFIG_LICHEN_HAS_BATTERY=y
CONFIG_SENSOR=y
CONFIG_ADC=y
```

## lichen/apps/puck/boards/t_echo_nrf52840.conf
```kconfig
# T-Echo puck config — nRF52840 + SX1262

CONFIG_LORA_SX126X=y
CONFIG_LICHEN_HAS_LORA=y
CONFIG_LICHEN_RADIO_MODEL_SX126X=y
CONFIG_LICHEN_HAS_DISPLAY=y

# USB CDC-ACM console — T-Echo has no USB-UART bridge chip.
# SERIAL must be explicitly enabled: USB_CDC_ACM selects UART_INTERRUPT_DRIVEN
# which depends on SERIAL, but nRF52840 doesn't pull it in without a physical UART.
CONFIG_SERIAL=y
CONFIG_UART_INTERRUPT_DRIVEN=y
CONFIG_UART_LINE_CTRL=y

# USB CDC-ACM via new USBD stack — old stack fails on T-Echo+MCUboot.
# Mirrors the T1000-E config which uses the same stack and works.
CONFIG_USB_DEVICE_STACK=n
CONFIG_USB_CDC_ACM=n
CONFIG_USB_DEVICE_STACK_NEXT=y
CONFIG_USBD_CDC_ACM_CLASS=y

# LICHEN Native now depends on ZCBOR (upstream refactor moved CBOR
# encode/parse to zcbor). Without this, LICHEN_NATIVE silently drops to n,
# native.c isn't compiled, and USB never enumerates — the board looks dead.
CONFIG_ZCBOR=y
CONFIG_LICHEN_NATIVE=y
# Upstream HAL gates the native UART (and with it the 1200-bps DFU touch)
# behind this capability; without it lichen_hal_serial_device_get() returns
# -ENOTSUP and native init dies silently.
CONFIG_LICHEN_HAS_SERIAL_LOCAL=y
CONFIG_LICHEN_HAS_DISPLAY=y
CONFIG_REBOOT=y
CONFIG_RTT_CONSOLE=n
CONFIG_UART_CONSOLE=y
CONFIG_LOG_BACKEND_RTT=n

# MCUboot layout: boot_partition@0x26000, slot0@0x32000 (356 KB).
# FLASH_LOAD_OFFSET must match slot0 so the app is linked at the correct address.
# Without this, build-t_echo.sh strips the vector table and the image crashes.
CONFIG_BOOTLOADER_MCUBOOT=y
CONFIG_FLASH_LOAD_OFFSET=0x32000
CONFIG_FLASH_LOAD_SIZE=0x59000

# 5 s beacon for bench testing (default is 60 s)
CONFIG_LICHEN_PUCK_BEACON_INTERVAL_MS=5000

# L2/CoAP mode: the LICHEN net interface owns the radio; main.c's raw
# beacon loop is compiled out under CONFIG_LICHEN_L2 (they'd fight over the
# half-duplex radio). prj.conf provides NETWORKING/NET_IPV6/UDP/SOCKETS/COAP;
# LICHEN_LORA_L2 and LICHEN_L2 then default on. First-packet milestone:
# periodic CoAP GET /status to the gateway.
CONFIG_LICHEN_COAP=y
# lichen_coap_request() k_malloc()s per-request state.
CONFIG_HEAP_MEM_POOL_SIZE=2048

# Dedicated preemptive net TX thread (same fix as the gateway): with
# TC_TX=0, system-workqueue-originated sends (ND/MLD) self-deadlock in
# lora_send() waiting for the SX126x TX-done work item queued on that same
# workqueue — "LoRa TX failed (-11)" — and hold the modem hostage exactly
# when responses arrive. The USB deaths once blamed on TC_TX=1 were really
# Ed25519 stack overflows (fixed in prj.conf). DAD/MLD stay ENABLED:
# without DAD the link-local never leaves tentative and packets go out
# with src :: (bd r002).
CONFIG_NET_TC_TX_COUNT=1
CONFIG_NET_TC_THREAD_PREEMPTIVE=y

# SECURITY: bench-only publicly-known fixed Schnorr key.
# See LICHEN_L2_DEV_PROVISIONING help.
CONFIG_LICHEN_L2_DEV_PROVISIONING=y
# The bench Heltec gateway (from its boot log: fe80::ec45:2f74:419c:f281,
# U/L bit flipped back). A node's own EUI-64/link-local is logged at L2 init.
# Gateway (CoAP destination) first, then the sibling T1000-E puck. Two
# pinned peers on a 64 MHz nRF52840 used to zero out RX because the RX loop
# Schnorr-verified every frame against ALL peers with the radio un-armed;
# the dev-mode early-exit (bd shbh) stops at the first match, so a gateway
# response verifies in one pass. Gateway is first so its frames exit
# immediately.
CONFIG_LICHEN_L2_DEV_PEER_EUI64="ee452f74419cf281,8a1a2c4b93812cab"

# SMP image management over USB CDC-ACM (cdc_acm_uart2, if04) — mirrors the
# T1000-E. Routine reflash path: smp-flash.py uploads a signed image to slot1
# over the RUNNING firmware; MCUboot swaps on reboot. No DFU mode, no buttons.
# MCUMGR depends on NET_BUF + ZCBOR; transport depends on BASE64 + CRC.
CONFIG_FLASH=y
CONFIG_FLASH_MAP=y
CONFIG_NET_BUF=y
CONFIG_BASE64=y
CONFIG_CRC=y
CONFIG_MCUMGR=y
CONFIG_MCUMGR_TRANSPORT_UART=y
CONFIG_MCUMGR_TRANSPORT_UART_MTU=512
CONFIG_MCUMGR_GRP_IMG=y
CONFIG_MCUMGR_GRP_OS=y
CONFIG_IMG_MANAGER=y
CONFIG_STREAM_FLASH=y
CONFIG_MPU_ALLOW_FLASH_WRITE=y
# Quiet the USB stack: usbd_ch9/udc_nrf log every control transfer at INF,
# so each host port-open floods the CDC console (which rides the same USB
# stack) with dozens of log lines. The burst coincides with watchdog resets
# at port-open; drop to WRN so opens are quiet.
CONFIG_USBD_LOG_LEVEL_WRN=y
CONFIG_UDC_DRIVER_LOG_LEVEL_WRN=y

# Erase slot1 page-by-page as the upload advances. Without this, img_mgmt
# erases the whole slot (~364 KB) on the first chunk; nRF52 NVMC erase halts
# the CPU, the 4 s hardware watchdog can't be fed, and the SoC resets
# mid-upload (console dies mid-line, USB re-enumerates).
CONFIG_IMG_ERASE_PROGRESSIVELY=y

# Persist the link TX epoch across reboots (bd 3uhb): advance it +1 each
# boot so a rebooted node's counter stays ahead of peers' replay windows,
# eliminating the ~50% reboot replay coin-flip. Settings-on-NVS backed by
# the board's storage_partition (FLASH/FLASH_MAP already enabled above).
CONFIG_NVS=y
CONFIG_SETTINGS=y
CONFIG_SETTINGS_NVS=y
CONFIG_LICHEN_LINK_EPOCH_PERSIST=y

# Serve the node's position at GET /sensors/location as SenML+CBOR
# (spec 12-apps.md §18.2.2). Returns 4.04 until a valid fix is available.
CONFIG_LICHEN_SENML=y
CONFIG_LICHEN_COAP_LOCATION=y

# E-ink display (GDEW0154M10 / SSD1681) for T-Echo
# Enables lichen_hal_display_* and display subsystem. Follows t_deck pattern.
# (project-LICHEN-2h1i.1.2.1.1)
CONFIG_DISPLAY=y
CONFIG_SSD16XX=y
CONFIG_LICHEN_HAS_DISPLAY=y
```

## lichen/apps/puck/boards/tbeam_supreme.conf
```kconfig
# BLOCKED: T-Beam Supreme board config (USB CDC-ACM + SLIP)
# No canonical board; see tbeam_supreme.overlay for BLOCKED classification
# and evidence. ESP32-S3 UDC config kept for reference/proxy use.

CONFIG_USB_DEVICE_STACK_NEXT=y
CONFIG_UDC_ESP32SX=y
CONFIG_USBD_CDC_ACM_CLASS=y

CONFIG_SLIP=y
CONFIG_NET_L2_SLIP=y
CONFIG_UART_LINE_CTRL=y
CONFIG_NET_BUF_DATA_SIZE=128
```

## lichen/apps/puck/boards/ttgo_lora32_esp32_procpu.conf
```kconfig
# LilyGo T3 V1.6.1 puck config — ESP32 + SX1276

CONFIG_SPI=y
CONFIG_LORA_SX127X=y
CONFIG_LICHEN_HAS_LORA=y
CONFIG_LICHEN_RADIO_MODEL_SX127X=y
```

## lichen/boards/elecrow/thinknode_m7/Kconfig
```kconfig
# SPDX-License-Identifier: GPL-3.0-or-later

config BOARD_ELECROW_THINKNODE_M7
	bool
	select SOC_ESP32S3_FN8
	select SOC_ESP32S3_PROCPU if BOARD_ELECROW_THINKNODE_M7_ESP32S3_PROCPU
	select SOC_ESP32S3_APPCPU if BOARD_ELECROW_THINKNODE_M7_ESP32S3_APPCPU
	select BOARD
	select NET_L2_ETHERNET
	select LICHEN_HAS_PMIC
	help
	  Elecrow ThinkNode M7 PoE board with LR1110 and SI3402 PoE controller.
```

## lichen/boards/elecrow/thinknode_m7/Kconfig.defconfig
```kconfig
# SPDX-License-Identifier: GPL-3.0-or-later

if BOARD_ELECROW_THINKNODE_M7

config HEAP_MEM_POOL_ADD_SIZE_BOARD
	int
	default 65535 if WIFI && BT
	default 51200 if WIFI
	default 40960 if BT
	default 4096

config BOARD
	default "elecrow_thinknode_m7"

endif # BOARD_ELECROW_THINKNODE_M7

if BOARD_ELECROW_THINKNODE_M7_ESP32S3_APPCPU

config HEAP_MEM_POOL_ADD_SIZE_BOARD
	default 256

endif # BOARD_ELECROW_THINKNODE_M7_ESP32S3_APPCPU
```

## lichen/boards/elecrow/thinknode_m7/elecrow_thinknode_m7_appcpu_defconfig
```kconfig
# SPDX-License-Identifier: GPL-3.0-or-later

CONFIG_MAIN_STACK_SIZE=2048
CONFIG_SERIAL=y
CONFIG_UART_CONSOLE=y
```

## lichen/boards/heltec/heltec_wifi_lora32_v3/Kconfig.heltec_wifi_lora32_v3
```kconfig
config BOARD_HELTEC_WIFI_LORA32_V3
	select SOC_ESP32S3_FN8
	select SOC_ESP32S3_PROCPU if BOARD_HELTEC_WIFI_LORA32_V3_ESP32S3_PROCPU
	select SOC_ESP32S3_APPCPU if BOARD_HELTEC_WIFI_LORA32_V3_ESP32S3_APPCPU
	select WIFI_NM
	select ESP_WIFI_ENABLED
```

## lichen/boards/heltec/heltec_wifi_lora32_v3/heltec_wifi_lora32_v3_procpu_defconfig
```kconfig
# SPDX-License-Identifier: GPL-3.0-or-later

CONFIG_MAIN_STACK_SIZE=4096

CONFIG_CLOCK_CONTROL=y
CONFIG_CONSOLE=y
CONFIG_GPIO=y
CONFIG_SERIAL=y
CONFIG_SPI=y
CONFIG_UART_CONSOLE=y
```
