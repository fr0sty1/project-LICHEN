## lichen/boards/lilygo/t_deck/Kconfig.defconfig
```kconfig
# SPDX-License-Identifier: GPL-3.0-or-later

if BOARD_T_DECK_ESP32S3_PROCPU
config HEAP_MEM_POOL_ADD_SIZE_BOARD
	int
	default 131072 if LVGL
	default 65535 if WIFI && BT
	default 51200 if WIFI
	default 40960 if BT
	default 8192 if !LVGL && !WIFI && !BT

config LICHEN_HAS_DISPLAY
	default y
	select LVGL
	select DISPLAY
	select ST7789V if DISPLAY
	select INPUT
	select GPIO_KEYS
	select I2C
	select INPUT_GPIO_KEYS

config I2C
	default y
config INPUT
	default y
config INPUT_GPIO_KEYS
	default y

config LV_Z
	default y if LICHEN_HAS_DISPLAY
endif # BOARD_T_DECK_ESP32S3_PROCPU

if BOARD_T_DECK_ESP32S3_APPCPU

config HEAP_MEM_POOL_ADD_SIZE_BOARD
	default 256

endif # BOARD_T_DECK_ESP32S3_APPCPU
```

## lichen/boards/lilygo/t_deck/Kconfig.t_deck
```kconfig
# SPDX-License-Identifier: GPL-3.0-or-later

config BOARD_T_DECK
	select SOC_ESP32S3_R8
	select SOC_ESP32S3_PROCPU if BOARD_T_DECK_ESP32S3_PROCPU
	select SOC_ESP32S3_APPCPU if BOARD_T_DECK_ESP32S3_APPCPU
```

## lichen/boards/lilygo/t_deck/t_deck_esp32s3_appcpu_defconfig
```kconfig
# SPDX-License-Identifier: GPL-3.0-or-later

CONFIG_MAIN_STACK_SIZE=512
CONFIG_HEAP_MEM_POOL_SIZE=0
```

## lichen/boards/lilygo/t_deck/t_deck_esp32s3_procpu_defconfig
```kconfig
# SPDX-License-Identifier: GPL-3.0-or-later

CONFIG_MAIN_STACK_SIZE=8192

CONFIG_CLOCK_CONTROL=y
CONFIG_CONSOLE=y
CONFIG_ESPTOOLPY_FLASHSIZE_16MB=y
CONFIG_GPIO=y
CONFIG_SERIAL=y
CONFIG_SPI=y
CONFIG_UART_CONSOLE=y
CONFIG_I2C=y
CONFIG_INPUT=y
CONFIG_DISPLAY=y
CONFIG_ST7789V=y
```

## lichen/boards/lilygo/t_echo/Kconfig
```kconfig
# SPDX-License-Identifier: GPL-3.0-or-later

if BOARD_T_ECHO

config BOARD_ENABLE_DCDC
	bool "Enable DC/DC converter"
	select SOC_DCDC_NRF52X
	default y

endif # BOARD_T_ECHO
```

## lichen/boards/lilygo/t_echo/Kconfig.defconfig
```kconfig
# SPDX-License-Identifier: GPL-3.0-or-later

if BOARD_T_ECHO

config BT_CTLR
	default BT

endif # BOARD_T_ECHO
```

## lichen/boards/lilygo/t_echo/Kconfig.t_echo
```kconfig
# LilyGo T-Echo board selection
# SPDX-License-Identifier: GPL-3.0-or-later

config BOARD_T_ECHO
	select SOC_NRF52840_QIAA
```

## lichen/boards/lilygo/t_echo/t_echo_nrf52840_defconfig
```kconfig
# SPDX-License-Identifier: GPL-3.0-or-later

# ARM MPU and stack protection
CONFIG_ARM_MPU=y
CONFIG_HW_STACK_PROTECTION=y

# LF clock: 32 kHz crystal (LFXO) is populated on T-Echo
CONFIG_CLOCK_CONTROL_NRF_K32SRC_XTAL=y

# GPIO
CONFIG_GPIO=y

# SPI (for LoRa and e-ink)
CONFIG_SPI=y

# I2C (for PCF8563 RTC)
CONFIG_I2C=y

# RTT console — no USB-UART chip on V1; use J-Link RTT for debug output.
# Apps that want USB CDC-ACM console should add CONFIG_USB_DEVICE_STACK=y
# and CONFIG_USB_CDC_ACM=y to their prj.conf.
CONFIG_USE_SEGGER_RTT=y
CONFIG_RTT_CONSOLE=y
CONFIG_CONSOLE=y
CONFIG_UART_CONSOLE=n
```

## lichen/boards/muzi/r1_neo/Kconfig.defconfig
```kconfig
# SPDX-License-Identifier: GPL-3.0-or-later

if BOARD_R1_NEO

config BT_CTLR
	default BT

endif # BOARD_R1_NEO
```
