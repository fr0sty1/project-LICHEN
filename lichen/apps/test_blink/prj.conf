## CMakeLists.txt
```
cmake_minimum_required(VERSION 3.20)
find_package(Zephyr REQUIRED HINTS $ENV{ZEPHYR_BASE})
project(test_blink)
target_sources(app PRIVATE src/main.c)
```

## prj.conf
```kconfig
# Absolute minimum — no drivers, no USB, no console
CONFIG_SERIAL=n
CONFIG_UART_CONSOLE=n
CONFIG_CONSOLE=n
CONFIG_LOG=n
CONFIG_USB_DEVICE_STACK=n
CONFIG_GPIO=y
CONFIG_USE_DT_CODE_PARTITION=y

# Safety (spec appendix-c-safety); assert fires via hard fault when no console
CONFIG_STACK_CANARIES=y
CONFIG_STACK_SENTINEL=y
CONFIG_ASSERT=y
CONFIG_ASSERT_VERBOSE=y
```

## boards/t1000_e_nrf52840.overlay
```dts
/ {
	chosen {
		/* Standalone - linked directly to boot_partition (0x1000), no MCUboot */
		zephyr,code-partition = &boot_partition;
	};
};
```

## src/main.c
```c
/* Minimal T1000-E blink: raw NRF registers only, ~1 s on / 1 s off */
#include <zephyr/kernel.h>
#include <nrf52840.h>

int main(void)
{
	NRF_P0->DIRSET = BIT(24);
	while (1) {
		NRF_P0->OUTSET = BIT(24);
		for (volatile uint32_t i = 0; i < 64000000; i++);
		NRF_P0->OUTCLR = BIT(24);
		for (volatile uint32_t i = 0; i < 64000000; i++);
	}
	return 0;
}
```
