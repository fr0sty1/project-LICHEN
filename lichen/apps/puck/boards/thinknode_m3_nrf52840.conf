## lichen/boards/elecrow/thinknode_m3/Kconfig.defconfig
```kconfig
# SPDX-License-Identifier: GPL-3.0-or-later

if BOARD_THINKNODE_M3

config BT_CTLR
	default BT

endif # BOARD_THINKNODE_M3
```

## lichen/boards/elecrow/thinknode_m3/Kconfig.thinknode_m3
```kconfig
# Elecrow ThinkNode M3 board selection
# SPDX-License-Identifier: GPL-3.0-or-later

config BOARD_THINKNODE_M3
	select SOC_NRF52840_QIAA
```

## lichen/drivers/rtc/Kconfig
```kconfig
# SPDX-License-Identifier: Apache-2.0

config LICHEN_RTC_RX8130CE
	bool "Epson RX8130CE RTC driver"
	default y
	depends on DT_HAS_LICHEN_RX8130CE_RTC_ENABLED
	select RTC
	help
	  Out-of-tree RTC driver for the Epson RX8130CE I2C real-time clock.
	  The pinned Zephyr v3.7.0 has no RX8130CE driver; this shim keeps
	  R1 Neo (and other boards using the lichen,rx8130ce-rtc compatible)
	  working until the LICHEN Zephyr pin moves past the upstream driver
	  introduction. Implements get/set time and init only.
```

## lichen/dts/bindings/rtc/lichen,rx8130ce-rtc.yaml
```yaml
# SPDX-License-Identifier: Apache-2.0
# Copyright (c) 2025 Måns Ansgariusson <mansgariusson@gmail.com>
# Copyright (c) 2026 The contributors to the LICHEN project

description: |
  Epson RX8130CE I2C real-time clock.

  LICHEN binding for the out-of-tree RX8130CE driver. Property semantics
  mirror the upstream Zephyr "epson,rx8130ce-rtc" binding (Zephyr >= 4.1);
  the LICHEN compatible exists because the pinned Zephyr v3.7.0 has no
  RX8130CE driver, and a duplicate compatible would collide with the
  upstream binding in shared Zephyr workspaces >= 4.1.

compatible: "lichen,rx8130ce-rtc"

include: [i2c-device.yaml, rtc-device.yaml]

properties:
  clockout-frequency:
    type: int
    description: |
      Frequency output on the FOUT pin in Hz. If not specified the clock
      output is disabled.
      - 1 # 1 Hz
      - 1024 # 1.024 kHz
      - 32768 # 32.768 kHz
    enum: [1, 1024, 32768]

  battery-switchover:
    type: int
    description: |
      Enable the battery backup feature and specify the switchover mode.
      If not specified the battery backup feature is left at its power-on
      default (disabled).
      - 1 # Non-rechargeable battery backup; i2c & FOUT disabled when VDD is below Vdet1
      - 2 # Non-rechargeable battery backup; i2c & FOUT always on
      - 3 # Rechargeable battery backup; i2c & FOUT disabled when VDD is below Vdet1
      - 4 # Rechargeable battery backup; i2c & FOUT always on
    enum: [1, 2, 3, 4]
```

## lichen/subsys/lichen/app_identity/Kconfig
```kconfig
# SPDX-License-Identifier: GPL-3.0-or-later
# SPDX-FileCopyrightText: The contributors to the LICHEN project

menuconfig LICHEN_APP_IDENTITY
	bool "LICHEN local app identity provider"
	depends on LICHEN
	depends on LICHEN_LINK
	select LICHEN_CRYPTO_MONOCYPHER
	help
	  Enable a copy-only public identity provider for local app
	  compatibility surfaces. This exposes self EUI/IID/public key and a
	  bounded public peer table without exposing private key material.

if LICHEN_APP_IDENTITY

config LICHEN_APP_IDENTITY_MAX_PEERS
	int "Maximum app-visible peer identities"
	default 8
	range 1 32
	help
	  Maximum number of public peer identity records retained for local app
	  compatibility surfaces.

config LICHEN_APP_IDENTITY_PERSIST
	bool "Persist the canonical node identity with Zephyr Settings"
	depends on SETTINGS
	default y
	help
	  Store one versioned, EUI-bound 32-byte identity seed in private
	  Settings storage. The platform must register an independent protected
	  rollback authority before using the Settings convenience API. Corrupt,
	  incomplete, stale, divergent, or unavailable established state fails
	  closed instead of silently generating another identity.

config LICHEN_APP_IDENTITY_TEST_HOOKS
	bool "LICHEN app identity ztest hooks"
	depends on ZTEST
	default n
	help
	  Enable reset hooks used only by native_sim app-identity tests.

endif # LICHEN_APP_IDENTITY
```

## lichen/subsys/lichen/app_interface/Kconfig
```kconfig
# SPDX-License-Identifier: GPL-3.0-or-later
# SPDX-FileCopyrightText: The contributors to the LICHEN project

menuconfig LICHEN_APP_INTERFACE
	bool "LICHEN local app-interface event contract"
	depends on LICHEN
	help
	  Enable the board-agnostic local app ingress/egress event contract used
	  by Meshtastic, MeshCore, native, CoAP, and future app surfaces.

if LICHEN_APP_INTERFACE

config LICHEN_APP_INTERFACE_MAX_SUBSCRIBERS
	int "Maximum app-interface subscribers"
	default 4
	range 1 8
	help
	  Maximum number of local app surfaces that can subscribe to shared
	  text/status events.

config LICHEN_APP_INTERFACE_MAX_PAYLOAD
	int "Maximum app-interface payload size"
	default 176
	range 1 512
	help
	  Maximum byte payload accepted by the shared app-interface event API.

config LICHEN_APP_INTERFACE_IPC_QUEUE_DEPTH
	int "Same-device IPC packet queue depth per direction"
	default 2
	range 1 8
	help
	  Number of complete IPv6 packets retained independently in each direction
	  between a same-MCU app and the network stack.

config LICHEN_APP_INTERFACE_IPC_MAX_PACKET
	int "Same-device IPC maximum IPv6 packet size"
	default 1280
	range 40 1280
	help
	  Maximum complete IPv6 packet accepted by the same-device IPC queues.
	  Static storage is allocated for two queues; no heap allocation is used.

config LICHEN_APP_INTERFACE_TEST_HOOKS
	bool "LICHEN app-interface ztest hooks"
	depends on ZTEST
	default n
	help
	  Enable reset hooks used only by native_sim app-interface tests.

endif # LICHEN_APP_INTERFACE
```
