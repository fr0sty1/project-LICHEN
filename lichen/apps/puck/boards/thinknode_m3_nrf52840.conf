## lichen/subsys/lichen/coap/Kconfig
```kconfig
# SPDX-License-Identifier: GPL-3.0-or-later
# SPDX-FileCopyrightText: The contributors to the LICHEN project

# LICHEN CoAP subsystem Kconfig

menuconfig LICHEN_COAP
	bool "LICHEN CoAP support"
	depends on LICHEN
	select COAP
	help
	  Enable LICHEN CoAP support (client and/or server).

if LICHEN_COAP

config LICHEN_COAP_CLIENT
	bool "LICHEN CoAP client"
	select COAP_CLIENT
	default y
	help
	  Enable LICHEN CoAP client for making requests to mesh nodes.

config LICHEN_COAP_CLIENT_LOG_LEVEL
	int "CoAP client log level"
	depends on LICHEN_COAP_CLIENT
	default 3
	range 0 4
	help
	  Log level for LICHEN CoAP client:
	  0=off, 1=error, 2=warning, 3=info, 4=debug

config LICHEN_COAP_CLIENT_OSCORE
	bool "OSCORE protection for CoAP client"
	depends on LICHEN_COAP_CLIENT
	depends on LICHEN_OSCORE
	default y
	help
	  Enable OSCORE (RFC 8613) end-to-end security for CoAP requests.
	  When enabled, requests with a non-NULL oscore_ctx are protected
	  using AES-CCM-16-64-128. Responses are automatically decrypted
	  before delivery to the callback.

	  SECURITY: Per spec/06-security.md Section 8.7, OSCORE is
	  recommended for all CoAP traffic to provide end-to-end security
	  independent of the link layer.

config LICHEN_COAP_SERVER
	bool "LICHEN CoAP server"
	select COAP_SERVER
	default y
	help
	  Enable LICHEN CoAP server for responding to requests from mesh nodes.
	  Exposes LCI resources: /status, /config, /neighbors, /keys, /msg/inbox,
	  and /.well-known/core for resource discovery.

config LICHEN_COAP_SERVER_STANDALONE
	bool "Standalone subsystem-owned CoAP service (coap_server.c)"
	depends on LICHEN_COAP_SERVER
	depends on !LICHEN_COAP_CONFIG
	default n
	help
	  Compile the subsystem-owned COAP_SERVICE (lichen_coap_server) from
	  coap_server.c, which registers its own /status, /config, /neighbors,
	  /msg/inbox resources. The /keys resource is provided by the
	  LICHEN_COAP_KEYS module (coap_keys.c).

	  Keep this off in applications that define their own CoAP service
	  and use the per-resource handler modules (LICHEN_COAP_STATUS,
	  LICHEN_COAP_CONFIG, LICHEN_COAP_KEYS, LICHEN_COAP_MSG) — the
	  gateway app does this with its lichen_coap service — otherwise the
	  same LCI paths are served twice on different sockets.

config LICHEN_COAP_SERVER_LOG_LEVEL
	int "CoAP server log level"
	depends on LICHEN_COAP_SERVER
	default 3
	range 0 4
	help
	  Log level for LICHEN CoAP server:
	  0=off, 1=error, 2=warning, 3=info, 4=debug

config LICHEN_COAP_SERVER_OSCORE
	bool "OSCORE protection for CoAP server"
	depends on LICHEN_COAP_SERVER
	depends on LICHEN_OSCORE
	default y
	help
	  Enable OSCORE (RFC 8613) end-to-end security for CoAP server.
	  When enabled, the server can verify OSCORE-protected requests
	  and send OSCORE-protected responses.

	  SECURITY: Per spec/06-security.md Section 8.7, OSCORE is
	  recommended for all CoAP traffic to provide end-to-end security
	  independent of the link layer.

config LICHEN_COAP_CONFIG
	bool "LCI /config resource handlers"
	depends on LICHEN_COAP_SERVER
	imply ZCBOR
	select LICHEN_COAP_KEYS
	help
	  Enable CoAP server resources for node configuration per LCI spec
	  section 17.5.2:
	  - GET/PUT /config - node name and role
	  - GET/PUT /config/radio - radio parameters
	  - GET /config/identity - read-only identity info

	  Requires a configuration provider to be registered via
	  lichen_coap_config_register() before handling requests.

config LICHEN_COAP_CONFIG_LOG_LEVEL
	int "CoAP config log level"
	depends on LICHEN_COAP_CONFIG
	default 3
	range 0 4
	help
	  Log level for LICHEN CoAP config handlers:
	  0=off, 1=error, 2=warning, 3=info, 4=debug

config LICHEN_COAP_STATUS
	bool "LCI /status resource handlers"
	depends on LICHEN_COAP_SERVER
	default y
	help
	  Enable LCI /status resource handlers per spec section 17.5.3.
	  Implements:
	  - GET /status - Node status with DODAG, time, radio stats
	  - GET /status/neighbors - Neighbor table with RSSI/SNR/ETX
	  - GET /status/routes - Routing table

	  All resources support RFC 7641 Observe for push notifications.

config LICHEN_COAP_STATUS_MAX_NEIGHBORS
	int "Maximum neighbors in /status/neighbors response"
	depends on LICHEN_COAP_STATUS
	default 8
	range 1 32
	help
	  Maximum number of neighbor entries returned in a single
	  /status/neighbors response.

config LICHEN_COAP_STATUS_MAX_ROUTES
	int "Maximum routes in /status/routes response"
	depends on LICHEN_COAP_STATUS
	default 8
	range 1 32
	help
	  Maximum number of route entries returned in a single
	  /status/routes response.

config LICHEN_COAP_STATUS_LOG_LEVEL
	int "CoAP status log level"
	depends on LICHEN_COAP_STATUS
	default 3
	range 0 4
	help
	  Log level for LICHEN CoAP status handlers:
	  0=off, 1=error, 2=warning, 3=info, 4=debug

config LICHEN_COAP_MSG
	bool "LCI /msg/* resource handlers"
	depends on LICHEN_COAP_SERVER
	select LICHEN_COAP_STATUS
	imply ZCBOR
	select COAP_URI_WILDCARD
	help
	  Enable CoAP server resources for application-level messaging per
	  LCI spec section 17.5.7:
	  - POST /msg/sent - queue outbound message
	  - GET /msg/sent/<id> - get sent message status
	  - GET /msg/inbox - retrieve inbound messages (Observable)
	  - POST /msg/ack - acknowledge message receipt

	  Messages are queued in memory with configurable limits. This is
	  an optional feature for chat-like human messaging; applications
	  may instead use CoAP directly to mesh nodes.

config LICHEN_COAP_MSG_LOG_LEVEL
	int "CoAP msg log level"
	depends on LICHEN_COAP_MSG
	default 3
	range 0 4
	help
	  Log level for LICHEN CoAP messaging handlers:
	  0=off, 1=error, 2=warning, 3=info, 4=debug

config LICHEN_COAP_RANGETEST
	bool "CoAP /diag/rangetest and /diag/traceroute resources"
	depends on LICHEN_COAP_SERVER
	depends on LICHEN_OSCORE
	help
	  Enable the range testing resources per spec/12-apps.md section 18.7:
	  - POST /diag/rangetest - extended range test (18.7.2), responds with
	    a SenML+CBOR pack (Content-Format 112) of radio metrics
	  - GET /diag/rangetest - continuous range test (18.7.3), Observable,
	    optional interval_ms body
	  - GET /diag/traceroute - mesh path discovery (18.7.4)

	  Radio metrics and traceroute hops come from the provider registered
	  via lichen_rangetest_init(); without one, static defaults are used.

config LICHEN_COAP_RANGETEST_LOG_LEVEL
	int "CoAP range test log level"
	depends on LICHEN_COAP_RANGETEST
	default 3
	range 0 4
	help
	  Log level for the CoAP range testing handlers:
	  0=off, 1=error, 2=warning, 3=info, 4=debug

config LICHEN_COAP_KEYS
	bool "LCI /keys resource handlers"
	depends on LICHEN_COAP_SERVER
	# coap_keys.c calls slip_transport_iface_get() and includes
	# <lichen/transport/slip_transport.h> to scope admin (PUT/DELETE)
	# access to the SLIP LCI interface. Without the SLIP transport the
	# header is off the include path and the symbol is undefined at link,
	# so this option genuinely requires it (bd a2a2).
	depends on LICHEN_SLIP_TRANSPORT
	depends on ZCBOR
	select COAP_URI_WILDCARD
	imply TINYCRYPT_SHA256
	help
	  Enable CoAP server resources for key store management per LCI spec
	  section 17.5.5:
	  - GET /keys - list peer IIDs with pubkey fingerprints, trust level
	  - GET /keys/{iid} - get specific peer's full pubkey
	  - PUT /keys/{iid} - add/update peer key (requires local admin)
	  - DELETE /keys/{iid} - remove peer (requires local admin)

	  Keys are stored in memory. TOFU key pinning is enforced: once a key
	  is learned for an IID, it cannot be changed without explicit removal.

	  SECURITY: Write operations require local admin access (loopback or
	  BLE LCI interface).

config LICHEN_COAP_KEYS_MAX_ENTRIES
	int "Maximum key store entries"
	depends on LICHEN_COAP_KEYS
	default 16
	range 4 16
	help
	  Maximum number of peer keys to store. Capped at 16 by CBOR encoder
	  stack usage in encode_keys_list_cbor() and the BUILD_ASSERT in
	  coap_keys.c. Each entry requires ~60 bytes of RAM.

config LICHEN_COAP_KEYS_LOG_LEVEL
	int "CoAP keys log level"
	depends on LICHEN_COAP_KEYS
	default 3
	range 0 4
	help
	  Log level for LICHEN CoAP keys handlers:
	  0=off, 1=error, 2=warning, 3=info, 4=debug

config LICHEN_COAP_KEYS_TEST_HOOKS
	bool "Test hooks for key store"
	depends on LICHEN_COAP_KEYS
	depends on ZTEST
	help
	  Enable test hooks for resetting the key store. Only for testing.

config LICHEN_COAP_LOCATION
	bool "CoAP /sensors/location resource (SenML position)"
	depends on !LICHEN_COAP_SERVER_STANDALONE
	depends on LICHEN_SENML
	depends on LICHEN_HAL
	depends on LICHEN_LORA_L2
	default n
	help
	  Serve GET /sensors/location as a SenML pack (application/senml+cbor,
	  spec 12-apps.md section 18.2.2) describing the node's current position,
	  or 4.04 when it has no valid fix. Requires the SenML encoder, the HAL
	  location provider, and the LoRa L2 (for the node EUI-64 base name).

config LICHEN_COAP_LOCATION_LOG_LEVEL
	int "CoAP location log level"
	depends on LICHEN_COAP_LOCATION
	default 3
	range 0 4
	help
	  Log level for the LICHEN CoAP location handler:
	  0=off, 1=error, 2=warning, 3=info, 4=debug

config LICHEN_COAP_DEADDROP
	bool "LCI /deaddrop DTN store-forward resource"
	depends on LICHEN_COAP_SERVER
	depends on LICHEN_OSCORE
	depends on LICHEN_DTN
	select COAP_URI_WILDCARD
	imply ZCBOR
	help
	  LCI /deaddrop (POST to store encrypted msg for recipient, GET?node=IID to pickup pending)
	  and /confessions for anonymous rate-limited broadcast. Per spec 18.11 and 18.9.
	  Requires LICHEN_COAP_SERVER to host the resource and LICHEN_OSCORE for E2E
	  encryption of stored messages. Query params resolved via COAP_URI_WILDCARD
	  (auto-selected). SenML+CBOR (112), DTN storage.

config LICHEN_COAP_DEADDROP_RATE_LIMIT_MS
	int "Rate limit for deaddrop/confessions POSTs in ms"
	depends on LICHEN_COAP_DEADDROP
	default 60000
	range 1000 600000
	help
	  Minimum interval between POSTs per-source (IID bucket) for /deaddrop and
	  /confessions. Prevents spam/DoS and storage exhaustion (spec 12-apps.md:18.9,
	  06-security.md). 60s default balances utility vs abuse prevention.

config LICHEN_COAP_DEADDROP_MAX_STORAGE
	int "Max deaddrop storage entries"
	depends on LICHEN_COAP_DEADDROP
	default 8
	range 1 64
	help
	  Maximum messages in DTN deaddrop buffer.

config LICHEN_COAP_DEADDROP_LOG_LEVEL
	int "CoAP deaddrop log level"
	depends on LICHEN_COAP_DEADDROP
	default 3
	range 0 4
	help
	  Log level for LICHEN CoAP deaddrop handler: 0=off, 1=error, 2=warning, 3=info, 4=debug

config LICHEN_COAP_SLOT_COORD
	bool "Enable Slot Coordination (GCP-6)"
	depends on LICHEN_COAP_SERVER
	depends on LICHEN_SCHNORR48
	default n
	help
	  Enable GCP-6 Slot Coordination protocol per spec/08-gateway-coordination.md
	  Section 6. Provides superframe synchronization, slot allocation, and
	  conflict resolution for gateway coordination.

	  SECURITY: All slot claims are signed with Schnorr48. Claims with invalid
	  or missing signatures are silently discarded.

config LICHEN_COAP_SLOT_COORD_RESOURCE
	bool "Enable Slot Coordination CoAP resources"
	depends on LICHEN_COAP_SLOT_COORD
	default y
	help
	  Expose CoAP resources for slot coordination: /info, /slots, /channels.
	  Disable to use slot coordination internally without exposing CoAP endpoints.

config LICHEN_COAP_SLOT_COORD_LOG_LEVEL
	int "Slot coordination log level"
	depends on LICHEN_COAP_SLOT_COORD
	default 3
	range 0 4
	help
	  Log level for slot coordination: 0=off, 1=error, 2=warning, 3=info, 4=debug

config LICHEN_COAP_HANDOFF
	bool "Enable Node Handoff (GCP-7)"
	depends on LICHEN_COAP_SERVER
	depends on LICHEN_OSCORE
	default n
	help
	  Enable GCP-7 Node Handoff protocol per spec/08-gateway-coordination.md
	  Section 7. Provides node ownership transfer between gateways when nodes
	  move between coverage areas.

	  State transferred includes sequence numbers, OSCORE security contexts,
	  freshness state, and parent list.

	  SECURITY: Handoff messages MUST be authenticated via OSCORE. Unauthenticated
	  handoff requests enable node hijacking attacks. Sequence numbers are
	  incremented on acceptance to prevent replay of in-flight messages.

config LICHEN_COAP_HANDOFF_RESOURCE
	bool "Enable Node Handoff CoAP resource"
	depends on LICHEN_COAP_HANDOFF
	default y
	help
	  Expose CoAP resource for node handoff: /.well-known/lichen-gw/handoff.
	  Disable to use handoff protocol internally without exposing CoAP endpoint.

config LICHEN_COAP_HANDOFF_MAX_NODES
	int "Maximum nodes in handoff registry"
	depends on LICHEN_COAP_HANDOFF
	default 32
	range 4 128
	help
	  Maximum number of nodes tracked in the gateway's node registry for
	  handoff protocol. Each entry requires approximately 200 bytes of RAM.

config LICHEN_COAP_HANDOFF_LOG_LEVEL
	int "Node handoff log level"
	depends on LICHEN_COAP_HANDOFF
	default 3
	range 0 4
	help
	  Log level for node handoff: 0=off, 1=error, 2=warning, 3=info, 4=debug

config LICHEN_SOS_ALERT
	bool "SOS alert CBOR encoding (spec 18.4.2)"
	default y
	help
	  Enable SOS alert CBOR encoding and decoding per spec section 18.4.2.
	  Provides data types and codec for the SOS alert payload:
	  - type: sos, medical, security, fire, cancel
	  - node: originating node IID (IPv6 hex)
	  - ts: Unix timestamp
	  - lat/lon: optional position
	  - msg: optional message
	  - seq: sequence number for updates

config LICHEN_SOS_RESOURCE
	bool "SOS resource state machine (spec 18.4)"
	default y if LICHEN_SOS_ALERT
	help
	  Enable SOS resource state machine for /sos CoAP endpoint per spec 18.4.
	  Provides state tracking for emergency beacon lifecycle:
	  - IDLE: No active emergency
	  - ACTIVE: SOS triggered, awaiting acknowledgment
	  - ACKNOWLEDGED: SOS acknowledged by coordinator
	  - CANCELLED: SOS cancelled by originator

	  The state machine enforces security invariants:
	  - Only originator can cancel their own SOS
	  - Sequence numbers must strictly advance (replay protection)
	  - Originator data is securely zeroed on reset

config LICHEN_CHECKIN
	bool "Check-In / Roll Call codec and service (spec 18.6)"
	default y
	help
	  Enable Check-In / Roll Call per spec section 18.6. Provides a pure
	  C11 CBOR codec plus a deterministic service for:
	  - POST /checkin (18.6.1): status ok/help/delayed, optional
	    lat/lon (inclusive bounds, all-or-none) and msg
	  - POST /rollcall (18.6.2): id coercion, timeout 1..604800,
	    far-future rejection, prune-oldest and 5.03-at-capacity policies
	  - GET /rollcall/<id> status documents (18.6.3)
	  - scheduled check-in configuration (18.6.4)
	  Storage is caller-provisioned; the module keeps no global state.
	  Conformance vectors: test/vectors/checkin_rollcall.json.

config LICHEN_CHECKIN_RESOURCE
	bool "Check-In / Roll Call CoAP resources (/checkin, /rollcall)"
	depends on LICHEN_CHECKIN
	depends on LICHEN_COAP_SERVER
	default n
	help
	  Register /checkin, /rollcall, and /config/checkin CoAP resources
	  against the lichen_coap_server CoAP service (the resources are
	  defined with COAP_RESOURCE_DEFINE(..., lichen_coap_server, ...)).
	  The service must therefore come from either:
	  - CONFIG_LICHEN_COAP_SERVER_STANDALONE: the subsystem-owned
	    coap_server.c service, which also declares the
	    coap_resource_lichen_coap_server iterable section, or
	  - an application-owned CoAP service that declares that iterable
	    section and links the handler symbols (as the puck and gateway
	    apps do).
	  Without one of the two, the resource definitions fail at link time.
	  The module owns a mutex-serialized service instance sized
	  by CONFIG_LICHEN_CHECKIN_MAX_CHECKINS / MAX_ROLLCALLS.

config LICHEN_CHECKIN_MAX_CHECKINS
	int "Maximum stored check-ins (resource instance)"
	depends on LICHEN_CHECKIN_RESOURCE
	default 16
	range 1 256
	help
	  Each entry is approximately 280 bytes. The conformance suite runs
	  the oracle capacity of 256; constrained targets may lower this.

config LICHEN_CHECKIN_MAX_ROLLCALLS
	int "Maximum tracked roll calls (resource instance)"
	depends on LICHEN_CHECKIN_RESOURCE
	default 4
	range 1 256
	help
	  Each roll call tracks up to LICHEN_ROLLCALL_TRACK_MAX responses.
	  Overflowing POSTs receive 5.03 Service Unavailable.

config LICHEN_CHECKIN_PAYLOAD_MAX
	int "Check-In / Roll Call CBOR payload buffer size"
	depends on LICHEN_CHECKIN_RESOURCE
	default 5120
	range 256 16384
	help
	  Static buffer used to decode requests and encode list/status
	  documents. Must bound the worst-case {"checkins":[...]} document
	  for the configured store sizes; this is enforced at build time
	  (MAX_CHECKINS x worst-case entry, LICHEN_CHECKIN_ENTRY_CBOR_MAX
	  in lichen/checkin.h, plus wrapper). It must also hold one
	  worst-case roll-call status document (LICHEN_ROLLCALL_RENDER_MAX
	  plus wrapper, also enforced at build time); the all-roll-calls
	  list document is clamped to what fits rather than failing. A
	  build error here means the buffer cannot hold those documents:
	  raise this value or lower the relevant store size.

config LICHEN_CHECKIN_LOG_LEVEL
	int "Check-In / Roll Call log level"
	depends on LICHEN_CHECKIN_RESOURCE
	default 3
	range 0 4
	help
	  Log level for the check-in resource: 0=off, 1=error, 2=warning,
	  3=info, 4=debug

endif # LICHEN_COAP
```
