## lichen/subsys/lichen/compact_cot/Kconfig
```kconfig
# SPDX-License-Identifier: GPL-3.0-or-later
# SPDX-FileCopyrightText: The contributors to the LICHEN project

config LICHEN_COMPACT_COT_PLI
	bool "Compact CoT PLI codec"
	default n
	help
	  Enable the bounded, allocation-free Position Location Information
	  encoder and decoder for Compact Cursor on Target datagrams on UDP port
	  5681. The canonical wire format is exactly 17 bytes.

config LICHEN_COMPACT_COT_CHAT
	bool "Compact CoT chat codec"
	default n
	help
	  Enable the bounded, allocation-free chat encoder and decoder for Compact
	  Cursor on Target datagrams on UDP port 5681. Broadcast, team, and direct
	  IPv6 destinations and messages of up to 255 UTF-8 bytes are supported.
```

## lichen/subsys/lichen/gateway/Kconfig
```kconfig
# SPDX-License-Identifier: GPL-3.0-or-later
# SPDX-FileCopyrightText: The contributors to the LICHEN project

config LICHEN_TUNNEL_AUTH
	bool "Fail-closed egress tunnel authorization"
	depends on LICHEN_LINK_SCHNORR
	select LICHEN_CRYPTO_MONOCYPHER
	select TINYCRYPT
	select TINYCRYPT_SHA256
	help
	  Verify root-issued COSE_Sign1 tunnel grants and enforce them before
	  forwarding inner IPv6 packets to an external interface.

if LICHEN_TUNNEL_AUTH

config LICHEN_TUNNEL_AUTH_MAX_ENTRIES
	int "Maximum active tunnel grants"
	default 8
	range 1 32

config LICHEN_TUNNEL_AUTH_MAX_HISTORY
	int "Maximum retained replay/revocation floors"
	default 32
	range LICHEN_TUNNEL_AUTH_MAX_ENTRIES 128

endif
```

## lichen/subsys/lichen/gcp/Kconfig
```kconfig
# SPDX-License-Identifier: GPL-3.0-or-later
# SPDX-FileCopyrightText: The contributors to the LICHEN project

# Gateway Coordination Protocol (GCP) Kconfig

menuconfig LICHEN_GCP
	bool "LICHEN Gateway Coordination Protocol (GCP)"
	help
	  Enable multi-gateway coordination per spec/08-gateway-coordination.md.
	  Provides slot coordination, node handoff, and federation support.

if LICHEN_GCP

config LICHEN_GCP_TRUST
	bool "GCP-3 Trust Models"
	default y
	depends on LICHEN_CRYPTO_MONOCYPHER
	depends on LICHEN_LINK_SCHNORR
	help
	  Enable dual-mode federation trust models:
	  - Closed federation: PSK-based OSCORE
	  - Open federation: Ed25519 + Schnorr-48 + TOFU

	  Required for multi-operator community meshes and
	  enterprise deployments with managed key distribution.

config LICHEN_GCP_LOG_LEVEL
	int "GCP logging level"
	default 3
	range 0 4
	help
	  Set the logging level for GCP module:
	  0 = OFF, 1 = ERR, 2 = WRN, 3 = INF, 4 = DBG

endif # LICHEN_GCP
```

## lichen/subsys/lichen/udp_port_dispatch/Kconfig
```kconfig
# SPDX-License-Identifier: GPL-3.0-or-later
# SPDX-FileCopyrightText: The contributors to the LICHEN project

config LICHEN_UDP_PORT_DISPATCH
	bool "LICHEN UDP application port dispatch"
	depends on LICHEN
	default y
	help
	  Enable bounded destination-port dispatch for the LICHEN application
	  assignments in spec/07-transport-app.md.
```

## lichen/tests/app_identity/testcase.yaml
```yaml
# SPDX-License-Identifier: GPL-3.0-or-later
# SPDX-FileCopyrightText: The contributors to the LICHEN project

tests:
  net.lichen.app_identity.ipv6_off:
    tags:
      - lichen
      - app_identity
    platform_allow:
      - native_sim
      - native_sim/native/64
      - qemu_x86
    integration_platforms:
      - native_sim
      - native_sim/native/64
      - qemu_x86
    extra_configs:
      - CONFIG_LICHEN_IPV6=n
  net.lichen.app_identity.ipv6_on:
    tags:
      - lichen
      - app_identity
    platform_allow:
      - native_sim
      - native_sim/native/64
      - qemu_x86
    integration_platforms:
      - native_sim
      - native_sim/native/64
      - qemu_x86
    extra_args:
      - EXTRA_CONF_FILE=ipv6_on.conf
```

## lichen/tests/app_identity_rollback/testcase.yaml
```yaml
# SPDX-License-Identifier: GPL-3.0-or-later
# SPDX-FileCopyrightText: The contributors to the LICHEN project

tests:
  lichen.app_identity.rollback_authority:
    platform_allow:
      - qemu_x86
    tags:
      - lichen
      - identity
      - security
      - settings
```

## lichen/tests/checkin_resource/testcase.yaml
```yaml
# SPDX-License-Identifier: GPL-3.0-or-later
# SPDX-FileCopyrightText: The contributors to the LICHEN project

tests:
  lichen.checkin_resource:
    tags:
      - coap
      - checkin
      - rollcall
    platform_allow:
      - native_sim
      - native_sim/native/64
      - qemu_x86
      - qemu_x86_64
    integration_platforms:
      - qemu_x86
      - qemu_x86_64
```

## lichen/tests/coap_blockwise/testcase.yaml
```yaml
# SPDX-License-Identifier: GPL-3.0-or-later
# SPDX-FileCopyrightText: The contributors to the LICHEN project

tests:
  lichen.coap_blockwise:
    platform_allow: qemu_x86 native_sim
    tags: coap blockwise rfc7959 security
```

## lichen/tests/coap_config/testcase.yaml
```yaml
# SPDX-License-Identifier: GPL-3.0-or-later
# SPDX-FileCopyrightText: The contributors to the LICHEN project

tests:
  lichen.coap.config:
    tags: coap config lci
    platform_allow:
      - native_sim
      - native_sim/native/64
      - qemu_x86
```

## lichen/tests/coap_keys_lifecycle/testcase.yaml
```yaml
# SPDX-License-Identifier: GPL-3.0-or-later
# SPDX-FileCopyrightText: The contributors to the LICHEN project

tests:
  lichen.coap_keys.protected_lifecycle:
    platform_allow:
      - qemu_x86
    tags:
      - lichen
      - coap
      - tofu
      - security
      - settings
```

## lichen/tests/coap_location_beacon/testcase.yaml
```yaml
# SPDX-License-Identifier: GPL-3.0-or-later
# SPDX-FileCopyrightText: The contributors to the LICHEN project

tests:
  lichen.coap.location_beacon:
    tags:
      - lichen
      - coap
      - location
    platform_allow:
      - qemu_x86
    integration_platforms:
      - qemu_x86
```

## lichen/tests/coap_msg_inbox/testcase.yaml
```yaml
# SPDX-License-Identifier: GPL-3.0-or-later
# SPDX-FileCopyrightText: The contributors to the LICHEN project

tests:
  lichen.coap_msg_inbox:
    platform_allow: qemu_x86 native_sim
    tags: coap messaging observe security
```

## lichen/tests/coap_status_get/testcase.yaml
```yaml
# SPDX-License-Identifier: GPL-3.0-or-later
# SPDX-FileCopyrightText: The contributors to the LICHEN project

tests:
  lichen.coap.status_get:
    tags: coap status lci
    platform_allow:
      - native_sim
      - native_sim/native/64
      - qemu_x86
```

## lichen/tests/coap_waypoints/testcase.yaml
```yaml
# SPDX-License-Identifier: GPL-3.0-or-later
# SPDX-FileCopyrightText: The contributors to the LICHEN project

tests:
  lichen.coap_waypoints:
    platform_allow: qemu_x86 native_sim
    tags: coap waypoints storage cbor security
```

## lichen/tests/compat_valid_utf8/testcase.yaml
```yaml
# SPDX-License-Identifier: GPL-3.0-or-later
# SPDX-FileCopyrightText: The contributors to the LICHEN project

tests:
  net.lichen.compat_valid_utf8:
    platform_allow:
      - native_sim
      - native_sim/native/64
    tags: meshcore
```
