/*
 * BLOCKED: LilyGO T-Beam Supreme (ESP32-S3 + SX1262)
 *
 * No canonical Zephyr board definition exists (investigated lichen/boards/
 * and Zephyr boards/lilygo/, heltec/; no tbeam_supreme or supreme dir).
 * Closest canonical targets: heltec_wifi_lora32_v3/esp32s3/procpu or
 * lilygo/t_deck_esp32s3_procpu. Puck target is orphaned per m5m1.8 audit.
 * Classified BLOCKED with evidence; do not present as supported.
 * Future support tracked by project-LICHEN-w8rd.
 */

/ {
	chosen {
		zephyr,lora = &lora0;
	};
};

/* SX1262 is on FSPI — pin assignments match the T-Beam Supreme schematic.
 * Update cs-gpios / reset-gpios / busy-gpios if the upstream board file
 * uses different GPIO numbers. */
&lora0 {
	status = "okay";

	tx-power = <22>;        /* dBm */
	frequency = <868000000>;
};
