## lichen/boards/muzi/r1_neo/Kconfig.r1_neo
```kconfig
# Muzi Works R1 Neo board selection
# SPDX-License-Identifier: GPL-3.0-or-later

config BOARD_R1_NEO
	select SOC_NRF52840_QIAA
```

## lichen/boards/muzi/r1_neo/r1_neo_nrf52840_defconfig
```kconfig
# SPDX-License-Identifier: GPL-3.0-or-later

CONFIG_ARM_MPU=y
CONFIG_HW_STACK_PROTECTION=y

# 32 kHz crystal is populated on the nRF52840 module.
CONFIG_CLOCK_CONTROL_NRF_K32SRC_XTAL=y

CONFIG_GPIO=y
CONFIG_SPI=y
CONFIG_I2C=y
CONFIG_ADC=y
CONFIG_SERIAL=y

# Native USB CDC-ACM console.
CONFIG_USB_DEVICE_STACK=y
CONFIG_USB_CDC_ACM=y
CONFIG_UART_CONSOLE=y
CONFIG_CONSOLE=y
```

## lichen/boards/seeed/t1000_e/Kconfig
```kconfig
# SPDX-License-Identifier: GPL-3.0-or-later

if BOARD_T1000_E

config BOARD_ENABLE_DCDC
	bool "Enable DC/DC converter"
	select SOC_DCDC_NRF52X
	default y

endif # BOARD_T1000_E
```

## lichen/boards/seeed/t1000_e/Kconfig.defconfig
```kconfig
# SPDX-License-Identifier: GPL-3.0-or-later

if BOARD_T1000_E

config BT_CTLR
	default BT

endif # BOARD_T1000_E
```

## lichen/boards/seeed/t1000_e/Kconfig.t1000_e
```kconfig
# Seeed SenseCAP T1000-E board selection
# SPDX-License-Identifier: GPL-3.0-or-later

config BOARD_T1000_E
	select SOC_NRF52840_QIAA
```

## lichen/boards/seeed/t1000_e/t1000_e_nrf52840_defconfig
```kconfig
# SPDX-License-Identifier: GPL-3.0-or-later

CONFIG_ARM_MPU=y
CONFIG_HW_STACK_PROTECTION=y

# 32 kHz XTAL present
CONFIG_CLOCK_CONTROL_NRF_K32SRC_XTAL=y

CONFIG_GPIO=y
CONFIG_SPI=y

# USB CDC-ACM console (native USB)
CONFIG_USB_DEVICE_STACK=y
CONFIG_USB_CDC_ACM=y
CONFIG_UART_CONSOLE=y
CONFIG_CONSOLE=y
```

## lichen/drivers/Kconfig
```kconfig
rsource "lora/Kconfig"
rsource "lora_loopback/Kconfig"
rsource "gnss/Kconfig"
rsource "input/Kconfig"
```

## lichen/drivers/gnss/Kconfig
```kconfig
config GNSS_AG3335
	bool "Airoha AG3335 GNSS driver"
	default y
	depends on DT_HAS_AIROHA_AG3335_ENABLED
	select GNSS
	select MODEM_MODULES
	select MODEM_BACKEND_UART
	select MODEM_CHAT
	select GNSS_PARSE
	select GNSS_NMEA0183
	select GNSS_NMEA0183_MATCH
	help
	  Driver for the Airoha AG3335 GNSS receiver. Outputs standard
	  NMEA-0183 at 115200 baud; no host-side init sequence required.

if GNSS_AG3335

config GNSS_AG3335_SATELLITES_COUNT
	int "Maximum satellite count"
	depends on GNSS_SATELLITES
	default 24
	help
	  Maximum number of satellites reported in the satellites callback.

endif # GNSS_AG3335
```

## lichen/drivers/input/Kconfig
```kconfig
# SPDX-License-Identifier: GPL-3.0-or-later

config INPUT_LILYGO_TDECK_KEYBOARD
	bool "LilyGO T-Deck keyboard and trackball (I2C 0x55)"
	default y
	depends on DT_HAS_LILYGO_TDECK_KEYBOARD_ENABLED
	select INPUT
	select I2C
	help
	  Driver for lilygo,tdeck-keyboard at I2C addr 0x55 following Zephyr input patterns.
```

## lichen/drivers/lora/Kconfig
```kconfig
config LORA_LICHEN_SIM
	bool "LICHEN simulator LoRa driver"
	depends on LORA
	select NET_SOCKETS
	select NET_SOCKETS_POSIX_NAMES
	help
	  TCP client driver for native_sim builds. Connects to the lichen-sim
	  server and presents a LoRa radio interface to the node stack.

if LORA_LICHEN_SIM

config LORA_LICHEN_SIM_HOST
	string "Simulator host address"
	default "127.0.0.1"

config LORA_LICHEN_SIM_PORT
	int "Simulator port"
	default 4444
	range 1 65535

config LORA_LICHEN_SIM_NODE_ID
	string "Node identifier sent to simulator at registration"
	default "node0"
	help
	  ASCII string identifying this node to the simulator (e.g. "gw0",
	  "node1"). Must be unique across all nodes in the simulation.

config LORA_LICHEN_SIM_SIM_ID
	string "Simulation run identifier"
	default "lichen"

endif # LORA_LICHEN_SIM

rsource "lr1110/Kconfig"
```

## lichen/drivers/lora/lr1110/Kconfig
```kconfig
#
# Copyright (c) 2024 The contributors to the LICHEN project
# SPDX-License-Identifier: Apache-2.0
#

config LORA_LR1110
	bool "Semtech LR1110 driver"
	default y
	depends on DT_HAS_SEMTECH_LR1110_ENABLED
	select SPI
	help
	  Enable driver for the Semtech LR1110 LoRa modem.
	  Uses the lr1110_driver library from the loramac-node module.
```

## lichen/drivers/lora_loopback/Kconfig
```kconfig
# SPDX-License-Identifier: Apache-2.0
# SPDX-FileCopyrightText: The contributors to the LICHEN project

config LORA_LOOPBACK
	bool "LoRa loopback driver for testing"
	depends on LORA
	help
	  Simple loopback driver for native_sim that loops transmitted packets
	  back to the receiver. No external simulator or hardware required.
	  Useful for testing the L2 stack without network connectivity.

if LORA_LOOPBACK

config LORA_LOOPBACK_QUEUE_DEPTH
	int "Loopback queue depth"
	default 8
	range 1 64
	help
	  Maximum number of packets that can be queued for loopback.
	  Packets sent when the queue is full will be dropped.

config LORA_LOOPBACK_RSSI
	int "Simulated RSSI value (dBm)"
	default -50
	range -150 0
	help
	  RSSI value reported for received loopback packets.

config LORA_LOOPBACK_SNR
	int "Simulated SNR value (dB)"
	default 10
	range -20 20
	help
	  SNR value reported for received loopback packets.

config LORA_LOOPBACK_MTU
	int "Maximum packet size (MTU)"
	default 200
	range 1 255
	help
	  Maximum packet size in bytes. Packets larger than this are
	  rejected with -EMSGSIZE. Default 200 matches LICHEN_LORA_MTU.

endif # LORA_LOOPBACK
```

## lichen/dts/bindings/gnss/airoha,ag3335.yaml
```yaml
# SPDX-License-Identifier: Apache-2.0
# Copyright (c) 2024 The contributors to the LICHEN project

description: |
  Airoha AG3335 GNSS receiver (NMEA-0183 via UART).

  Streams standard NMEA sentences at 115200 baud with no host-side
  initialisation required.  Power sequencing uses four GPIOs derived
  from the Seeed SenseCAP T1000-E schematic.

  Example (nRF52840, T1000-E pin assignments):

    &uart1 {
      current-speed = <115200>;
      ...
      gnss0: ag3335 {
        compatible = "airoha,ag3335";
        enable-gpios    = <&gpio1 11 GPIO_ACTIVE_HIGH>;
        vrtc-gpios      = <&gpio0  8 GPIO_ACTIVE_HIGH>;
        sleep-int-gpios = <&gpio1 12 GPIO_ACTIVE_HIGH>;
        reset-gpios     = <&gpio1 15 GPIO_ACTIVE_HIGH>;
      };
    };

compatible: "airoha,ag3335"

include:
  - uart-device.yaml

properties:
  enable-gpios:
    type: phandle-array
    required: true
    description: GPS_EN — main power enable (active HIGH)

  vrtc-gpios:
    type: phandle-array
    required: true
    description: GPS_VRTC_EN — RTC backup supply; held HIGH at all times

  sleep-int-gpios:
    type: phandle-array
    required: true
    description: GPS_SLEEP_INT — held HIGH for normal (non-sleep) operation

  reset-gpios:
    type: phandle-array
    required: true
    description: GPS_RESET — active-HIGH reset pulse
```

## lichen/dts/bindings/input/lilygo,tdeck-keyboard.yaml
```yaml
# SPDX-License-Identifier: GPL-3.0-or-later
# SPDX-FileCopyrightText: The contributors to the LICHEN project

description: LilyGo T-Deck I2C keyboard controller
compatible: "lilygo,tdeck-keyboard"
include: i2c-device.yaml
properties:
  reg:
    required: true
    description: I2C address, must be 0x55
```

## lichen/dts/bindings/lora/lichen,lora-sim.yaml
```yaml
description: LICHEN simulator LoRa driver (TCP client to lichen-sim)
compatible: "lichen,lora-sim"
include: base.yaml
```

## lichen/dts/bindings/lora/semtech,lr1110.yaml
```yaml
# Copyright (c) 2024 The contributors to the LICHEN project
# SPDX-License-Identifier: Apache-2.0

description: Semtech LR1110 LoRa/GNSS/Wi-Fi Modem

compatible: "semtech,lr1110"

include: spi-device.yaml

properties:
  reset-gpios:
    type: phandle-array
    required: true
    description: |
      GPIO connected to NRESET (active-low). The LR1110 reset is asserted
      by driving this pin low for at least 100 us.

  busy-gpios:
    type: phandle-array
    required: true
    description: |
      GPIO connected to the BUSY output (active-high). The modem holds
      BUSY high while processing a command; the HAL must wait for it to
      fall before issuing the next command.

  dio9-gpios:
    type: phandle-array
    required: true
    description: |
      GPIO connected to DIO9. This is the primary radio interrupt line
      used to signal TX-done, RX-done, and error conditions.

  tx-enable-gpios:
    type: phandle-array
    description: |
      Optional RF switch TX-enable GPIO.  When present the driver asserts
      this during transmission and de-asserts during reception.

  tcxo-power-startup-delay-ms:
    type: int
    description: |
      Startup stabilisation delay in milliseconds for an external TCXO
      supplied by the LR1110's TCXO supply pin.  Omit if a crystal or
      no TCXO is used.

  hp-max-power:
    type: boolean
    description: |
      Select the High-Power PA path (up to +22 dBm, requires VBAT > 3.7 V)
      instead of the default Low-Power PA path (up to +14 dBm, DCDC).
```

## lichen/lib/native/Kconfig
```kconfig
config LICHEN_NATIVE
	bool "Legacy LICHEN Native CBOR protocol library"
	depends on LICHEN_HAL
	depends on UART_INTERRUPT_DRIVEN
	depends on ZCBOR
	help
	  Enables the historical LICHEN Native framing library (0xC1 + CBOR
	  over USB CDC-ACM or serial UART). This is not the current LCI app
	  contract; new local-client transports carry IPv6 packets and use
	  CoAP resources from spec/11-lci.md. Runtime transport discovery
	  uses the LICHEN HAL serial-local API.

if LICHEN_NATIVE

config LICHEN_NATIVE_TX_BUF_SIZE
	int "TX scratch buffer (bytes)"
	default 512
	help
	  Scratch buffer used to encode one outgoing CBOR frame.
	  Must be large enough for the largest message you send.

config LICHEN_NATIVE_RX_BUF_SIZE
	int "RX reassembly buffer (bytes)"
	default 512
	help
	  Buffer for incoming frame payload reassembly.

config LICHEN_NATIVE_RX_STACK_SIZE
	int "RX thread stack size (bytes)"
	default 1024

config LICHEN_NATIVE_BUZZER
	bool "Enable startup buzzer beeps (T1000-E only)"
	default n
	help
	  Emit two beep tones via P0.25/P1.05 on native transport init.
	  Only for T1000-E which has a buzzer; must not be set on boards
	  where P0.25 is used for another purpose (e.g. T-Echo LoRa RESET).

endif # LICHEN_NATIVE
```

## lichen/subsys/lichen/Kconfig
```kconfig
# SPDX-License-Identifier: GPL-3.0-or-later
# SPDX-FileCopyrightText: The contributors to the LICHEN project

# LICHEN protocol subsystem Kconfig

menuconfig LICHEN
	bool "LICHEN protocol stack"
	help
	  Enable the LICHEN (LoRa IPv6 CoAP Hybrid Extended Network)
	  protocol stack for mesh networking over LoRa.

if LICHEN

rsource "app_identity/Kconfig"
rsource "app_interface/Kconfig"
rsource "coap/Kconfig"
rsource "crypto/Kconfig"
rsource "edhoc/Kconfig"
rsource "hal/Kconfig"
rsource "link/Kconfig"
rsource "meshcore/Kconfig"
rsource "meshtastic/Kconfig"
rsource "l2/Kconfig"
rsource "oscore/Kconfig"
rsource "schc/Kconfig"
rsource "senml/Kconfig"
rsource "rpl/Kconfig"
rsource "routing/Kconfig"
rsource "transport/Kconfig"

config LICHEN_ADAPTIVE_SF_ENABLED
	bool "Adaptive spreading factor selection (per-neighbor SNR/CCP16)"
	default y
	depends on LICHEN_RPL
	help
	  Enable dynamic selection of LoRa spreading factor per neighbor based on
	  SNR measurements and density signals from CCP16. Improves network
	  capacity in dense deployments. See spec/appendix-design-rationale.md.
	  When disabled, falls back to
	  CONFIG_LICHEN_DEFAULT_SF.

config LICHEN_DEFAULT_SF
	int "Default spreading factor (when adaptive SF disabled)"
	default 10
	range 7 12
	depends on LICHEN
	help
	  Default SF for transmissions when adaptive SF is not enabled.
	  SF7 = highest bitrate/shortest range; SF12 = lowest bitrate/longest range.
	  Must match regional regulations and link budget.

config LICHEN_DUTY_CYCLE
	bool "Duty cycle tracker (CCP-13)"
	default y
	depends on LICHEN

endif # LICHEN

# Resolved merge conflict project-LICHEN-cbvp (worktree-worker23:Kconfig), project-LICHEN-98r7 (integration/worker3-20260722:Kconfig), project-LICHEN-2y4e (worktree-worker20:Kconfig), project-LICHEN-8nhx (worktree-worker24:Kconfig).
# Consolidated LICHEN_*_SF and LICHEN_DUTY_CYCLE definitions to top-level
# lichen/subsys/lichen/Kconfig; removed duplicates from hal/l2/link per prior fixes
# (a0yn/syn6/48xu/9nq6/z4oj/nm65/07am/8nhx). Cleaned stale bead refs (zrh2/da2q/5273) from
# adaptive-SF/CCA/TDMA/multi-channel help texts per worker20. Fixed whitespace/indent from
# parallel workers. Matches canonical style. No dead code.
```

## lichen/subsys/lichen/crypto/Kconfig
```kconfig
# SPDX-License-Identifier: GPL-3.0-or-later
# SPDX-FileCopyrightText: The contributors to the LICHEN project

# LICHEN crypto subsystem Kconfig

config LICHEN_CRYPTO_AES_CCM
	bool "AES-CCM-16-64-128 helper"
	depends on LICHEN
	select TINYCRYPT
	select TINYCRYPT_AES
	select TINYCRYPT_AES_CCM
	help
	  Include the AES-CCM-16-64-128 helper used by OSCORE.

config LICHEN_CRYPTO_MONOCYPHER
	bool "Monocypher cryptographic library"
	help
	  Include the Monocypher cryptographic library (v4.0.3).
	  Provides Ed25519/EdDSA primitives, SHA-512, X25519, and
	  authenticated encryption.

	  This is required for Schnorr-48 link signatures.
	  Size: ~3KB code on Cortex-M.
```

## lichen/subsys/lichen/edhoc/Kconfig
```kconfig
# SPDX-License-Identifier: GPL-3.0-or-later
# SPDX-FileCopyrightText: The contributors to the LICHEN project

menuconfig LICHEN_EDHOC
	bool "EDHOC (RFC 9528) Suite 0 support"
	depends on LICHEN_CRYPTO_MONOCYPHER
	depends on ZCBOR
	select TINYCRYPT
	select TINYCRYPT_SHA256
	select TINYCRYPT_HMAC
	select TINYCRYPT_AES
	select TINYCRYPT_AES_CCM
	help
	  Enable EDHOC (Ephemeral Diffie-Hellman Over COSE) for establishing
	  OSCORE security contexts. Uses Suite 0: X25519 + Ed25519 + AES-CCM.

if LICHEN_EDHOC

config LICHEN_EDHOC_LOG_LEVEL
	int "EDHOC log level"
	default 3
	range 0 4
	help
	  Log level for EDHOC module (0=off, 1=err, 2=wrn, 3=inf, 4=dbg)

endif # LICHEN_EDHOC
```
