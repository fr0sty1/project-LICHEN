## lichen/subsys/lichen/hal/Kconfig
```kconfig
# SPDX-License-Identifier: GPL-3.0-or-later
# SPDX-FileCopyrightText: The contributors to the LICHEN project

menuconfig LICHEN_HAL
	bool "LICHEN board capability HAL"
	depends on LICHEN
	default y
	help
	  Enable the small board capability boundary used by LICHEN apps.

	  Board ports should describe hardware using these Kconfig symbols plus
	  the devicetree conventions documented below. Protocol and application
	  code should consume the HAL API instead of open-coding board-specific
	  devicetree aliases or board names.

if LICHEN_HAL

config LICHEN_BOARD_NAME
	string "LICHEN board identity override"
	default ""
	help
	  Optional user-facing board name override. If left empty, the HAL
	  reports CONFIG_BOARD.

config LICHEN_HAS_LORA
	bool "Board has a LICHEN LoRa radio"
	depends on LORA
	help
	  Enable when devicetree provides an okay chosen zephyr,lora.

config LICHEN_HAS_BLE_LOCAL
	bool "Board supports BLE local-client transport"
	depends on BT
	depends on BT_PERIPHERAL
	help
	  Enable when the board can expose the local client interface over BLE.

config LICHEN_HAS_SERIAL_LOCAL
	bool "Board supports serial local-client transport"
	help
	  Enable when the board can expose the local client interface over a
	  lichen,native-uart, zephyr,uart-pipe, Zephyr serial console,
	  shell UART, SLIP UART, CDC ACM device, or board overlay.

config LICHEN_HAS_GNSS
	bool "Board has GNSS"
	depends on GNSS
	help
	  Enable when devicetree provides an okay gnss0 alias.

config LICHEN_HAS_BATTERY
	bool "Board has battery measurement"
	depends on SENSOR || FUEL_GAUGE
	help
	  Enable when devicetree provides an okay battery0 alias backed by a
	  Zephyr voltage-divider sensor or fuel-gauge device.

config LICHEN_HAS_PMIC
 	bool "Board has PMIC or charger control"
 	depends on CHARGER || SENSOR || I2C || GPIO || ADC
 	help
 	  Enable when devicetree provides an okay pmic0 alias for a Zephyr
 	  charger, PMIC, or board-specific power telemetry/control device.

config LICHEN_HAS_POE
	bool "Board has PoE"
	depends on REGULATOR
	depends on ADC
	help
	  Enable when devicetree provides an okay poe0 alias or PoE detection
	  via GPIO/ADC for power source selection. DT binding in
	  dts/bindings/power/lichen,poe.yaml.

config LICHEN_HAS_BUTTONS
	bool "Board has user buttons"
	depends on GPIO
	help
	  Enable when devicetree provides at least an okay sw0 alias.

config LICHEN_HAS_LEDS
	bool "Board has user LEDs"
	depends on GPIO
	help
	  Enable when devicetree provides at least an okay led0 alias.

config LICHEN_HAS_DISPLAY
	bool "Board has a display"
	depends on DISPLAY
	help
	  Enable when devicetree provides chosen zephyr,display or an okay
	  display0 alias.

config LICHEN_HAS_EXTERNAL_FLASH
	bool "Board has external flash"
	depends on FLASH
	help
	  Enable when devicetree provides an okay external-flash0 alias.

choice LICHEN_RADIO_MODEL
	prompt "LICHEN radio model"
	default LICHEN_RADIO_MODEL_LOOPBACK if LORA_LOOPBACK
	default LICHEN_RADIO_MODEL_SIM if LORA_LICHEN_SIM
	default LICHEN_RADIO_MODEL_RENODE if LORA_LICHEN_RENODE
	default LICHEN_RADIO_MODEL_LR1110 if LORA_LR1110
	default LICHEN_RADIO_MODEL_STM32WL if LORA_STM32WL_SUBGHZ_RADIO
	default LICHEN_RADIO_MODEL_SX126X if LORA_SX126X
	default LICHEN_RADIO_MODEL_SX127X if LORA_SX127X
	default LICHEN_RADIO_MODEL_NONE
	help
	  Radio silicon family used by the LICHEN board port.

config LICHEN_RADIO_MODEL_NONE
	bool "No LoRa radio"
	depends on !LICHEN_HAS_LORA

config LICHEN_RADIO_MODEL_SX126X
	bool "Semtech SX126x"
	depends on LICHEN_HAS_LORA

config LICHEN_RADIO_MODEL_SX127X
	bool "Semtech SX127x"
	depends on LICHEN_HAS_LORA

config LICHEN_RADIO_MODEL_LR1110
	bool "Semtech LR1110"
	depends on LICHEN_HAS_LORA

config LICHEN_RADIO_MODEL_STM32WL
	bool "STM32WL integrated Sub-GHz radio"
	depends on LICHEN_HAS_LORA

config LICHEN_RADIO_MODEL_SIM
	bool "LICHEN simulator LoRa"
	depends on LICHEN_HAS_LORA

config LICHEN_RADIO_MODEL_LOOPBACK
	bool "LICHEN loopback LoRa"
	depends on LICHEN_HAS_LORA

config LICHEN_RADIO_MODEL_RENODE
	bool "LICHEN Renode LoRa"
	depends on LICHEN_HAS_LORA

endchoice

choice LICHEN_UI_PROFILE
	prompt "LICHEN UI profile"
	default LICHEN_UI_PROFILE_HEADLESS
	help
	  Coarse UI shape exposed to apps. It is intentionally small so board
	  overlays, not app code, own display/button/LED details.

config LICHEN_UI_PROFILE_HEADLESS
	bool "Headless"

config LICHEN_UI_PROFILE_TRACKER
	bool "Tracker"
	depends on LICHEN_HAS_LEDS || LICHEN_HAS_BUTTONS || LICHEN_HAS_DISPLAY

config LICHEN_UI_PROFILE_HANDHELD
	bool "Handheld"
	depends on LICHEN_HAS_DISPLAY

endchoice

choice LICHEN_LOCATION_PROVIDER
	prompt "LICHEN location provider"
	default LICHEN_LOCATION_PROVIDER_NONE

config LICHEN_LOCATION_PROVIDER_NONE
	bool "No location provider"

config LICHEN_LOCATION_PROVIDER_GNSS
	bool "GNSS"
	depends on LICHEN_HAS_GNSS

endchoice

config LICHEN_LOCATION_FRESHNESS_MAX_AGE_S
	int "Maximum fresh location age in seconds"
	default 300
	range 1 86400
	help
	  Maximum age before a submitted location fix is treated as stale. Stale
	  samples keep source metadata for status reporting but do not export
	  position fields to app-compatibility consumers.

choice LICHEN_TIME_PROVIDER
	prompt "LICHEN time provider"
	default LICHEN_TIME_PROVIDER_GNSS if LICHEN_CCP_TIME_SYNC && LICHEN_HAS_GNSS
	default LICHEN_TIME_PROVIDER_UPTIME

config LICHEN_TIME_PROVIDER_UPTIME
	bool "Uptime only"

config LICHEN_TIME_PROVIDER_GNSS
	bool "GNSS time"
	depends on LICHEN_HAS_GNSS

endchoice

config LICHEN_TIME_BUILD_EPOCH_UNIX
	int "Deterministic firmware build epoch floor"
	default 1700000000
	range 1 2147483647
	help
	  Deterministic Unix timestamp used as the minimum plausible wall-clock
	  value. Production builds must set this from reproducible build
	  metadata, preferably SOURCE_DATE_EPOCH, or an explicit release epoch.

choice LICHEN_TIME_BUILD_EPOCH_SOURCE
	prompt "Firmware build epoch metadata source"
	default LICHEN_TIME_BUILD_EPOCH_SOURCE_FIXED
	help
	  Records where CONFIG_LICHEN_TIME_BUILD_EPOCH_UNIX came from. Production
	  firmware entry points set this through lichen_build_epoch.cmake before
	  Zephyr loads Kconfig.

config LICHEN_TIME_BUILD_EPOCH_SOURCE_FIXED
	bool "Fixed Kconfig default or test override"

config LICHEN_TIME_BUILD_EPOCH_SOURCE_DATE_EPOCH
	bool "SOURCE_DATE_EPOCH"

config LICHEN_TIME_BUILD_EPOCH_SOURCE_RELEASE
	bool "Explicit release epoch"

config LICHEN_TIME_BUILD_EPOCH_SOURCE_DEVELOPER_GENERATED
	bool "Explicit developer generated timestamp"

config LICHEN_TIME_BUILD_EPOCH_SOURCE_DEVELOPER_FIXED
	bool "Explicit developer fixed timestamp"

endchoice

config LICHEN_TIME_PROVISION_MAX_LEAD_S
	int "Maximum provision epoch lead over build epoch"
	default 31536000
	range 0 2147483647
	help
	  Maximum accepted board provision timestamp lead over the firmware build
	  epoch. This is a deterministic release policy bound, not a comparison
	  with an untrusted runtime clock.

config LICHEN_TIME_FRESHNESS_MAX_AGE_S
	int "Maximum fresh wall-clock time age in seconds"
	default 86400
	range 1 2147483647
	help
	  Maximum age before an accepted wall-clock sample is considered stale.
	  Stale samples remain visible as diagnostics but no longer establish
	  wall-clock validity.

endif # LICHEN_HAL
```
